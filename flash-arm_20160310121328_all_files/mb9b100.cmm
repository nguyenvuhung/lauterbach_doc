; --------------------------------------------------------------------------------
; @Title: Generic script for Fujitsu MB9B100 and MB9B100A series internal flash
;
; @Description: 
; Example for flash declaration of Fujitsu MB9B100 and MB9B100A series
; internal flash.
;
; Script arguments:
;
;   DO mb9b100 [PREPAREONLY] [CPU=<cpu>]
;
;     PREPAREONLY only declares flash but does not execute flash programming
;
;     CPU=<cpu> selects CPU derivative <cpu>
;
; Example:
;
;   DO ~~/demo/arm/flash/mb9b100 CPU=MB9BF106R PREPAREONLY
;
; List of MB9B100 and MB9B100A series derivatives and their configuration:
;
;   CPU-Type   Derivatives   FlashSize   RamSize
;                               [kB]       [kB]
; --------------------------------------------------------------------------------
;   MB9BF102N  MB9BF102NA       128.       16.
;   MB9BF102R  MB9BF102RA       128.       16.
;   MB9BF104N  MB9BF104N        256.       32.
;              MB9BF104NA
;   MB9BF104R  MB9BF104R        256.       32.
;              MB9BF104RA
;   MB9BF105N  MB9BF105N        384.       48.
;              MB9BF105RA
;   MB9BF105R  MB9BF105R        384.       48.
;              MB9BF105RA
;   MB9BF106N  MB9BF106N        512.       64.
;              MB9BF106RA
;   MB9BF106R  MB9BF106R        512.       64.
;              MB9BF106RA
;
; @Author: WRD
; @Copyright: (C) 1989-2014 Lauterbach GmbH, licensed for use with TRACE32(R) only
; @Chip: MB9BF10* 
; --------------------------------------------------------------------------------
; $Rev: 2903 $
; $Id: mb9b100.cmm 2903 2014-07-16 11:19:46Z kjmal $

  LOCAL &parameters &param_prepareonly
  ENTRY %LINE &parameters
  &param_prepareonly=(STRing.SCAN(STRing.UPpeR("&parameters"),"PREPAREONLY",0)!=-1)

  LOCAL &param_cpu
  &param_cpu=STRing.SCANAndExtract(STRing.UPpeR("&parameters"),"CPU=","")

  ; ------------------------------------------------------------------------------
  ; Start debugging

  IF SYStem.MODE()<5
  (
    Break.RESet
    SYStem.RESet

    IF "&param_cpu"!=""
      SYStem.CPU &param_cpu
    IF !CPUIS(MB9BF10*)
      SYStem.CPU MB9BF10*

    IF CABLE.TWOWIRE()
      SYStem.CONFIG.DEBUGPORTTYPE SWD
    ELSE
      SYStem.CONFIG.DEBUGPORTTYPE JTAG

    SYStem.Option.ResBreak OFF
    SYStem.Up
  )

  ; ------------------------------------------------------------------------------
  ; Flash declaration

  FLASH.RESet
  GOSUB FlashDeclaration

  ; ------------------------------------------------------------------------------
  ; Flash programming example

  ; Flash script ends here if called with parameter PREPAREONLY
  IF &param_prepareonly
    ENDDO PREPAREDONE

  DIALOG.YESNO "Program flash memory?"
  LOCAL &progflash
  ENTRY &progflash
  IF &progflash 
  (
    FLASH.ReProgram.ALL /Erase
    Data.LOAD.auto *
    FLASH.ReProgram.off

    ; Reset device
    SYStem.Down
    SYStem.Up
  )

  ENDDO


; --------------------------------------------------------------------------------
; Flash declaration depending on selected CPU 

FlashDeclaration:
  LOCAL &FlashSize

  IF CPUIS("MB9BF102?")
  (
    &FlashSize=0x20000
  )
  ELSE IF CPUIS("MB9BF104?")
  (
    &FlashSize=0x40000
  )
  ELSE IF CPUIS("MB9BF105?")
  (
    &FlashSize=0x60000
  )
  ELSE IF CPUIS("MB9BF106?")
  (
    &FlashSize=0x80000
  )
  ELSE
  (
    PRINT %ERROR "FLASH size of CPU type is unknown"
    ENDDO
  )

  IF &FlashSize>=0x20000
  (
    FLASH.Create 1. 0x000000--0x007FFF  0x4000 TARGET Word
    FLASH.Create 1. 0x008000--0x01FFFF 0x18000 TARGET Word
  )
  IF &FlashSize>=0x40000
  (
    FLASH.Create 1. 0x020000--0x03FFFF 0x20000 TARGET Word
  )
  IF &FlashSize>=0x60000
  (
    FLASH.Create 1. 0x040000--0x05FFFF 0x20000 TARGET Word
  )
  IF &FlashSize>=0x80000
  (
    FLASH.Create 1. 0x060000--0x07FFFF 0x20000 TARGET Word
  )

  FLASH.TARGET 0x1FFFF000 0x20000000 0x1000 ~~/demo/arm/flash/word/fm3t0.bin

  RETURN
