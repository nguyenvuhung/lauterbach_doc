; --------------------------------------------------------------------------------
; @Title: TMS470 internal flash of TMS470AVF689B
;
; @Description:
; Script arguments:
;
;   DO tms470avf689b [PREPAREONLY]
;
;     PREPAREONLY only declares flash but does not execute flash programming
;
; Example:
;
;   DO ~~/demo/arm/flash/tms470avf689b PREPAREONLY
;
; internal flash is mapped to: 0x00000000
; internal RAM is mapped to:   0x01000000
;
; @Author: WRD
; @Copyright: (C) 1989-2014 Lauterbach GmbH, licensed for use with TRACE32(R) only
; --------------------------------------------------------------------------------
; $Rev: 3152 $
; $Id: tms470avf689b.cmm 3152 2015-02-06 16:35:19Z kjmal $

LOCAL &parameters
ENTRY %LINE &parameters

LOCAL &param_prepareonly
&param_prepareonly=(STRing.SCAN(STRing.UPpeR("&parameters"),"PREPAREONLY",0)!=-1)
; --------------------------------------------------------------------------------
; Init script variables

DO ~~~~/tms470-func Init

; --------------------------------------------------------------------------------
; Setup CPU
IF SYStem.MODE()<5
(
  SYStem.RESet
  SYStem.CPU TMS470AVF689B
  SYStem.Option.BigEndian ON
  SYStem.Up
)

; --------------------------------------------------------------------------------
; Flash configuration and declaration generated out of flash470.cfg file

;;;;;;;;;;;;;;;;;;;;;;;;;;;;;;;;;;;;;;;;;;;;;;;;;;
; Config for TMS470AVF689B
;;;;;;;;;;;;;;;;;;;;;;;;;;;;;;;;;;;;;;;;;;;;;;;;;;
;Device_ID=0x96f               ;TMS470AVF689B
;  ProgVersion: 0.30 ; Library version
;  ProgRoutines: f05a.lib ; Library archive
LOCAL &ProgRoutines
&ProgRoutines="f05a"

;  Frequency: 24.0 Range: 10.0 - 24.0
;  Minor Revisions: 1
;    0 "TMS470AVF689B Rev 0"
;  Ram Config: 0x01000000 0x00008000 0x00000600
LOCAL &RamStart &RamSize
&RamStart=0x01000000
&RamSize=0x00008000

;  Initialization: 4
Data.Set 0xfffffe00 %Long 0x00000000 0x00000090 0x00000004 0x00000080 0x00000100 0x00000060 0x00000000 0x00000000
Data.Set 0xfffffe20 %Long 0x00000000 0x00000000 0x00000000 0x00000000 0x00000000 0x00000000 0x00000000 0x00000000
Data.Set 0xfffffe40 %Long 0x00000000 0x00000000 0x00000000 0x00000000 0x00000000 0x00000000 0x00000000 0x00000000
Data.Set 0xfffffe00 %Long 0x00000000 0x00000190 ; Enable memory map

;  PLL Config: 0xffffffdc 0x00000008 ; configure PLL
Data.Set 0xFFFFFFDC %Long 0x00000007 ; configure PLL
LOCAL &FlashClock_Frequency
&FlashClock_Frequency="15MHz"      ; Setup flash clock frequency to PLL frequency

;  Engr ID: 0xffe88000 0x00000000
;  Protection Keys:
;    0xffe88000 0x00001ff0: 0xffffffff 0xffffffff 0xffffffff 0xffffffff
DO ~~~~/tms470-func FlashProtection 0xffe88000 0x00001ff0 0xffffffff 0xffffffff 0xffffffff 0xffffffff

;  Number of Blocks: 19
FLASH.RESet
DO ~~~~/tms470-func DeclareSector Type: OTP    Start: 0x00000000   Length: 0x00000800   Control: 0xffe88000   Core: 0x00   Sector: 0x00
DO ~~~~/tms470-func DeclareSector Type: FLASH  Start: 0x00000000   Length: 0x00002000   Control: 0xffe88000   Core: 0x00   Sector: 0x00
DO ~~~~/tms470-func DeclareSector Type: FLASH  Start: 0x00002000   Length: 0x00002000   Control: 0xffe88000   Core: 0x00   Sector: 0x01
DO ~~~~/tms470-func DeclareSector Type: FLASH  Start: 0x00004000   Length: 0x00004000   Control: 0xffe88000   Core: 0x00   Sector: 0x02
DO ~~~~/tms470-func DeclareSector Type: FLASH  Start: 0x00008000   Length: 0x00004000   Control: 0xffe88000   Core: 0x00   Sector: 0x03
DO ~~~~/tms470-func DeclareSector Type: FLASH  Start: 0x0000c000   Length: 0x00004000   Control: 0xffe88000   Core: 0x00   Sector: 0x04
DO ~~~~/tms470-func DeclareSector Type: FLASH  Start: 0x00010000   Length: 0x00004000   Control: 0xffe88000   Core: 0x00   Sector: 0x05
DO ~~~~/tms470-func DeclareSector Type: FLASH  Start: 0x00014000   Length: 0x00004000   Control: 0xffe88000   Core: 0x00   Sector: 0x06
DO ~~~~/tms470-func DeclareSector Type: FLASH  Start: 0x00018000   Length: 0x00004000   Control: 0xffe88000   Core: 0x00   Sector: 0x07
DO ~~~~/tms470-func DeclareSector Type: FLASH  Start: 0x0001c000   Length: 0x00002000   Control: 0xffe88000   Core: 0x00   Sector: 0x08
DO ~~~~/tms470-func DeclareSector Type: FLASH  Start: 0x0001e000   Length: 0x00002000   Control: 0xffe88000   Core: 0x00   Sector: 0x09
DO ~~~~/tms470-func DeclareSector Type: FLASH  Start: 0x00020000   Length: 0x00008000   Control: 0xffe88000   Core: 0x01   Sector: 0x00
DO ~~~~/tms470-func DeclareSector Type: FLASH  Start: 0x00028000   Length: 0x00008000   Control: 0xffe88000   Core: 0x01   Sector: 0x01
DO ~~~~/tms470-func DeclareSector Type: FLASH  Start: 0x00030000   Length: 0x00008000   Control: 0xffe88000   Core: 0x01   Sector: 0x02
DO ~~~~/tms470-func DeclareSector Type: FLASH  Start: 0x00038000   Length: 0x00008000   Control: 0xffe88000   Core: 0x01   Sector: 0x03
DO ~~~~/tms470-func DeclareSector Type: FLASH  Start: 0x00040000   Length: 0x00008000   Control: 0xffe88000   Core: 0x02   Sector: 0x00
DO ~~~~/tms470-func DeclareSector Type: FLASH  Start: 0x00048000   Length: 0x00008000   Control: 0xffe88000   Core: 0x02   Sector: 0x01
DO ~~~~/tms470-func DeclareSector Type: FLASH  Start: 0x00050000   Length: 0x00008000   Control: 0xffe88000   Core: 0x02   Sector: 0x02
DO ~~~~/tms470-func DeclareSector Type: FLASH  Start: 0x00058000   Length: 0x00008000   Control: 0xffe88000   Core: 0x02   Sector: 0x03

;;;;;;;;;;;;;;;;;;;;;;;;;;;;;;;;;;;;;;;;;;;;;;;;;;
; End of flash.cfg
;;;;;;;;;;;;;;;;;;;;;;;;;;;;;;;;;;;;;;;;;;;;;;;;;;


; Flash script ends here if called with parameter PREPAREONLY
IF &param_prepareonly
  ENDDO PREPAREDONE

; --------------------------------------------------------------------------------
; Flash programming example

FLASH.List

DIALOG.YESNO "Program flash memory?"
ENTRY &progflash

IF &progflash 
(  
  FLASH.Erase ALL
  FLASH.Program ALL
  Data.LOAD.auto * /Long
  FLASH.Program off
  Data.LOAD.auto * /ComPare
)

ENDDO
