; --------------------------------------------------------------------------------
; @Title: TMS470 internal flash of TMS470MSF241/246
;
; @Description: 
; Script arguments:
;
;   DO tms470msf241 [CPU=<cpu>|<cpu>] [PREPAREONLY]
;
;     CPU=<cpu> selects CPU derivative <cpu>
;     <cpu>     selects CPU derivative <cpu> (obsolete syntax)
;
;     PREPAREONLY only declares flash but does not execute flash programming
;
; Example:
;
;   DO ~~/demo/arm/flash/tms470msf241 CPU=TMS470MSF241 PREPAREONLY
;
; internal flash is mapped to: 0x00000000
; internal RAM is mapped to:   0x08000000
;
; @Author: WRD
; @Copyright: (C) 1989-2014 Lauterbach GmbH, licensed for use with TRACE32(R) only
; --------------------------------------------------------------------------------
; $Rev: 3152 $
; $Id: tms470msf241.cmm 3152 2015-02-06 16:35:19Z kjmal $


LOCAL &parameters
ENTRY %LINE &parameters

LOCAL &cpu &param_prepareonly
&param_prepareonly=(STRing.SCAN(STRing.UPpeR("&parameters"),"PREPAREONLY",0)!=-1)
IF STRing.SCAN(STRing.UPpeR("&parameters"),"TMS470MSF246",0)!=-1
  &cpu="TMS470MSF246"
ELSE
  &cpu="TMS470MSF241"


; --------------------------------------------------------------------------------
; Init script variables

DO ~~~~/tms470-func Init

; --------------------------------------------------------------------------------
; Setup CPU
IF SYStem.MODE()<5
(
  SYStem.RESet
  SYStem.CPU &cpu
  SYStem.Option.BigEndian ON
  SYStem.Up
)

; --------------------------------------------------------------------------------
; Flash configuration and declaration generated out of flash470.cfg file

;;;;;;;;;;;;;;;;;;;;;;;;;;;;;;;;;;;;;;;;;;;;;;;;;;
; Config for TMS470MSF241/246
;;;;;;;;;;;;;;;;;;;;;;;;;;;;;;;;;;;;;;;;;;;;;;;;;;
; actual device ID is 0x00366D05 (Unique id is bits 30-17, revision is bits 7-3)
;;;;;;;;;;;;;;;;;;;;;;;;;;;;;;;;;;;;;;;;;;;;;;;;;;
;Device ID: 0x001B         TMS470MSF241/246
;  ProgVersion: 1.03 ; Library Version
;  ProgRoutines: pf035a_cortexm3.x70 ; Platform library archive
LOCAL &ProgRoutines
&ProgRoutines="pf035a_cortexm3"

;  Frequency: 48 Range: 10.0 - 48.0
;  Minor Revisions: 1
;    0 "TMS470MSF241/246 Rev 0"
;  Ram Config: 0x08000000 0x00004000  ; 16k RAM
LOCAL &RamStart &RamSize
&RamStart=0x08000000 
&RamSize=0x00004000 

;  Initialization: 9
;    0xffffff48: 0x00000000 ; set GHVSRC to OSCIN clock source
;    0xfff87000: 0x04000101 ; enable pipeline mode and set 1 waitstate (1 WS <=56MHz, 2 WS >56MHz)
;    0xffffffd0: 0x01010000 ; Disable peripherals
;    0xffffffd0: 0x01010100 ; Enable peripherals
;    0xffffff74: 0x00000000 ; FMENA off
;    0xffffff00: 0x00000000 ; Disable ECLK Output
;    0xfff87040: 0x000000ff ; force active mode for all banks
;    0xfff87008: 0x000A0005 ; disable flash ECC
;    0xffffffc4: 0x0000000A ; MEMSW='1010' => Flash at 0x00000000, RAM at 0x08000000)

Data.Set 0xffffff48 %Long 0x00000000 ; set GHVSRC to OSCIN clock source
Data.Set 0xfff87000 %Long 0x04000101 ; enable pipeline mode and set 1 waitstate (1 WS <=56MHz, 2 WS >56MHz)
Data.Set 0xffffffd0 %Long 0x01010000 ; Disable peripherals
Data.Set 0xffffffd0 %Long 0x01010100 ; Enable peripherals
Data.Set 0xffffff74 %Long 0x00000000 ; FMENA off
Data.Set 0xffffff00 %Long 0x00000000 ; Disable ECLK Output
Data.Set 0xfff87040 %Long 0x000000ff ; force active mode for all banks
Data.Set 0xfff87008 %Long 0x000A0005 ; disable flash ECC
Data.Set 0xffffffc4 %Long 0x0000000A ; MEMSW='1010' => Flash at 0x00000000, RAM at 0x08000000)

;   PLL Config: 0xffffff70 0x21075F00 0xffbfffff 0xffffff74 0x3FC0023D 0xffffffff ; configure 48 MHz (assuming 16.0 MHz OSCIN)
Data.Set    0xffffff70 %Long 0x21075F00|(Data.Long(SD:0xffffff70)&~0xffbfffff) 
Data.Set    0xffffff74 %Long 0x3FC0023D|(Data.Long(SD:0xffffff74)&~0xffffffff) 
LOCAL &FlashClock_Frequency
&FlashClock_Frequency="48Mhz"      ; Setup flash clock frequency to PLL frequency

;  Engr ID: 0xfff87000 0x00000000
;  Number of Blocks: 18
FLASH.RESet
&FlashType="FLASHECC"

;;;;;;;;;;;;;;;;;;;;;;;;;;;;;;;;;;;;;;;;;;;
; bank 0
;;;;;;;;;;;;;;;;;;;;;;;;;;;;;;;;;;;;;;;;;;;
DO ~~~~/tms470-func DeclareSector Type: FLASH  Start: 0x00000000   Length: 0x00004000   Control: 0xfff87000   Core: 0x00   Sector: 0x00
DO ~~~~/tms470-func DeclareSector Type: FLASH  Start: 0x00004000   Length: 0x00004000   Control: 0xfff87000   Core: 0x00   Sector: 0x01
DO ~~~~/tms470-func DeclareSector Type: FLASH  Start: 0x00008000   Length: 0x00008000   Control: 0xfff87000   Core: 0x00   Sector: 0x02
DO ~~~~/tms470-func DeclareSector Type: FLASH  Start: 0x00010000   Length: 0x00010000   Control: 0xfff87000   Core: 0x00   Sector: 0x03
DO ~~~~/tms470-func DeclareSector Type: FLASH  Start: 0x00020000   Length: 0x00010000   Control: 0xfff87000   Core: 0x00   Sector: 0x04
DO ~~~~/tms470-func DeclareSector Type: FLASH  Start: 0x00030000   Length: 0x00010000   Control: 0xfff87000   Core: 0x00   Sector: 0x05

;;;;;;;;;;;;;;;;;;;;;;;;;;;;;;;;;;;;;;;;;;;
; bank 1
;;;;;;;;;;;;;;;;;;;;;;;;;;;;;;;;;;;;;;;;;;;
DO ~~~~/tms470-func DeclareSector Type: FLASH  Start: 0x00080000   Length: 0x00004000   Control: 0xfff87000   Core: 0x01   Sector: 0x00
DO ~~~~/tms470-func DeclareSector Type: FLASH  Start: 0x00084000   Length: 0x00004000   Control: 0xfff87000   Core: 0x01   Sector: 0x01
DO ~~~~/tms470-func DeclareSector Type: FLASH  Start: 0x00088000   Length: 0x00004000   Control: 0xfff87000   Core: 0x01   Sector: 0x02

;;;;;;;;;;;;;;;;;;;;;;;;;;;;;;;;;;;;;;;;;;;
; ECC
;;;;;;;;;;;;;;;;;;;;;;;;;;;;;;;;;;;;;;;;;;;
DO ~~~~/tms470-func DeclareSector Type: FLASHECC  Start: 0x00400000   Length: 0x00002000   Control: 0xfff87000   Core: 0x00   Sector: 0x00
DO ~~~~/tms470-func DeclareSector Type: FLASHECC  Start: 0x00402000   Length: 0x00002000   Control: 0xfff87000   Core: 0x00   Sector: 0x01
DO ~~~~/tms470-func DeclareSector Type: FLASHECC  Start: 0x00404000   Length: 0x00004000   Control: 0xfff87000   Core: 0x00   Sector: 0x02
DO ~~~~/tms470-func DeclareSector Type: FLASHECC  Start: 0x00408000   Length: 0x00008000   Control: 0xfff87000   Core: 0x00   Sector: 0x03
DO ~~~~/tms470-func DeclareSector Type: FLASHECC  Start: 0x00410000   Length: 0x00008000   Control: 0xfff87000   Core: 0x00   Sector: 0x04
DO ~~~~/tms470-func DeclareSector Type: FLASHECC  Start: 0x00418000   Length: 0x00008000   Control: 0xfff87000   Core: 0x00   Sector: 0x05
DO ~~~~/tms470-func DeclareSector Type: FLASHECC  Start: 0x00440000   Length: 0x00002000   Control: 0xfff87000   Core: 0x01   Sector: 0x00
DO ~~~~/tms470-func DeclareSector Type: FLASHECC  Start: 0x00442000   Length: 0x00002000   Control: 0xfff87000   Core: 0x01   Sector: 0x01
DO ~~~~/tms470-func DeclareSector Type: FLASHECC  Start: 0x00444000   Length: 0x00002000   Control: 0xfff87000   Core: 0x01   Sector: 0x02

DO ~~~~/tms470-func DeclareFlashAlgortihm &ProgRoutines &RamStart &RamSize &FlashClock_Frequency

;;;;;;;;;;;;;;;;;;;;;;;;;;;;;;;;;;;;;;;;;;;;;;;;;;
; End of flash.cfg
;;;;;;;;;;;;;;;;;;;;;;;;;;;;;;;;;;;;;;;;;;;;;;;;;;

; Flash script ends here if called with parameter PREPAREONLY
IF &param_prepareonly
  ENDDO PREPAREDONE
; --------------------------------------------------------------------------------
; Flash programming example

FLASH.List

DIALOG.YESNO "Program flash memory?"
LOCAL &progflash
ENTRY &progflash

IF &progflash 
(  
  FLASH.ReProgram ALL /Erase
  Data.LOAD.auto *
  FLASH.ReProgram off

  ; optional
  ;Data.LOAD.auto * /ComPare
)

ENDDO
