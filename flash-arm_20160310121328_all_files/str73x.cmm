; --------------------------------------------------------------------------------
; @Title: Example Script for programming of ST STR73x internal flash
;
; @Description: 
; List of STR73x derivatives and their configuration:
;
; CPU-Type      FlashBank0   SRAM size 
;                (kByte)      (kByte)
; ------------------------------------
; STR730FZ1        128.         16.
; STR730FZ2        256.         16.
; STR731FV0         64.         16.
; STR731FV1        128.         16.
; STR731FV2        256.         16.
; STR735FZ1        128.         16.
; STR735FZ2        256.         16.
; STR736FV0         64.         16.
; STR736FV1        128.         16.
; STR736FV2        256.         16.
;
; @Author: WRD
; @Copyright: (C) 1989-2014 Lauterbach GmbH, licensed for use with TRACE32(R) only
; @Chip: STR73*
; --------------------------------------------------------------------------------
; $Id: str73x.cmm 2881 2014-07-07 10:35:48Z kjmal $

; --------------------------------------------------------------------------------
; Setup the configuration information out of the table above.
;
; Example for STR730FZ2

&flashbank0=256.

; --------------------------------------------------------------------------------
; CPU setup
IF SYStem.MODE()<5
(
  SYStem.RESet
  SYStem.CPU ARM7TDMI
   
  SYStem.Option RESBREAK OFF 
  SYStem.JtagClock 10MHz

  SYStem.Up
)
      
; --------------------------------------------------------------------------------
; Flash declaration

FLASH.RESet
FLASH.Create 1. 0x00000000++0x01fff TARGET Long 0x00000001  ; Bank 0 Sector 0
FLASH.Create 1. 0x00002000++0x01fff TARGET Long 0x00000002  ; Bank 0 Sector 1
FLASH.Create 1. 0x00004000++0x01fff TARGET Long 0x00000004  ; Bank 0 Sector 2
FLASH.Create 1. 0x00006000++0x01fff TARGET Long 0x00000008  ; Bank 0 Sector 3
FLASH.Create 1. 0x00008000++0x07fff TARGET Long 0x00000010  ; Bank 0 Sector 4
IF &flashbank0>=128.
(
  FLASH.Create 1. 0x00010000++0x0ffff TARGET Long 0x00000020  ; Bank 0 Sector 5
)
IF &flashbank0>=256.
(
  FLASH.Create 1. 0x00020000++0x0ffff TARGET Long 0x00000040  ; Bank 0 Sector 6
  FLASH.Create 1. 0x00030000++0x0ffff TARGET Long 0x00000080  ; Bank 0 Sector 7
)
IF &flashbank0>=512.
(
  FLASH.Create 1. 0x00040000++0x0ffff TARGET Long 0x00000100  ; Bank 0 Sector 8
  FLASH.Create 1. 0x00050000++0x0ffff TARGET Long 0x00000200  ; Bank 0 Sector 9
  FLASH.Create 1. 0x00060000++0x0ffff TARGET Long 0x00000400  ; Bank 0 Sector 10
  FLASH.Create 1. 0x00070000++0x0ffff TARGET Long 0x00000800  ; Bank 0 Sector 11
)

FLASH.TARGET 0xa0000000 0xa0001000 0x1000 ~~/demo/arm/flash/long/st30.bin
  
ENDDO  
