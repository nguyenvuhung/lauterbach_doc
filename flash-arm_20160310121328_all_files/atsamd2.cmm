; --------------------------------------------------------------------------------
; @Title: Example for flash declaration of Atmel ATSAMD20 and ATSAMD21 internal flash
; @Description:
;   Script arguments:
;
;    DO atsamd2 [PREPAREONLY] [CPU=<cpu>]
;
;      PREPAREONLY only declares flash but does not execute flash programming
;
;      CPU=<cpu> selects CPU derivative <cpu>
;
;   Example:
;
;   DO ~~/demo/arm/flash/atsamd2 CPU=ATSAMD21J18A PREPAREONLY
;
;   List of ATSAMD2* derivatives and their configuration:
;
;     CPU-Type        Flash size   Page size    SRAM size
;                        [Byte]      [Byte]       [Byte]
;     ATSAMD20E14        0x4000       0x40         0x800
;     ATSAMD20E15        0x8000       0x40        0x1000
;     ATSAMD20E16       0x10000       0x40        0x2000
;     ATSAMD20E17       0x20000       0x40        0x4000
;     ATSAMD20G14        0x4000       0x40         0x800
;     ATSAMD20G15        0x8000       0x40        0x1000
;     ATSAMD20G16       0x10000       0x40        0x2000
;     ATSAMD20G17       0x20000       0x40        0x4000
;     ATSAMD20G18       0x40000       0x40        0x8000
;     ATSAMD20J14        0x4000       0x40         0x800
;     ATSAMD20J15        0x8000       0x40        0x1000
;     ATSAMD20J16       0x10000       0x40        0x2000
;     ATSAMD20J17       0x20000       0x40        0x4000
;     ATSAMD20J18       0x40000       0x40        0x8000
;     ATSAMD21E15A       0x8000       0x40        0x1000
;     ATSAMD21E16A      0x10000       0x40        0x2000
;     ATSAMD21E17A      0x20000       0x40        0x4000
;     ATSAMD21E18A      0x40000       0x40        0x8000
;     ATSAMD21G15A       0x8000       0x40        0x1000
;     ATSAMD21G16A      0x10000       0x40        0x2000
;     ATSAMD21G17A      0x20000       0x40        0x4000
;     ATSAMD21G18A      0x40000       0x40        0x8000
;     ATSAMD21J15A       0x8000       0x40        0x1000
;     ATSAMD21J16A      0x10000       0x40        0x2000
;     ATSAMD21J17A      0x20000       0x40        0x4000
;     ATSAMD21J18A      0x40000       0x40        0x8000
;
; @Author: FLC
; @Chip: ATSAMD2*
; @Copyright: (C) 1989-2014 Lauterbach GmbH, licensed for use with TRACE32(R) only
; --------------------------------------------------------------------------------
; $Rev: 3131 $
; $Id: atsamd2.cmm 3131 2015-01-23 11:21:46Z fcaron $


  LOCAL &parameters
  ENTRY %LINE &parameters

  LOCAL &param_prepareonly &param_cpu
  &param_prepareonly=(STRing.SCAN(STRing.UPpeR("&parameters"),"PREPAREONLY",0)!=-1)
  &param_cpu=STRing.SCANAndExtract(STRing.UPpeR("&parameters"),"CPU=","")

  IF VERSION.BUILD.BASE()<55857.
  (
    PRINT %ERROR "TRACE32 software version is too old, please request an update."
    ENDDO
  )
  
  ; ------------------------------------------------------------------------------
  ; Setup CPU

  IF SYStem.MODE()<5
  (
    SYStem.RESet

    IF "&param_cpu"!=""
      SYStem.CPU &param_cpu
    IF !CPUIS(ATSAMD2*)
      SYStem.CPU ATSAMD2*
    SYStem.CONFIG.DEBUGPORTTYPE SWD
    SYStem.Option.ResBreak OFF
    SYStem.Up
  )

  ; ------------------------------------------------------------------------------
  ; Flash declaration

  FLASH.RESet
  GOSUB FlashDeclaration

  ; Flash script ends here if called with parameter PREPAREONLY
  IF &param_prepareonly
    ENDDO PREPAREDONE

 ; -------------------------------------------------------------------------------
  ; Flash programming example

  DIALOG.YESNO "Program flash memory?"
  LOCAL &progflash
  ENTRY &progflash
  IF &progflash 
  (
    FLASH.ReProgram.ALL
    Data.LOAD.auto *
    FLASH.ReProgram.off
    
    ; Reset device
    SYStem.Down
    SYStem.Up
  )

  ENDDO


; --------------------------------------------------------------------------------
; Flash declaration depending on selected CPU 

FlashDeclaration:
  LOCAL &FlashSize &FlashDriver

  IF CPUIS("ATSAMD2??14*")
  (
    &FlashSize=0x4000
    &FlashDriver="atsamd2.bin"
  )
  ELSE IF CPUIS("ATSAMD2??15*")
  (
    &FlashSize=0x8000
    &FlashDriver="atsamd2.bin"
  )
  ELSE IF CPUIS("ATSAMD2??16*")
  (
    &FlashSize=0x10000
    &FlashDriver="atsamd2.bin"
  )
  ELSE IF CPUIS("ATSAMD2??17*")
  (
    &FlashSize=0x20000
    &FlashDriver="atsamd2.bin"
  )
  ELSE IF CPUIS("ATSAMD2??18*")
  (
      &FlashSize=0x40000
      &FlashDriver="atsamd2.bin"
  )
  ELSE
  (
    PRINT %ERROR "FLASH size of CPU type is unknown"
    ENDDO
  )

  IF &FlashSize>=0x4000
    FLASH.Create  1. 0x00000000--0x00003FFF 0x100 TARGET Long
  IF &FlashSize>=0x8000
    FLASH.Create  1. 0x00004000--0x00007FFF 0x100 TARGET Long
  IF &FlashSize>=0x10000
    FLASH.Create  1. 0x00008000--0x0000FFFF 0x100 TARGET Long
  IF &FlashSize>=0x20000
    FLASH.Create  1. 0x00010000--0x0001FFFF 0x100 TARGET Long
  IF &FlashSize>=0x40000
    FLASH.Create  1. 0x00020000--0x0003FFFF 0x100 TARGET Long

  FLASH.TARGET 0x20000000 0x20000400 0x400 ~~/demo/arm/flash/long/&FlashDriver
  
  RETURN
