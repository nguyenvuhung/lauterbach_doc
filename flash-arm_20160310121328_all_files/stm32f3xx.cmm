; --------------------------------------------------------------------------------
; @Title: Example Script for programming of ST STM32F3xx internal flash
;
; @Description: 
; Script arguments:
;
;  DO stm32f3xx [PREPAREONLY] [CPU=<cpu>]
;
;   PREPAREONLY only declares flash but does not execute flash programming example
;
;   CPU=<cpu> selects CPU derivative <cpu>
;
; Example:
;
;   DO ~~/demo/arm/flash/stm32f3xx CPU=STM32F303VC PREPAREONLY
;
; List of STM32F3xx derivatives and their configuration:
;
;   CPU-Type      Flash size   RAM size
;                   [kByte]     [kByte]
; --------------------------------------------------------------------------------
;   STM32F301C6        32.         16.
;   STM32F301C8        64.         16.
;   STM32F301K6        32.         16.
;   STM32F301K8        64.         16.
;   STM32F301R6        32.         16.
;   STM32F301R8        64.         16.
; --------------------------------------------------------------------------------
;   STM32F302C6        32.         16.
;   STM32F302C8        64.         16.
;   STM32F302K6        32.         16.
;   STM32F302K8        64.         16.
;   STM32F302R6        32.         16.
;   STM32F302R8        64.         16.
;   STM32F302CB       128.         24.
;   STM32F302CC       256.         32.
;   STM32F302RB       128.         24.
;   STM32F302RC       256.         32.
;   STM32F302VB       128.         24.
;   STM32F302VC       256.         32.
; --------------------------------------------------------------------------------
;   STM32F303C6        32.         16.
;   STM32F303C8        64.         16.
;   STM32F303K6        32.         16.
;   STM32F303K8        64.         16
;   STM32F303R6        32.         16.
;   STM32F303R8        64.         16.
;   STM32F303CB       128.         32.
;   STM32F303CC       256.         40.
;   STM32F303RB       128.         32.
;   STM32F303RC       256.         40.
;   STM32F303VB       128.         32.
;   STM32F303VC       256.         40.
; --------------------------------------------------------------------------------
;   STM32F313CC       256.         40.
;   STM32F313RC       256.         40.
;   STM32F313VC       256.         40.
; --------------------------------------------------------------------------------
;   STM32F318C8        64.         16.
;   STM32F318K8        64.         16.
; --------------------------------------------------------------------------------
;   STM32F328C8        64.         16.
; --------------------------------------------------------------------------------
;   STM32F334C4        16.         16.
;   STM32F334C6        32.         10.
;   STM32F334C8        64.         16.
;   STM32F334K4        16.         16.
;   STM32F334K6        32.         10.
;   STM32F334K8        64.         16.
;   STM32F334R6        32.         10.
;   STM32F334R8        64.         16.
; --------------------------------------------------------------------------------
;   STM32F358CC       256.         48.
;   STM32F358RC       256.         48.
;   STM32F358VC       256.         48.
; --------------------------------------------------------------------------------
;   STM32F372C8        64.         16.
;   STM32F372CB       128.         24.
;   STM32F372CC       256.         32.
;   STM32F372R8        64.         16.
;   STM32F372RB       128.         24.
;   STM32F372RC       256.         32.
;   STM32F372V8        64.         16.
;   STM32F372VB       128.         24.
;   STM32F372VC       256.         32.
; --------------------------------------------------------------------------------
;   STM32F373C8        64.         16.
;   STM32F373CB       128.         24.
;   STM32F373CC       256.         32.
;   STM32F373R8        64.         16.
;   STM32F373RB       128.         24.
;   STM32F373RC       256.         32.
;   STM32F373V8        64.         16.
;   STM32F373VB       128.         24.
;   STM32F373VC       256.         32.
; --------------------------------------------------------------------------------
;   STM32F378CC       256.         32.
;   STM32F378RC       256.         32.
;   STM32F378VC       256.         32.
; --------------------------------------------------------------------------------
;   STM32F383CC       256.         32.
;   STM32F383RC       256.         32.
;   STM32F383VC       256.         32.
;
; Flash base address is       0x08000000
; SRAM base address is        0x20000000
; System memory is located at 0x1FFFD800--0x1FFFF7FF
; Option bytes are located at 0x1FFFF800--0x1FFFF80F
;
; Depending on the boot mode main flash memory, system memory or embedded SRAM
; is mirrored to address 0x00000000. Boot modes are defined by nBOOT1 and
; BOOT0 pins after reset or when exiting standby mode:
;
;   nBOOT1 BOOT0   Boot mode
; --------------------------------------------------------------------------------
;      x     0     Main Flash memory
;      1     1     System memory
;      0     1     Embedded SRAM
;
; 
; @Author: WRD
; @Copyright: (C) 1989-2014 Lauterbach GmbH, licensed for use with TRACE32(R) only
; @Chip: STM32F3* 
; --------------------------------------------------------------------------------
; $Rev: 3535 $
; $Id: stm32f3xx.cmm 3535 2015-12-15 16:27:01Z fcaron $

  LOCAL &parameters
  ENTRY %LINE &parameters

  LOCAL &param_prepareonly
  &param_prepareonly=(STRing.SCAN(STRing.UPpeR("&parameters"),"PREPAREONLY",0)!=-1)

  LOCAL &param_cpu
  &param_cpu=STRing.SCANAndExtract(STRing.UPpeR("&parameters"),"CPU=","")

  ; ------------------------------------------------------------------------------
  ; CPU setup

  IF SYStem.MODE()<5
  (
    SYStem.RESet
    IF "&param_cpu"!=""
      SYStem.CPU &param_cpu
    IF !CPUIS(STM32F3*)
      SYStem.CPU STM32F3*
    SYStem.Up
  )

  ; ------------------------------------------------------------------------------
  ; Flash declaration

  FLASH.RESet
  GOSUB FlashDeclaration
  
  ; Flash script ends here if called with parameter PREPAREONLY
  IF &param_prepareonly
    ENDDO PREPAREDONE

  ; ------------------------------------------------------------------------------
  ; Flash programming example

  DIALOG.YESNO "Program flash memory?"
  LOCAL &progflash
  ENTRY &progflash

  IF &progflash 
  (
    FLASH.ReProgram ALL /Erase
    Data.LOAD.auto *
    FLASH.ReProgram off

    ; Reset device
    SYStem.Down
    SYStem.Up
  )

  ENDDO


; --------------------------------------------------------------------------------
; Flash declaration depending on selected CPU 

FlashDeclaration:
  LOCAL &FlashSize &FlashDriver
  
  IF CPUIS("STM32F3???4")
    &FlashSize=0x4000
  ELSE IF CPUIS("STM32F3???6")
    &FlashSize=0x8000
  ELSE IF CPUIS("STM32F3???8")
    &FlashSize=0x10000
  ELSE IF CPUIS("STM32F3???B")
    &FlashSize=0x20000
  ELSE IF CPUIS("STM32F3???C")
    &FlashSize=0x40000
  ELSE
  (
    PRINT %ERROR "FLASH size of CPU type is unknown"
    ENDDO
  )

  IF CPUIS("STM32F30???")||CPUIS("STM32F31???")||CPUIS("STM32F32???")||CPUIS("STM32F33???")||CPUIS("STM32F35???")
    &FlashDriver="stm32f300.bin"
  ELSE IF CPUIS("STM32F37???")||CPUIS("STM32F38???")
    &FlashDriver="stm32f370.bin"
  ELSE
  (
    PRINT %ERROR "FLASH driver is not defined for CPU type"
    ENDDO
  )
  
  IF &FlashSize>=0x4000
  (
    FLASH.Create 1. 0x08000000--0x08003FFF 0x800 TARGET Word
  )
  IF &FlashSize>=0x8000
  (
    FLASH.Create 1. 0x08004000--0x08007FFF 0x800 TARGET Word
  )
  IF &FlashSize>=0x10000
  (
    FLASH.Create 1. 0x08008000--0x0800FFFF 0x800 TARGET Word
  )
  IF &FlashSize>=0x20000
  (
    FLASH.Create 1. 0x08010000--0x0801FFFF 0x800 TARGET Word
  )
  IF &FlashSize>=0x40000
  (
    FLASH.Create 1. 0x08020000--0x0803FFFF 0x800 TARGET Word
  )

  ; For Main Flash memory boot mode flash memory is aliased to address 0x0
  ; Because SYSCFG_CFGR1:MEM_MODE[1:0] is not indicating active memory remap
  ; we are comparing flash reset vector against reset vector at alias address
  Data.ComPare 0x0--0x7 0x08000000
  IF !FOUND()
    FLASH.CreateALIAS 0x00000000--0x0003FFFF 0x08000000

  FLASH.TARGET 0x20000000 0x20001000 0x800 ~~/demo/arm/flash/word/&FlashDriver

  RETURN
