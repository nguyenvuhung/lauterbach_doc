; --------------------------------------------------------------------------------
; @Title: Generic script for Freescale MK70 internal flash
;
; @Description:
;
; Example for flash declaration of Freescale MK70 internal flash.
;
; Script arguments:
;
;   DO mk70 [PREPAREONLY] [CPU=<cpu>] [DUALPORT=0|1] [MASSERASE]
;
;     PREPAREONLY only declares flash but does not execute flash programming
;     example
;
;     CPU=<cpu> selects CPU derivative <cpu>
;
;     DUALPORT default value is 0 (disabled). If DualPort mode is enabled
;             flash algorithm stays running until flash programming is
;             finished. Data is tranferred via dual port memory access. 
;
;     MASSERASE forces mass erase of device before establishing debug connection
;
; Example:
;
;   DO ~~/demo/arm/flash/mk70 CPU=MK70FN1M0VMF12 DUALPORT=1 PREPAREONLY
;
; List of MK70 derivatives and their configuration:
;
;   CPU-Type       Flash   ProgFlash   FlexNVM   EEPROM   RamSize
;                   type     [Byte]     [Byte]    [Byte]   [Byte]
; --------------------------------------------------------------------------------
;   MK70FX512VMF12   3X      512KB      512KB      16KB    128KB
;   MK70FX512VMF15   3X      512KB      512KB      16KB    128KB
;   MK70FX512VMJ12   3X      512KB      512KB      16KB    128KB
;   MK70FX512VMJ15   3X      512KB      512KB      16KB    128KB
;   MK70FN1M0VMF12   3N        1MB          -         -    128KB
;   MK70FN1M0VMF15   3N        1MB          -         -    128KB
;   MK70FN1M0VMJ12   3N        1MB          -         -    128KB
;   MK70FN1M0VMJ15   3N        1MB          -         -    128KB
;
; Flash Configuration Field:
;
;   Byte address    Width   Description
; --------------------------------------------------------------------------------
;   0x0400--0x0407    8    Backdoor Comparison Key.
;   0x0408--0x040B    4    Program flash protection bytes (FPROT0-3).
;   0x040F            1    Program flash only devices: Reserved
;                          FlexNVM devices: Data flash protection byte
;                          (FDPROT).
;   0x040E            1    Program flash only devices: Reserved
;                          FlexNVM devices: EEPROM protection byte
;                          (FEPROT).
;   0x040D            1    Flash nonvolatile option byte (FOPT).
;   0x040C            1    Flash security byte (FSEC).
;
;   Flash Configuration Field can be programmed using FLASH.AUTO command 
;   with /CENSORSHIP option.
;
; @Chip: MK70*
; @Author: WRD
; @Copyright: (C) 1989-2014 Lauterbach GmbH, licensed for use with TRACE32(R) only#
; --------------------------------------------------------------------------------
; $Rev: 2903 $
; $Id: mk70.cmm 2903 2014-07-16 11:19:46Z kjmal $
;

  LOCAL &parameters
  ENTRY %LINE &parameters

  LOCAL &param_prepareonly &param_masserase
  &param_prepareonly=(STRing.SCAN(STRing.UPpeR("&parameters"),"PREPAREONLY",0)!=-1)
  &param_masserase=(STRing.SCAN(STRing.UPpeR("&parameters"),"MASSERASE",0)!=-1)

  LOCAL &param_cpu
  &param_cpu=STRing.SCANAndExtract(STRing.UPpeR("&parameters"),"CPU=","")
  IF "&param_cpu"==""
  (
    &param_cpu=STRing.SCANAndExtract(STRing.UPpeR("&parameters"),"MK70","")
    IF "&param_cpu"!=""
      &param_cpu="MK70"+"&param_cpu"
    ELSE
    (
      &param_cpu=STRing.SCANAndExtract(STRing.UPpeR("&parameters"),"K70","")
      IF "&param_cpu"!=""
        &param_cpu="K70"+"&param_cpu"
    )
  )

  LOCAL &param_dualport
  &param_dualport=0
  IF VERSION.BUILD.BASE()>=43441.
    &param_dualport=STRing.SCANAndExtract(STRing.UPpeR("&parameters"),"DUALPORT=","0")

  ; ------------------------------------------------------------------------------
  ; Start debugging

  IF (SYStem.MODE()<5)||&param_masserase
  (
    SYStem.RESet

    IF "&param_cpu"!=""
      SYStem.CPU &param_cpu
    IF !CPUIS(MK70*)&&!CPUIS(K70*)
      SYStem.CPU MK70*

    IF CABLE.TWOWIRE()
      SYStem.CONFIG.DEBUGPORTTYPE SWD
    ELSE
      SYStem.CONFIG.DEBUGPORTTYPE JTAG

    IF &param_masserase
      GOSUB MassErase

    ON.ERROR GOSUB Unsecure
    SYStem.Up
    ON.ERROR
  )

  ; Unsecure device
  IF VERSION.BUILD()>=34133.
  (
    IF (Data.Long(EDBG:0x40000100)&0x04)==0x04
      GOSUB Unsecure
  )

  ; Disable watchdog
  ON.ERROR GOSUB Unsecure
  GOSUB DisableWatchdog
  ON.ERROR

  ; ------------------------------------------------------------------------------
  ; Flash declaration

  FLASH.RESet
  GOSUB FlashDeclaration &param_dualport

  ; Flash script ends here if called with parameter PREPAREONLY
  IF &param_prepareonly
    ENDDO PREPAREDONE

  ; ------------------------------------------------------------------------------
  ; Flash programming example

  DIALOG.YESNO "Program flash memory?"
  LOCAL &progflash
  ENTRY &progflash
  IF &progflash 
  (
    FLASH.ReProgram.ALL /Erase
    Data.LOAD.auto *
    FLASH.ReProgram.off

    ; Reset device
    SYStem.Down
    SYStem.Up

    ; Disable watchdog
    GOSUB DisableWatchdog
  )

  ENDDO


; --------------------------------------------------------------------------------
; Disable watchdog

DisableWatchdog:
  LOCAL &tmp1 &tmp2
  &tmp1=Data.Long(ST:0x20000000)
  &tmp2=Data.Long(ST:0x20000004)

  ; The watchdog has a restrictive timing. It has to be configured and unlocked within a peripod
  ; of 20+256 cycles. Therefor the unlock sequence need to be done by a small target program.
  Data.Assemble ST:0x20000000  strh r1,[r0]  ;SD:0x4005200E = 0xC520   (Key 1)
  Data.Assemble ,              strh r2,[r0]  ;SD:0x4005200E = 0xD928   (Key 2)
  Data.Assemble ,              strh r4,[r3]  ;SD:0x40052000 = 0x0000   (Config register)
  Data.Assemble ,              bkpt #0
  Register.Set PC 0x20000000
  Register.Set R0 0x4005200E
  Register.Set R1 0xC520
  Register.Set R2 0xD928
  Register.Set R3 0x40052000
  Register.Set R4 0x0
  Go.direct
  WAIT !RUN()

  Data.Set ST:0x20000000 %Long &tmp1
  Data.Set ST:0x20000004 %Long &tmp2

  RETURN


; --------------------------------------------------------------------------------
; Try to unsecure a secured device

Unsecure:
  IF VERSION.BUILD()<48722.
    DO ~~~~/kinetis-unsecure
  ELSE
  (
    ; Print security state information
    SYStem.Mode.Prepare
    PRINT "MDM-AP Status Register is 0x" Data.Long(EDBG:0x40000100)

    DIALOG.YESNO "Execute mass erase to unsecure chip?"
    LOCAL &masserase
    ENTRY &masserase
    IF &masserase
    (
      ON.ERROR DEFault

      ; Unsecure device
      SYStem.Down
      FLASH.UNSECUREerase
      SYStem.Mode.Prepare
      IF (Data.Long(EDBG:0x40000100)&0x04)==0x04
      (
        PRINT %ERROR "Unsecure failed, MDM-AP Status Register is 0x" Data.Long(EDBG:0x40000100)
        SYStem.Down
        ENDDO
      )
    )
    ELSE
      ENDDO
  )

  SYStem.Up

  ; Disable watchdog
  GOSUB DisableWatchdog

  RETURN


; --------------------------------------------------------------------------------
; Try to mass erase the device

MassErase:
  IF VERSION.BUILD.BASE()<49714.
    DO ~~~~/kinetis-unsecure
  ELSE
  (
    ; Mass erase device by unsecure command
    SYStem.Down
    FLASH.UNSECUREerase
    SYStem.Mode.Prepare
    IF (Data.Long(EDBG:0x40000100)&0x24)!=0x20
    (
      PRINT %ERROR "Mass erase failed, MDM-AP Status Register is 0x" Data.Long(EDBG:0x40000100)
      SYStem.Down
      ENDDO
    )
  )

  RETURN


; --------------------------------------------------------------------------------
; Flash declaration depending on selected CPU 

FlashDeclaration:
  LOCAL &DualPort
  ENTRY &DualPort

  LOCAL &PFlashSize
  LOCAL &FlexNVMSize
  ;LOCAL &EEPROMSize

  ; Setup configuration values
  IF CPUIS("MK70FX512*")||CPUIS("K70FX512*")
  (
    &PFlashSize=0x80000
    &FlexNVMSize=0x80000
    ;&EEPROMSize=0x4000
  )
  ELSE IF CPUIS("MK70FN1M0*")||CPUIS("K70FN1M0*")
  (
    &PFlashSize=0x100000
    &FlexNVMSize=0x0
    ;&EEPROMSize=0x0
  )
  ELSE
  (
    PRINT %ERROR "FLASH size of CPU type is not supported by the script"
    ENDDO
  )

  ; Program Flash
  IF &PFlashSize>=0x80000
  (
    FLASH.Create 1. 0x00000000--0x0003FFFF 0x1000 TARGET Quad
    FLASH.Create 2. 0x00040000--0x0007FFFF 0x1000 TARGET Quad
  )
  IF &PFlashSize>=0x100000
  (
    FLASH.Create 3. 0x00080000--0x000BFFFF 0x1000 TARGET Quad
    FLASH.Create 4. 0x000C0000--0x000FFFFF 0x1000 TARGET Quad
  )

  ; FlexNVM
  IF &FlexNVMSize>=0x80000
  (
    FLASH.Create 3. 0x10000000--0x1003FFFF 0x1000 TARGET Quad
    FLASH.Create 4. 0x10040000--0x1007FFFF 0x1000 TARGET Quad
  )

  ; EEPROM
  ; preliminary not supported
  ;IF &EEPROMSize>=0x4000
  ;  FLASH.Create 5. 0x1400000--0x14003FFF "t.b.d." TARGET Quad

  LOCAL &access &option
  IF &DualPort==0
    &access="D"
  ELSE
  (
    &access="EAHB"
    &option="/DualPort"
  )

  IF &FlexNVMSize>0x0
    FLASH.TARGET 0x1FFFF000 &access:0x20000000 0x1000 ~~/demo/arm/flash/quad/ftfe3x.bin &option
  ELSE
    FLASH.TARGET 0x1FFFF000 &access:0x20000000 0x1000 ~~/demo/arm/flash/quad/ftfe3n.bin &option

  RETURN
