; --------------------------------------------------------------------------------
; @Title: TMS470 internal flash of TMS470AVF688A
;
; @Description:
; Script arguments:
;
;   DO tms470r1vf688a [PREPAREONLY] 
;
;     PREPAREONLY only declares flash but does not execute flash programming
;
; Example:
;
;   DO ~~/demo/arm/flash/tms470r1vf688a PREPAREONLY
;
; @Author: WRD
; @Copyright: (C) 1989-2014 Lauterbach GmbH, licensed for use with TRACE32(R) only
; --------------------------------------------------------------------------------
; $Rev: 3152 $
; $Id: tms470avf688a.cmm 3152 2015-02-06 16:35:19Z kjmal $

LOCAL &parameters
ENTRY %LINE &parameters

DO ~~~~/tms470r1vf688 TMS470AVF688A &parameters

ENDDO
