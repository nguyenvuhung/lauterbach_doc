; --------------------------------------------------------------------------------
; @Title: TMS470 internal flash of TMS470R1VF346A
;
; @Description: 
; Script arguments:
;
;   DO tms470r1vf346a [PREPAREONLY] 
;
;     PREPAREONLY only declares flash but does not execute flash programming
;
; Example:
;
;   DO ~~/demo/arm/flash/tms470r1vf346a PREPAREONLY
;
; @Author: WRD
; @Copyright: (C) 1989-2014 Lauterbach GmbH, licensed for use with TRACE32(R) only
; @Chip: TMS470R1VF346A  
; --------------------------------------------------------------------------------
; $Rev: 2881 $
; $Id: tms470r1vf346a.cmm 2881 2014-07-07 10:35:48Z kjmal $

LOCAL &parameters
ENTRY %LINE &parameters

DO ~~~~/tms470r1vf336a TMS470R1VF346A &parameters

ENDDO
