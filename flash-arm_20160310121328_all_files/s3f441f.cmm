; --------------------------------------------------------------------------------
; @Title: Example for flash declaration of Samsung S3F441FX internal flash 
;
; @Description:
; 256 kBytes internal Flash organized in 512 sectors, 512 Byte each.
; Flash start address is 0x0 or 0x1f00000. Select your setting with
; LOCAL variable flashbase as required.
;
; S3F441FX has 8 kByte internal RAM from 0x1ff000--0x1ff1fff.
;
; @Author: WRD
; @Copyright: (C) 1989-2014 Lauterbach GmbH, licensed for use with TRACE32(R) only
; @Chip: S3F441FX
; --------------------------------------------------------------------------------
; $Rev: 2881 $
; $Id: s3f441f.cmm 2881 2014-07-07 10:35:48Z kjmal $

  LOCAL &flashbase

  &flashbase=0x0
  ; &flashbase=0x1f00000

  FLASH.RESet
  FLASH.TARGET 0x1ff0000 0x1ff0800 0x1000 ~~/demo/arm/flash/long/s3f441fx.bin
  FLASH.Create 1. &flashbase++0x3ffff 0x200 TARGET Long

  ENDDO
