; --------------------------------------------------------------------------------
; @Title: TMS570PSFC61 internal flash setup
;
; @Description:
; Script arguments:
;
;   DO tms570psfc61 [PREPAREONLY]
;
;     PREPAREONLY only declares flash but does not execute flash programming
;
; Example:
;
;   DO ~~/demo/arm/flash/tms570psfc61 PREPAREONLY
;
; @Author: WRD
; @Copyright: (C) 1989-2014 Lauterbach GmbH, licensed for use with TRACE32(R) only
; @Chip: TMS570PSFC61 
; --------------------------------------------------------------------------------
; $Rev: 2881 $
; $Id: tms570psfc61.cmm 2881 2014-07-07 10:35:48Z kjmal $
;
LOCAL &parameters &param_prepareonly
ENTRY %LINE &parameters
&param_prepareonly=(STRing.SCAN(STRing.UPpeR("&parameters"),"PREPAREONLY",0)!=-1)  
; --------------------------------------------------------------------------------
; Init script variables

DO ~~~~/tms470-func Init

; --------------------------------------------------------------------------------
; Setup CPU
IF SYStem.MODE()<5
(
  SYStem.RESet
  SYStem.CPU TMS570PSFC61
  SYStem.Up
  IF VERSION.BUILD()<15283.
  (
    SYStem.Up  ; preliminary work around for endianess problem
  )
  ELSE IF VERSION.BUILD.BASE()<15283.
  (
    SYStem.Up  ; preliminary work around for endianess problem
  )
)

; --------------------------------------------------------------------------------
;;;;;;;;;;;;;;;;;;;;;;;;;;;;;;;;;;;;;;;;;;;;;;;;;;
; Config for TMS570PSFC61 REV 0 (Mira)
;;;;;;;;;;;;;;;;;;;;;;;;;;;;;;;;;;;;;;;;;;;;;;;;;;
; actual device ID is 0x80126B05
;;;;;;;;;;;;;;;;;;;;;;;;;;;;;;;;;;;;;;;;;;;;;;;;;;
;Device ID: 0x0009         TMS570PSFC61 Rev0 (Mira)
;  ProgVersion: 0.07 ; Library Version
;  ProgRoutines: pf035a.lib ; Platform library archive
&ProgRoutines="pf035a"

;  Frequency: 160.0 Range: 10.0 - 160.0
;  Minor Revisions: 1
;    0 "TMS570PSFC61 Rev 0"
;  Ram Config: 0x08000000 0x0000C000 ; 48KB
LOCAL &RamStart &RamSize
&RamStart=0x08000000 
&RamSize=0x0000C000 

;  Initialization: 10
Data.Set    0xfffff538 %Long 0x00000005 ; reset ESM
Data.Set    0xffffffd0 %Long 0x01010000 ; Disable peripherals
Data.Set    0xffffffd0 %Long 0x01010100 ; Enable peripherals
Data.Set    0xfffffa00 %Long 0x00070085 ; disable RTP
Data.Set    0xfffff700 %Long 0x00010005 ; disable DMM
Data.Set    0xffffffc0 %Long 0x00000000 ; Set RAM wait states to 0
Data.Set    0xfff87000 %Long 0x00000401 ; enable pipeline mode and RWAIT=4
Data.Set    0xfff87008 %Long 0x00000005 ; disable flash parity
Data.Set    0xfff87040 %Long 0x0000ffff ; force active mode for all banks
Data.Set    0xffffffc4 %Long 0x0000000a ; MEMSW='1010' => Flash at 0x00000000, RAM at 0x08000000)

; PLL setup out of flash470.cfg:
;  PLL Config: 0xffffff70 0x20037700 0xffbfffff 0xffffff74 0x7FC07400 0xffffffff ; configure 160Mhz (assuming 16.0 Mhz OSCIN)
;Data.Set    0xffffff70 %Long 0x20037700|(Data.Long(SD:0xffffff70)&~0xffbfffff) 
;Data.Set    0xffffff74 %Long 0x7FC07400|(Data.Long(SD:0xffffff74)&~0xffffffff) 
;&FlashClock_Frequency="160MHz"

; Alternative PLL setup for 160 MHz
; configure 160Mhz (assuming 16.0 Mhz OSCIN)
Data.Set    0xffffff70 %Long 0x41839f00
Data.Set    0xffffff74 %Long 0x15111201
&FlashClock_Frequency="160MHz"

; Alternative PLL setup for 100 MHz
; configure 100Mhz (assuming 16.0 Mhz OSCIN)
;Data.Set    0xffffff70 %Long 0x40875B00 
;Data.Set    0xffffff74 %Long 0x2A59E201
;&FlashClock_Frequency="100MHz"

;  Engr ID: 0xfff87000 0x00604000
;  Number of Blocks: 52
FLASH.RESet
&FlashType="FLASHPAR"
DO ~~~~/tms470-func DeclareSector Type: FLASH     Start: 0x00000000  Length: 0x00008000  Control: 0xfff87000  Core: 0x00  Sector: 0x00
DO ~~~~/tms470-func DeclareSector Type: FLASH     Start: 0x00008000  Length: 0x00008000  Control: 0xfff87000  Core: 0x00  Sector: 0x01
DO ~~~~/tms470-func DeclareSector Type: FLASH     Start: 0x00010000  Length: 0x00008000  Control: 0xfff87000  Core: 0x00  Sector: 0x02
DO ~~~~/tms470-func DeclareSector Type: FLASH     Start: 0x00018000  Length: 0x00002000  Control: 0xfff87000  Core: 0x00  Sector: 0x03
DO ~~~~/tms470-func DeclareSector Type: FLASH     Start: 0x0001A000  Length: 0x00002000  Control: 0xfff87000  Core: 0x00  Sector: 0x04
DO ~~~~/tms470-func DeclareSector Type: FLASH     Start: 0x0001C000  Length: 0x00004000  Control: 0xfff87000  Core: 0x00  Sector: 0x05
DO ~~~~/tms470-func DeclareSector Type: FLASH     Start: 0x00020000  Length: 0x00010000  Control: 0xfff87000  Core: 0x00  Sector: 0x06
DO ~~~~/tms470-func DeclareSector Type: FLASH     Start: 0x00030000  Length: 0x00010000  Control: 0xfff87000  Core: 0x00  Sector: 0x07
DO ~~~~/tms470-func DeclareSector Type: FLASH     Start: 0x00040000  Length: 0x00020000  Control: 0xfff87000  Core: 0x00  Sector: 0x08
DO ~~~~/tms470-func DeclareSector Type: FLASH     Start: 0x00060000  Length: 0x00020000  Control: 0xfff87000  Core: 0x00  Sector: 0x09
DO ~~~~/tms470-func DeclareSector Type: FLASH     Start: 0x00080000  Length: 0x00020000  Control: 0xfff87000  Core: 0x01  Sector: 0x00
DO ~~~~/tms470-func DeclareSector Type: FLASH     Start: 0x000A0000  Length: 0x00020000  Control: 0xfff87000  Core: 0x01  Sector: 0x01
DO ~~~~/tms470-func DeclareSector Type: FLASH     Start: 0x000C0000  Length: 0x00020000  Control: 0xfff87000  Core: 0x01  Sector: 0x02
DO ~~~~/tms470-func DeclareSector Type: FLASH     Start: 0x000E0000  Length: 0x00020000  Control: 0xfff87000  Core: 0x01  Sector: 0x03
DO ~~~~/tms470-func DeclareSector Type: FLASH     Start: 0x00100000  Length: 0x00020000  Control: 0xfff87000  Core: 0x02  Sector: 0x00
DO ~~~~/tms470-func DeclareSector Type: FLASH     Start: 0x00120000  Length: 0x00020000  Control: 0xfff87000  Core: 0x02  Sector: 0x01
DO ~~~~/tms470-func DeclareSector Type: FLASH     Start: 0x00140000  Length: 0x00020000  Control: 0xfff87000  Core: 0x02  Sector: 0x02
DO ~~~~/tms470-func DeclareSector Type: FLASH     Start: 0x00160000  Length: 0x00020000  Control: 0xfff87000  Core: 0x02  Sector: 0x03
DO ~~~~/tms470-func DeclareSector Type: FLASH     Start: 0x00180000  Length: 0x00020000  Control: 0xfff87000  Core: 0x03  Sector: 0x00
DO ~~~~/tms470-func DeclareSector Type: FLASH     Start: 0x001A0000  Length: 0x00020000  Control: 0xfff87000  Core: 0x03  Sector: 0x01
DO ~~~~/tms470-func DeclareSector Type: FLASH     Start: 0x001C0000  Length: 0x00020000  Control: 0xfff87000  Core: 0x03  Sector: 0x02
DO ~~~~/tms470-func DeclareSector Type: FLASH     Start: 0x001E0000  Length: 0x00020000  Control: 0xfff87000  Core: 0x03  Sector: 0x03
DO ~~~~/tms470-func DeclareSector Type: FLASHPAR  Start: 0x00400000  Length: 0x00004000  Control: 0xfff87000  Core: 0x00  Sector: 0x00
DO ~~~~/tms470-func DeclareSector Type: FLASHPAR  Start: 0x00404000  Length: 0x00004000  Control: 0xfff87000  Core: 0x00  Sector: 0x01
DO ~~~~/tms470-func DeclareSector Type: FLASHPAR  Start: 0x00408000  Length: 0x00004000  Control: 0xfff87000  Core: 0x00  Sector: 0x02
DO ~~~~/tms470-func DeclareSector Type: FLASHPAR  Start: 0x0040c000  Length: 0x00001000  Control: 0xfff87000  Core: 0x00  Sector: 0x03
DO ~~~~/tms470-func DeclareSector Type: FLASHPAR  Start: 0x0040d000  Length: 0x00001000  Control: 0xfff87000  Core: 0x00  Sector: 0x04
DO ~~~~/tms470-func DeclareSector Type: FLASHPAR  Start: 0x0040e000  Length: 0x00002000  Control: 0xfff87000  Core: 0x00  Sector: 0x05
DO ~~~~/tms470-func DeclareSector Type: FLASHPAR  Start: 0x00410000  Length: 0x00008000  Control: 0xfff87000  Core: 0x00  Sector: 0x06
DO ~~~~/tms470-func DeclareSector Type: FLASHPAR  Start: 0x00418000  Length: 0x00008000  Control: 0xfff87000  Core: 0x00  Sector: 0x07
DO ~~~~/tms470-func DeclareSector Type: FLASHPAR  Start: 0x00420000  Length: 0x00010000  Control: 0xfff87000  Core: 0x00  Sector: 0x08
DO ~~~~/tms470-func DeclareSector Type: FLASHPAR  Start: 0x00430000  Length: 0x00010000  Control: 0xfff87000  Core: 0x00  Sector: 0x09
DO ~~~~/tms470-func DeclareSector Type: FLASHPAR  Start: 0x00440000  Length: 0x00010000  Control: 0xfff87000  Core: 0x01  Sector: 0x00
DO ~~~~/tms470-func DeclareSector Type: FLASHPAR  Start: 0x00450000  Length: 0x00010000  Control: 0xfff87000  Core: 0x01  Sector: 0x01
DO ~~~~/tms470-func DeclareSector Type: FLASHPAR  Start: 0x00460000  Length: 0x00010000  Control: 0xfff87000  Core: 0x01  Sector: 0x02
DO ~~~~/tms470-func DeclareSector Type: FLASHPAR  Start: 0x00470000  Length: 0x00010000  Control: 0xfff87000  Core: 0x01  Sector: 0x03
DO ~~~~/tms470-func DeclareSector Type: FLASHPAR  Start: 0x00480000  Length: 0x00010000  Control: 0xfff87000  Core: 0x02  Sector: 0x00
DO ~~~~/tms470-func DeclareSector Type: FLASHPAR  Start: 0x00490000  Length: 0x00010000  Control: 0xfff87000  Core: 0x02  Sector: 0x01
DO ~~~~/tms470-func DeclareSector Type: FLASHPAR  Start: 0x004a0000  Length: 0x00010000  Control: 0xfff87000  Core: 0x02  Sector: 0x02
DO ~~~~/tms470-func DeclareSector Type: FLASHPAR  Start: 0x004b0000  Length: 0x00010000  Control: 0xfff87000  Core: 0x02  Sector: 0x03
DO ~~~~/tms470-func DeclareSector Type: FLASHPAR  Start: 0x004c0000  Length: 0x00010000  Control: 0xfff87000  Core: 0x03  Sector: 0x00
DO ~~~~/tms470-func DeclareSector Type: FLASHPAR  Start: 0x004d0000  Length: 0x00010000  Control: 0xfff87000  Core: 0x03  Sector: 0x01
DO ~~~~/tms470-func DeclareSector Type: FLASHPAR  Start: 0x004e0000  Length: 0x00010000  Control: 0xfff87000  Core: 0x03  Sector: 0x02
DO ~~~~/tms470-func DeclareSector Type: FLASHPAR  Start: 0x004f0000  Length: 0x00010000  Control: 0xfff87000  Core: 0x03  Sector: 0x03
DO ~~~~/tms470-func DeclareSector Type: OTP       Start: 0x00600000  Length: 0x00000800  Control: 0xfff87000  Core: 0x00  Sector: 0x00
DO ~~~~/tms470-func DeclareSector Type: OTP       Start: 0x00600800  Length: 0x00000800  Control: 0xfff87000  Core: 0x01  Sector: 0x00
DO ~~~~/tms470-func DeclareSector Type: OTP       Start: 0x00601000  Length: 0x00000800  Control: 0xfff87000  Core: 0x02  Sector: 0x00
DO ~~~~/tms470-func DeclareSector Type: OTP       Start: 0x00601800  Length: 0x00000800  Control: 0xfff87000  Core: 0x03  Sector: 0x00
DO ~~~~/tms470-func DeclareSector Type: OTPPAR    Start: 0x00608000  Length: 0x00000400  Control: 0xfff87000  Core: 0x00  Sector: 0x00
DO ~~~~/tms470-func DeclareSector Type: OTPPAR    Start: 0x00608400  Length: 0x00000400  Control: 0xfff87000  Core: 0x01  Sector: 0x00
DO ~~~~/tms470-func DeclareSector Type: OTPPAR    Start: 0x00608800  Length: 0x00000400  Control: 0xfff87000  Core: 0x02  Sector: 0x00
DO ~~~~/tms470-func DeclareSector Type: OTPPAR    Start: 0x00608c00  Length: 0x00000400  Control: 0xfff87000  Core: 0x03  Sector: 0x00

DO ~~~~/tms470-func DeclareFlashAlgortihm &ProgRoutines &RamStart &RamSize &FlashClock_Frequency

;;;;;;;;;;;;;;;;;;;;;;;;;;;;;;;;;;;;;;;;;;;;;;;;;;
; End of flash.cfg
;;;;;;;;;;;;;;;;;;;;;;;;;;;;;;;;;;;;;;;;;;;;;;;;;;
; Flash script ends here if called with parameter PREPAREONLY
IF &param_prepareonly
  ENDDO PREPAREDONE
; --------------------------------------------------------------------------------
; Flash programming example
;
FLASH.List
;
DIALOG.YESNO "Program flash memory?"
ENTRY &progflash

IF &progflash 
(  
  FLASH.ReProgram ALL
  
  ; Optional: setup erased flash values
  ;Data.Set 0x0--0x1fffff %Long 0xffffffff

  Data.LOAD.auto *
  FLASH.ReProgram.off 

  Data.LOAD.auto * /ComPare
)

ENDDO
