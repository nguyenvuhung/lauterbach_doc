; --------------------------------------------------------------------------------
; @Title: TMS470 internal flash of TMS470R1VF104 rev 0 & A
;
; @Description:
; Script arguments:
;
;   DO tms470r1vf104 [PREPAREONLY]
;
;     PREPAREONLY only declares flash but does not execute flash programming
;
; Example:
;
;   DO ~~/demo/arm/flash/tms470r1vf104 PREPAREONLY
;
; internal flash is mapped to 0x00000000
; internal RAM is mapped to 0x01000000
;
; @Author: WRD
; @Copyright: (C) 1989-2014 Lauterbach GmbH, licensed for use with TRACE32(R) only
; --------------------------------------------------------------------------------
; $Rev: 3152 $
; $Id: tms470r1vf104.cmm 3152 2015-02-06 16:35:19Z kjmal $

LOCAL &parameters &param_prepareonly
ENTRY %LINE &parameters
&param_prepareonly=(STRing.SCAN(STRing.UPpeR("&parameters"),"PREPAREONLY",0)!=-1)
; --------------------------------------------------------------------------------
; Init script variables

DO ~~~~/tms470-func Init

; --------------------------------------------------------------------------------
; Setup CPU

ON ERROR NOTHING
IF SYStem.MODE()<5
(
  SYStem.RESet
  SYStem.CPU TMS470R1VF104
  SYStem.Option.BigEndian ON
  SYStem.Option NOIRCHECK ON
  SYStem.Up
)

; --------------------------------------------------------------------------------
; Flash configuration and declaration generated out of flash.cfg file
;

;;;;;;;;;;;;;;;;;;;;;;;;;;;;;;;;;;;;;;;;;;;;;;;;;;
; Config for TMS470R1VF104 rev 0 & A
;;;;;;;;;;;;;;;;;;;;;;;;;;;;;;;;;;;;;;;;;;;;;;;;;;
;Device ID: 0x887               TMS470R1VF104
;  ProgVersion: 0.27 ; Library version
;  ProgRoutines: f05a.lib ; Library archive
LOCAL &ProgRoutines
&ProgRoutines="f05a"

;  Frequency: 12.5 Range: 10.0 - 24.0
;  Minor Revisions: 2
;    0 "TMS470R1VF104 Rev 0"
;    1 "TMS470R1VF104 Rev A"
;  Ram Config: 0x01000000 0x00006000 0x00000600
LOCAL &RamStart &RamSize
&RamStart=0x01000000 
&RamSize=0x00006000 

;  Initialization: 4
;    0xFFFFFE00: 0x00000000 0x00000060 0x00000000 0x00008060 0x00000100 0x00000050 0x00000100 0x00004040
;    0xFFFFFE20: 0x00000000 0x00000000 0x00000000 0x00000000 0x00000000 0x00000000 0x00000000 0x00000000
;    0xFFFFFE40: 0x00000000 0x00000000 0x00000000 0x00000000 0x00000000 0x00000000 0x00000000 0x00000000
;    0xFFFFFE00: 0x00000000 0x00000160 ; Enable memory map
Data.Set 0xFFFFFE00 %Long 0x00000000 0x00000060 0x00000000 0x00008060 0x00000100 0x00000050 0x00000100 0x00004040
Data.Set 0xFFFFFE20 %Long 0x00000000 0x00000000 0x00000000 0x00000000 0x00000000 0x00000000 0x00000000 0x00000000
Data.Set 0xFFFFFE40 %Long 0x00000000 0x00000000 0x00000000 0x00000000 0x00000000 0x00000000 0x00000000 0x00000000
Data.Set 0xFFFFFE00 %Long 0x00000000 0x00000160 ; Enable memory map

;  PLL Config: 0xFFFFFFDC 0x0000000b ; configure PLL
Data.Set 0xFFFFFFDC %Long 0x00000007 ; configure PLL
LOCAL &FlashClock_Frequency
&FlashClock_Frequency="12.5MHz"      ; Setup flash clock frequency to PLL frequency

;  Engr ID: 0xffe88000 0x00000000  
;  Protection Keys:
;  0xffe88000 0x00003FF0: 0xffffffff 0xffffffff 0xffffffff 0xffffffff
DO ~~~~/tms470-func FlashProtection 0xffe88000 0x00003FF0 0xffffffff 0xffffffff 0xffffffff 0xffffffff

;  Number of Blocks: 5
FLASH.RESet
DO ~~~~/tms470-func DeclareSector Type: OTP    Start: 0x00000000   Length: 0x00000800   Control: 0xffe88000   Core: 0x00   Sector: 0x00
DO ~~~~/tms470-func DeclareSector Type: FLASH  Start: 0x00000000   Length: 0x00004000   Control: 0xffe88000   Core: 0x00   Sector: 0x00
DO ~~~~/tms470-func DeclareSector Type: FLASH  Start: 0x00004000   Length: 0x00004000   Control: 0xffe88000   Core: 0x00   Sector: 0x01
DO ~~~~/tms470-func DeclareSector Type: FLASH  Start: 0x00008000   Length: 0x00004000   Control: 0xffe88000   Core: 0x00   Sector: 0x02
DO ~~~~/tms470-func DeclareSector Type: FLASH  Start: 0x0000c000   Length: 0x00004000   Control: 0xffe88000   Core: 0x00   Sector: 0x03

DO ~~~~/tms470-func DeclareFlashAlgortihm &ProgRoutines &RamStart &RamSize &FlashClock_Frequency

;;;;;;;;;;;;;;;;;;;;;;;;;;;;;;;;;;;;;;;;;;;;;;;;;;
; End of flash.cfg
;;;;;;;;;;;;;;;;;;;;;;;;;;;;;;;;;;;;;;;;;;;;;;;;;;

; Flash script ends here if called with parameter PREPAREONLY
IF &param_prepareonly
  ENDDO PREPAREDONE
  
; --------------------------------------------------------------------------------
; Flash programming example

FLASH.List

DIALOG.YESNO "Program flash memory?"
ENTRY &progflash

IF &progflash 
(  
  FLASH.Erase ALL
  FLASH.Program ALL
  Data.LOAD.auto * /Long
  FLASH.Program off
)

ENDDO
