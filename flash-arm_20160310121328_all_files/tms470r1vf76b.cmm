; --------------------------------------------------------------------------------
; @Title: TMS470 internal flash of TMS470R1VF76B
;
; @Description:
; Script arguments:
;
;   DO tms470r1vf76b [PREPAREONLY]
;
;     PREPAREONLY only declares flash but does not execute flash programming
;
; Example:
;
;   DO ~~/demo/arm/flash/tms470r1vf76b PREPAREONLY
;
; internal flash is mapped to 0x00000000
; internal RAM is mapped to 0x01000000
;
; @Author: WRD
; @Copyright: (C) 1989-2014 Lauterbach GmbH, licensed for use with TRACE32(R) only
; @Chip: TMS470R1VF76B
; --------------------------------------------------------------------------------
; $Rev: 2881 $
; $Id: tms470r1vf76b.cmm 2881 2014-07-07 10:35:48Z kjmal $

LOCAL &parameters &param_prepareonly
ENTRY %LINE &parameters
&param_prepareonly=(STRing.SCAN(STRing.UPpeR("&parameters"),"PREPAREONLY",0)!=-1)
; --------------------------------------------------------------------------------
; Init script variables

DO ~~~~/tms470-func Init

; --------------------------------------------------------------------------------
; Setup CPU

ON ERROR NOTHING
IF SYStem.MODE()<5
(
  SYStem.RESet
  SYStem.CPU TMS470R1VF76B
  SYStem.Option.BigEndian ON
  SYStem.Option NOIRCHECK ON
  SYStem.Up
)

; --------------------------------------------------------------------------------
; Flash configuration and declaration generated out of flash.cfg file
;

;;;;;;;;;;;;;;;;;;;;;;;;;;;;;;;;;;;;;;;;;;;;;;;;;;
; Config for TMS470R1VF76B
;;;;;;;;;;;;;;;;;;;;;;;;;;;;;;;;;;;;;;;;;;;;;;;;;;
;Device_ID=0x907               ;TMS470R1VF76B
;  ProgVersion: 0.27 ; Library version
LOCAL &ProgRoutines
&ProgRoutines="f05a"

;&Frequency="20.0MHz" ;Range: 10.0 - 24.0
;  Minor Revisions: 3
;    0 "TMS470R1VF76B Rev 0"
;    1 "TMS470R1VF76B Rev A"
;    2 "TMS470R1VF76B Rev B"
;  Ram Config: 0x01000000 0x00008000 0x00000600
LOCAL &RamStart &RamSize
&RamStart=0x01000000
&RamSize=0x00008000

;  Initialization: 4
Data.Set 0xFFFFFE00 %Long 0x00000000 0x000000a0 0x00000008 0x00000090 0x00000100 0x00000060 0x00000000 0x00000000
Data.Set 0xFFFFFE20 %Long 0x00000000 0x00000000 0x00000000 0x00000000 0x00000000 0x00000000 0x00000000 0x00000000
Data.Set 0xFFFFFE40 %Long 0x00000000 0x00000000 0x00000000 0x00000000 0x00000000 0x00000000 0x00000000 0x00000000
Data.Set 0xFFFFFE00 %Long 0x00000000 0x000001a0 ; Enable memory map

Data.Set 0xFFFFFFDC %Long 0x00000007 ; configure PLL
LOCAL &FlashClock_Frequency
&FlashClock_Frequency="20MHz"      ; Setup flash clock frequency to PLL frequency

;  Engr ID: 0xffe88000 0x00000000
;  Protection Keys:
DO ~~~~/tms470-func FlashProtection 0xffe88000 0x00003FF0 0xffffffff 0xffffffff 0xffffffff 0xffffffff

;  Number of Blocks: 19
FLASH.RESet
DO ~~~~/tms470-func DeclareSector Type: OTP    Start: 0x00000000   Length: 0x00000800   Control: 0xffe88000   Core: 0x00   Sector: 0x00
DO ~~~~/tms470-func DeclareSector Type: FLASH  Start: 0x00000000   Length: 0x00004000   Control: 0xffe88000   Core: 0x00   Sector: 0x00
DO ~~~~/tms470-func DeclareSector Type: FLASH  Start: 0x00004000   Length: 0x00004000   Control: 0xffe88000   Core: 0x00   Sector: 0x01
DO ~~~~/tms470-func DeclareSector Type: FLASH  Start: 0x00008000   Length: 0x00008000   Control: 0xffe88000   Core: 0x00   Sector: 0x02
DO ~~~~/tms470-func DeclareSector Type: FLASH  Start: 0x00010000   Length: 0x00008000   Control: 0xffe88000   Core: 0x00   Sector: 0x03
DO ~~~~/tms470-func DeclareSector Type: FLASH  Start: 0x00018000   Length: 0x00008000   Control: 0xffe88000   Core: 0x00   Sector: 0x04
DO ~~~~/tms470-func DeclareSector Type: FLASH  Start: 0x00020000   Length: 0x00008000   Control: 0xffe88000   Core: 0x00   Sector: 0x05
DO ~~~~/tms470-func DeclareSector Type: FLASH  Start: 0x00028000   Length: 0x00008000   Control: 0xffe88000   Core: 0x00   Sector: 0x06
DO ~~~~/tms470-func DeclareSector Type: FLASH  Start: 0x00030000   Length: 0x00008000   Control: 0xffe88000   Core: 0x00   Sector: 0x07
DO ~~~~/tms470-func DeclareSector Type: FLASH  Start: 0x00038000   Length: 0x00004000   Control: 0xffe88000   Core: 0x00   Sector: 0x08
DO ~~~~/tms470-func DeclareSector Type: FLASH  Start: 0x0003c000   Length: 0x00004000   Control: 0xffe88000   Core: 0x00   Sector: 0x09
DO ~~~~/tms470-func DeclareSector Type: FLASH  Start: 0x00040000   Length: 0x00010000   Control: 0xffe88000   Core: 0x01   Sector: 0x00
DO ~~~~/tms470-func DeclareSector Type: FLASH  Start: 0x00050000   Length: 0x00010000   Control: 0xffe88000   Core: 0x01   Sector: 0x01
DO ~~~~/tms470-func DeclareSector Type: FLASH  Start: 0x00060000   Length: 0x00010000   Control: 0xffe88000   Core: 0x01   Sector: 0x02
DO ~~~~/tms470-func DeclareSector Type: FLASH  Start: 0x00070000   Length: 0x00010000   Control: 0xffe88000   Core: 0x01   Sector: 0x03
DO ~~~~/tms470-func DeclareSector Type: FLASH  Start: 0x00080000   Length: 0x00010000   Control: 0xffe88000   Core: 0x02   Sector: 0x00
DO ~~~~/tms470-func DeclareSector Type: FLASH  Start: 0x00090000   Length: 0x00010000   Control: 0xffe88000   Core: 0x02   Sector: 0x01
DO ~~~~/tms470-func DeclareSector Type: FLASH  Start: 0x000a0000   Length: 0x00010000   Control: 0xffe88000   Core: 0x02   Sector: 0x02
DO ~~~~/tms470-func DeclareSector Type: FLASH  Start: 0x000b0000   Length: 0x00010000   Control: 0xffe88000   Core: 0x02   Sector: 0x03

DO ~~~~/tms470-func DeclareFlashAlgortihm &ProgRoutines &RamStart &RamSize &FlashClock_Frequency

;;;;;;;;;;;;;;;;;;;;;;;;;;;;;;;;;;;;;;;;;;;;;;;;;;
; End of flash.cfg
;;;;;;;;;;;;;;;;;;;;;;;;;;;;;;;;;;;;;;;;;;;;;;;;;;
; Flash script ends here if called with parameter PREPAREONLY
IF &param_prepareonly
  ENDDO PREPAREDONE
; --------------------------------------------------------------------------------
; Flash programming example

FLASH.List

DIALOG.YESNO "Program flash memory?"
ENTRY &progflash

IF &progflash 
(  
  FLASH.Erase ALL
  FLASH.Program ALL
  Data.LOAD.auto * /Long
  FLASH.Program off
)

ENDDO
