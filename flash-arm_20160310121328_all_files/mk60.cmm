; --------------------------------------------------------------------------------
; @Title: Generic script for Freescale MK6* internal flash
;
; @Description:
;
; Example for flash declaration of Freescale MK6* internal flash.
;
; Script arguments:
;
;   DO mk60 [PREPAREONLY] [CPU=<cpu>] [DUALPORT=0|1] [MASSERASE]
;
;     PREPAREONLY only declares flash but does not execute flash programming
;     example
;
;     CPU=<cpu> selects CPU derivative <cpu>. <cpu> can be CPU name out of the
;             table listed below. For these derivatives the flash declaration
;             is done by the script.
;
;     DUALPORT default value is 0 (disabled). If DualPort mode is enabled
;             flash algorithm stays running until flash programming is
;             finished. Data is tranferred via dual port memory access. 
;
;     MASSERASE forces mass erase of device before establishing debug connection
;
; For example:
;
;   DO ~~/demo/arm/flash/mk60 CPU=MK60DN512VLL10 DUALPORT=1 PREPAREONLY
;
; List of MK6* derivatives and their configuration:
;
;   CPU-Type       Flash   ProgFlash   FlexNVM   EEPROM   RamSize
;                   type     [Byte]     [Byte]    [Byte]   [Byte]
; --------------------------------------------------------------------------------
;   MK60DN256VLL10    2N     256KB          -         -     64KB
;   MK60DN256VLQ10    2N     256KB          -         -     64KB
;   MK60DN256VMC10    2N     256KB          -         -     64KB
;   MK60DN256VMD10    2N     256KB          -         -     64KB
;   MK60DX256VLL10    2X     256KB      256KB       4KB     64KB
;   MK60DX256VLQ10    2X     256KB      256KB       4KB     64KB
;   MK60DX256VMC10    2X     256KB      256KB       4KB     64KB
;   MK60DX256VMD10    2X     256KB      256KB       4KB     64KB
;   MK60DN512VLL10    2N     512KB          -         -    128KB
;   MK60DN512VLQ10    2N     512KB          -         -    128KB
;   MK60DN512VMC10    2N     512KB          -         -    128KB
;   MK60DN512VMD10    2N     512KB          -         -    128KB
;   MK60FX512VLQ12    3X     512KB      512KB      16KB    128KB
;   MK60FX512VLQ15    3X     512KB      512KB      16KB    128KB
;   MK60FX512VMD12    3X     512KB      512KB      16KB    128KB
;   MK60FX512VMD15    3X     512KB      512KB      16KB    128KB
;   MK60FN1M0VLQ12    3N       1MB          -         -    128KB
;   MK60FN1M0VLQ15    3N       1MB          -         -    128KB
;   MK60FN1M0VMD12    3N       1MB          -         -    128KB
;   MK60FN1M0VMD15    3N       1MB          -         -    128KB
; --------------------------------------------------------------------------------
;   MK61FX512VMD12    3X     512KB      512KB      16KB    128KB
;   MK61FX512VMD15    3X     512KB      512KB      16KB    128KB
;   MK61FX512VMF12    3X     512KB      512KB      16KB    128KB
;   MK61FX512VMF15    3X     512KB      512KB      16KB    128KB
;   MK61FX512VMJ12    3X     512KB      512KB      16KB    128KB
;   MK61FX512VMJ15    3X     512KB      512KB      16KB    128KB
;   MK61FN1M0VMD12    3N       1MB          -         -    128KB
;   MK61FN1M0VMD15    3N       1MB          -         -    128KB
;   MK61FN1M0VMF12    3N       1MB          -         -    128KB
;   MK61FN1M0VMF15    3N       1MB          -         -    128KB
;   MK61FN1M0VMJ12    3N       1MB          -         -    128KB
;   MK61FN1M0VMJ15    3N       1MB          -         -    128KB
; --------------------------------------------------------------------------------
;   MK65FN2M0VMI18    3N       2MB          -         -    260KB
;   MK65FN2M0CAC18R   3N       2MB          -         -    260KB
;   MK65FX1M0CAC18R   3X    1.25MB     256KB        4KB    256KB
;   MK65FX1M0VMI18    3X    1.25MB     256KB        4KB    256KB
; --------------------------------------------------------------------------------
;   MK66FN2M0VLQ18    3N       2MB          -         -    260KB
;   MK66FN2M0VMD18    3N       2MB          -         -    260KB
;   MK66FX1M0VLQ18    3X    1.25MB     256KB        4KB    256KB
;   MK66FX1M0VMD18    3X    1.25MB     256KB        4KB    256KB
;
; Flash Configuration Field:
;
;   Byte address    Width   Description
; --------------------------------------------------------------------------------
;   0x0400--0x0407    8    Backdoor Comparison Key.
;   0x0408--0x040B    4    Program flash protection bytes (FPROT0-3).
;   0x040F            1    Program flash only devices: Reserved
;                          FlexNVM devices: Data flash protection byte
;                          (FDPROT).
;   0x040E            1    Program flash only devices: Reserved
;                          FlexNVM devices: EEPROM protection byte
;                          (FEPROT).
;   0x040D            1    Flash nonvolatile option byte (FOPT).
;   0x040C            1    Flash security byte (FSEC).
;
;   Flash Configuration Field can be programmed using FLASH.AUTO command 
;   with /CENSORSHIP option.
;
; @Chip: MK60* MK61* MK65* MK66*
; @Author: WRD
; @Copyright: (C) 1989-2014 Lauterbach GmbH, licensed for use with TRACE32(R) only
; --------------------------------------------------------------------------------
; $Rev: 3312 $
; $Id: mk60.cmm 3312 2015-06-25 10:24:47Z fcaron $
;

  LOCAL &parameters
  ENTRY %LINE &parameters

  LOCAL &param_prepareonly &param_masserase
  &param_prepareonly=(STRing.SCAN(STRing.UPpeR("&parameters"),"PREPAREONLY",0)!=-1)
  &param_masserase=(STRing.SCAN(STRing.UPpeR("&parameters"),"MASSERASE",0)!=-1)

  LOCAL &param_cpu
  &param_cpu=STRing.SCANAndExtract(STRing.UPpeR("&parameters"),"CPU=","")
  IF "&param_cpu"==""
  (
    ; For compatibility with older script versions
    &param_cpu=STRing.SCANAndExtract(STRing.UPpeR("&parameters"),"MK60","")
    IF "&param_cpu"!=""
      &param_cpu="MK60"+"&param_cpu"
    ELSE
    (
      &param_cpu=STRing.SCANAndExtract(STRing.UPpeR("&parameters"),"K60","")
      IF "&param_cpu"!=""
        &param_cpu="K60"+"&param_cpu"
      ELSE
      (
        &param_cpu=STRing.SCANAndExtract(STRing.UPpeR("&parameters"),"MK61","")
        IF "&param_cpu"!=""
          &param_cpu="MK61"+"&param_cpu"
      )
    )
  )

  LOCAL &param_dualport
  &param_dualport=0
  IF VERSION.BUILD.BASE()>=43441.
    &param_dualport=STRing.SCANAndExtract(STRing.UPpeR("&parameters"),"DUALPORT=","0")

  ; ------------------------------------------------------------------------------
  ; Setup CPU

  IF (SYStem.MODE()<5)||&param_masserase
  (
    SYStem.RESet

    IF "&param_cpu"!=""
      SYStem.CPU &param_cpu
    IF !CPUIS(MK60*)&&!CPUIS(K60*)&&!CPUIS(MK61*)&&!CPUIS(MK65*)&&!CPUIS(MK66*)
      SYStem.CPU MK6*

    IF CABLE.TWOWIRE()
      SYStem.CONFIG.DEBUGPORTTYPE SWD
    ELSE
      SYStem.CONFIG.DEBUGPORTTYPE JTAG

    IF &param_masserase
      GOSUB MassErase

    ON.ERROR GOSUB Unsecure
    SYStem.Up
    ON.ERROR
  )

  ; Unsecure device
  IF VERSION.BUILD()>=34133.
  (
    IF (Data.Long(EDBG:0x40000100)&0x04)==0x04
      GOSUB Unsecure
  )

  ; Disable watchdog
  ON.ERROR GOSUB Unsecure
  GOSUB DisableWatchdog
  ON.ERROR

  ; ------------------------------------------------------------------------------
  ; Flash declaration

  FLASH.RESet
  GOSUB FlashDeclaration &param_dualport

  ; Flash script ends here if called with parameter PREPAREONLY
  IF &param_prepareonly
    ENDDO PREPAREDONE

  ; ------------------------------------------------------------------------------
  ; Flash programming example

  DIALOG.YESNO "Program flash memory?"
  LOCAL &progflash
  ENTRY &progflash
  IF &progflash 
  (
    FLASH.ReProgram.ALL /Erase
    Data.LOAD.auto *
    FLASH.ReProgram.off

    ; Reset device
    SYStem.Down
    SYStem.Up

    ; Disable watchdog
    GOSUB DisableWatchdog
  )

  ENDDO


; --------------------------------------------------------------------------------
; Disable watchdog

DisableWatchdog:
  LOCAL &tmp1 &tmp2
  &tmp1=Data.Long(ST:0x20000000)
  &tmp2=Data.Long(ST:0x20000004)

  ; The watchdog has a restrictive timing. It has to be configured and unlocked within a peripod
  ; of 20+256 cycles. Therefor the unlock sequence need to be done by a small target program.
  Data.Assemble ST:0x20000000  strh r1,[r0]  ;SD:0x4005200E = 0xC520   (Key 1)
  Data.Assemble ,              strh r2,[r0]  ;SD:0x4005200E = 0xD928   (Key 2)
  Data.Assemble ,              strh r4,[r3]  ;SD:0x40052000 = 0x0000   (Config register)
  Data.Assemble ,              bkpt #0
  Register.Set PC 0x20000000
  Register.Set R0 0x4005200E
  Register.Set R1 0xC520
  Register.Set R2 0xD928
  Register.Set R3 0x40052000
  Register.Set R4 0x0
  Go.direct
  WAIT !RUN()

  Data.Set ST:0x20000000 %Long &tmp1
  Data.Set ST:0x20000004 %Long &tmp2

  RETURN


; --------------------------------------------------------------------------------
; Try to unsecure a secured device

Unsecure:
  IF VERSION.BUILD()<48722.
    DO ~~~~/kinetis-unsecure
  ELSE
  (
    ; Print security state information
    SYStem.Mode.Prepare
    PRINT "MDM-AP Status Register is 0x" Data.Long(EDBG:0x40000100)

    DIALOG.YESNO "Execute mass erase to unsecure chip?"
    LOCAL &masserase
    ENTRY &masserase
    IF &masserase
    (
      ON.ERROR DEFault

      ; Unsecure device
      SYStem.Down
      FLASH.UNSECUREerase
      SYStem.Mode.Prepare
      IF (Data.Long(EDBG:0x40000100)&0x04)==0x04
      (
        PRINT %ERROR "Unsecure failed, MDM-AP Status Register is 0x" Data.Long(EDBG:0x40000100)
        SYStem.Down
        ENDDO
      )
    )
    ELSE
      ENDDO
  )

  SYStem.Up

  ; Disable watchdog
  GOSUB DisableWatchdog

  RETURN


; --------------------------------------------------------------------------------
; Try to mass erase the device

MassErase:
  IF VERSION.BUILD.BASE()<49714.
    DO ~~~~/kinetis-unsecure
  ELSE
  (
    ; Mass erase device by unsecure command
    SYStem.Down
    FLASH.UNSECUREerase
    SYStem.Mode.Prepare
    IF (Data.Long(EDBG:0x40000100)&0x24)!=0x20
    (
      PRINT %ERROR "Mass erase failed, MDM-AP Status Register is 0x" Data.Long(EDBG:0x40000100)
      SYStem.Down
      ENDDO
    )
  )

  RETURN


; --------------------------------------------------------------------------------
; Flash declaration depending on selected CPU 

FlashDeclaration:
  LOCAL &DualPort
  ENTRY &DualPort

  LOCAL &PFlashSize &FlexNVMSize
  LOCAL &SectorSize
  ;LOCAL &EEPROMSize

  &FlexNVMSize=0x0
  ;&EEPROMSize=0x0

  ; Setup configuration values
  IF CPUIS("MK60DN256*")||CPUIS("K60N256*")
  (
    &PFlashSize=0x40000
    &SectorSize=0x800
  )
  ELSE IF CPUIS("MK60DX256*")||CPUIS("K60X256*")
  (
    &PFlashSize=0x40000
    &FlexNVMSize=0x40000
    &SectorSize=0x800
    ;&EEPROMSize=0x1000
  )
  ELSE IF CPUIS("MK60DN512*")||CPUIS("K60N512*")
  (
    &PFlashSize=0x80000
    &SectorSize=0x800
  )
  ELSE IF CPUIS("MK6?FX512*")||CPUIS("K60X512*")
  (
    &PFlashSize=0x80000
    &FlexNVMSize=0x80000
    &SectorSize=0x1000
    ;&EEPROMSize=0x4000
  )
  ELSE IF CPUIS("MK6?FN1M0*")||CPUIS("K60N1M0*")
  (
    &PFlashSize=0x100000
    &SectorSize=0x1000
  )
  ELSE IF CPUIS("MK6?FX1M0*")
  (
    &PFlashSize=0x140000
    &FlexNVMSize=0x40000
    &SectorSize=0x1000
    ;&EEPROMSize=0x4000
  )
  ELSE IF CPUIS("MK6?FN2M0*")
  (
    &PFlashSize=0x200000
    &SectorSize=0x1000
  )
  ELSE
  (
    PRINT %ERROR "FLASH size of CPU type is not supported by the script"
    ENDDO
  )

  LOCAL &access &option
  IF &DualPort==0
    &access="D"
  ELSE
  (
    &access="EAHB"
    &option="/DualPort"
  )


  IF &SectorSize==0x800
  (
    ; Program Flash
    IF &PFlashSize>=0x40000
      FLASH.Create 1. 0x00000000--0x0003FFFF 0x800 TARGET Long
    IF &PFlashSize>=0x80000
      FLASH.Create 2. 0x00040000--0x0007FFFF 0x800 TARGET Long

    ; FlexNVM
    IF &FlexNVMSize>=0x40000
      FLASH.Create 2. 0x10000000--0x1003FFFF 0x800 TARGET Long

    ; EEPROM
    ; preliminary not supported
    ;IF &EEPROMSize>=0x1000
    ;  FLASH.Create 3. 0x14000000--0x14000fff "t.b.d." TARGET Long

    IF &FlexNVMSize>0x0
      FLASH.TARGET 0x1FFFF000 &access:0x20000000 0x800 ~~/demo/arm/flash/long/ftfl2x.bin &option
    ELSE
      FLASH.TARGET 0x1FFFF000 &access:0x20000000 0x800 ~~/demo/arm/flash/long/ftfl2n.bin &option
  )
  ELSE IF &SectorSize==0x1000
  (
    ; Program Flash
    IF &PFlashSize>=0x80000
    (
      FLASH.Create 1. 0x00000000--0x0003FFFF 0x1000 TARGET Quad
      FLASH.Create 2. 0x00040000--0x0007FFFF 0x1000 TARGET Quad
    )
    IF &PFlashSize>=0x100000
    (
      FLASH.Create 3. 0x00080000--0x000BFFFF 0x1000 TARGET Quad
      FLASH.Create 4. 0x000C0000--0x000FFFFF 0x1000 TARGET Quad
    )
    IF &PFlashSize>=0x140000
    (
       FLASH.Create 5. 0x00100000--0x0013FFFF 0x1000 TARGET Quad
    )
    IF &PFlashSize>=0x200000
    (
       FLASH.Create 6. 0x00140000--0x0017FFFF 0x1000 TARGET Quad
       FLASH.Create 7. 0x00180000--0x001FFFFF 0x1000 TARGET Quad
    )
    
    ; FlexNVM
    IF &FlexNVMSize>=0x80000
    (
      FLASH.Create 3. 0x10000000--0x1003FFFF 0x1000 TARGET Quad
      FLASH.Create 4. 0x10040000--0x1007FFFF 0x1000 TARGET Quad
    )

    ; EEPROM
    ; preliminary not supported
    ;IF &EEPROMSize>=0x4000
    ;  FLASH.Create 3. 0x14000000--0x14003FFF "t.b.d." TARGET Quad

    IF &FlexNVMSize>0x0
      FLASH.TARGET 0x1FFFF000 &access:0x20000000 0x1000 ~~/demo/arm/flash/quad/ftfe3x.bin &option
    ELSE
      FLASH.TARGET 0x1FFFF000 &access:0x20000000 0x1000 ~~/demo/arm/flash/quad/ftfe3n.bin &option
  )

  RETURN
