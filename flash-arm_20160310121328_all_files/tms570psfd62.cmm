; --------------------------------------------------------------------------------
; @Title: TMS570PSFD62 internal flash setup
;
; @Description: 
; Script arguments:
;
;   DO tms570psfd62 [PREPAREONLY]
;
;     PREPAREONLY only declares flash but does not execute flash programming
;
; Example:
;
;   DO ~~/demo/arm/flash/tms570psfd62 PREPAREONLY
;
; @Author: WRD
; @Copyright: (C) 1989-2014 Lauterbach GmbH, licensed for use with TRACE32(R) only
; @Chip: TMS570PSFD62 
; --------------------------------------------------------------------------------
; $Rev: 2881 $
; $Id: tms570psfd62.cmm 2881 2014-07-07 10:35:48Z kjmal $
;
LOCAL &parameters &param_prepareonly
ENTRY %LINE &parameters
&param_prepareonly=(STRing.SCAN(STRing.UPpeR("&parameters"),"PREPAREONLY",0)!=-1)  
; --------------------------------------------------------------------------------
; Init script variables

DO ~~~~/tms470-func Init

; --------------------------------------------------------------------------------
; Setup CPU
IF SYStem.MODE()<5
(
  SYStem.RESet
  SYStem.CPU TMS570PSFD62
  SYStem.Up
)

; --------------------------------------------------------------------------------
; Flash configuration and declaration generated out of flash470.cfg file

;;;;;;;;;;;;;;;;;;;;;;;;;;;;;;;;;;;;;;;;;;;;;;;;;;
; Config for TMS570PSFD62
;;;;;;;;;;;;;;;;;;;;;;;;;;;;;;;;;;;;;;;;;;;;;;;;;;
; actual device ID is 0x80386D05
;;;;;;;;;;;;;;;;;;;;;;;;;;;;;;;;;;;;;;;;;;;;;;;;;;
;Device ID: 0x001C         TMS570PSFD62
;  ProgVersion: 1.03 ; Library Version
;  ProgRoutines: pf035a_slavecore.x70 ; Platform library archive
LOCAL &ProgRoutines
&ProgRoutines="pf035a_slavecore"

;  Frequency: 150.0 Range: 10.0 - 150.0
;  Minor Revisions: 1
;    0 "TMS570PSFD62 Rev 0"
;  Ram Config: 0x08000000 0x00014000 ; R4 Ram from 40 to 80kb - assumed second # is RAM length
LOCAL &RamStart &RamSize
&RamStart=0x08000000 
&RamSize=0x00014000 

;  Initialization: 16
Data.Set 0xffffff48 %Long 0x00000000 ; set GHVSRC to OSCIN clock source
Data.Set 0xfffff538 %Long 0x00000005 ; reset ESM
Data.Set 0xffffffd0 %Long 0x01010000 ; Disable peripherals
Data.Set 0xffffffd0 %Long 0x01010100 ; Enable peripherals
Data.Set 0xffffffc0 %Long 0x00000000 ; R4 RAM, Set RAM wait states to 0
Data.Set 0xfff7c414 %Long 0x00000000 ; M3 RAM, Set RAm wait states to 0
Data.Set 0xfff87008 %Long 0x00000005 ; Disable R4 Flash Parity
Data.Set 0xfff88008 %Long 0x00000005 ; Disable M3 Flash Parity
Data.Set 0xfffff000 %Long 0x00000000 ; Disable DMA
Data.Set 0xffffff00 %Long 0x00000000 ; Disable ECLK Output
Data.Set 0xfff87000 %Long 0x00000411 ; R4 Flash Wrapper, enable pipeline mode and RWAIT=4
Data.Set 0xfff87040 %Long 0x0000FFFF ; R4 Flash Wrapper, force active mode for all banks
Data.Set 0xfff88000 %Long 0x00000201 ; M3 Flash Wrapper, enable pipepline mode and RWAIT=2
Data.Set 0xfff88040 %Long 0x0000FFFF ; M3 Flash Wrapper, force active mode for all banks
Data.Set 0xffffffc4 %Long 0x0000000a ; MEMSW='1010' => R4 Flash at 0x00000000, R4 RAM at 0x08000000
Data.Set 0xfff7c40c %Long 0x0000000a ; MEMSW='1010' => M3 Flash at 0x00000000, M3 RAM at 0x08000000, in its own memory map

Data.Set 0xfffffe40 %Long 0xffffffff ; disable interrupts in REQMASKSET0
Data.Set 0xfffffe44 %Long 0xffffffff ; disable interrupts in REQMASKSET1

;  Initialization Code: 5
;    S00600004844521B
;    S32208000300477846C0E92D0001EE110F30E3C00402E3800001EE010F30EE1F0F10E36E
;    S3220800031DC00005EE0F0F10EE110F30E3C00303E3800006EE010F30EE1F0F10E380C7
;    S31B0800033A0002E3C00008EE0F0F10E3A00000E8BD0001E12FFF1E80
;    S70500000000FA
AREA.OPEN A000 ~~~/InitializationCode.s3
PRINT "S00600004844521B"
PRINT "S32208000300477846C0E92D0001EE110F30E3C00402E3800001EE010F30EE1F0F10E36E"
PRINT "S3220800031DC00005EE0F0F10EE110F30E3C00303E3800006EE010F30EE1F0F10E380C7"
PRINT "S31B0800033A0002E3C00008EE0F0F10E3A00000E8BD0001E12FFF1E80"
PRINT "S70500000000FA"
AREA.CLOSE
Data.LOAD.auto ~~~/InitializationCode.s3
Register.Set PC  0x08000300
Register.Set R14 0x080002fc
Go.direct Register(R14)
WAIT !RUN()
Register.RESet

;  PLL Config: 0xffffff70 0x21039500 0xffbfffff 0xffffff74 0x7FC07200 0xffffffff ; configure 150Mhz (assuming 16.0 Mhz OSCIN)
Data.Set    0xffffff70 %Long 0x21039500|(Data.Long(SD:0xffffff70)&~0xffbfffff) 
Data.Set    0xffffff74 %Long 0x7FC07200|(Data.Long(SD:0xffffff74)&~0xffffffff) 
LOCAL &FlashClock_Frequency
&FlashClock_Frequency="150Mhz"      ; Setup flash clock frequency to PLL frequency

;  Engr ID: 0xfff87000 0x00604000
;  Number of Blocks: 64
FLASH.RESet
&FlashType="FLASHECC"

; R4 Flash Sectors
DO ~~~~/tms470-func SelectCore MASTER_CORE
DO ~~~~/tms470-func DeclareSector Type: FLASH     Start: 0x00000000  Length: 0x00004000  Control: 0xfff87000  Core: 0x00  Sector: 0x00 ;R4 starts 16k
DO ~~~~/tms470-func DeclareSector Type: FLASH     Start: 0x00004000  Length: 0x00004000  Control: 0xfff87000  Core: 0x00  Sector: 0x01 ;16k
DO ~~~~/tms470-func DeclareSector Type: FLASH     Start: 0x00008000  Length: 0x00004000  Control: 0xfff87000  Core: 0x00  Sector: 0x02 ;16k
DO ~~~~/tms470-func DeclareSector Type: FLASH     Start: 0x0000C000  Length: 0x00004000  Control: 0xfff87000  Core: 0x00  Sector: 0x03 ;16k
DO ~~~~/tms470-func DeclareSector Type: FLASH     Start: 0x00010000  Length: 0x00008000  Control: 0xfff87000  Core: 0x00  Sector: 0x04 ;32k
DO ~~~~/tms470-func DeclareSector Type: FLASH     Start: 0x00018000  Length: 0x00008000  Control: 0xfff87000  Core: 0x00  Sector: 0x05 ;32k
DO ~~~~/tms470-func DeclareSector Type: FLASH     Start: 0x00020000  Length: 0x00010000  Control: 0xfff87000  Core: 0x00  Sector: 0x06 ;64k
DO ~~~~/tms470-func DeclareSector Type: FLASH     Start: 0x00030000  Length: 0x00010000  Control: 0xfff87000  Core: 0x00  Sector: 0x07 ;64k
DO ~~~~/tms470-func DeclareSector Type: FLASH     Start: 0x00040000  Length: 0x00020000  Control: 0xfff87000  Core: 0x00  Sector: 0x08 ;128k
DO ~~~~/tms470-func DeclareSector Type: FLASH     Start: 0x00060000  Length: 0x00020000  Control: 0xfff87000  Core: 0x00  Sector: 0x09 ;128k
DO ~~~~/tms470-func DeclareSector Type: FLASH     Start: 0x00080000  Length: 0x00020000  Control: 0xfff87000  Core: 0x01  Sector: 0x00 ;128k
DO ~~~~/tms470-func DeclareSector Type: FLASH     Start: 0x000A0000  Length: 0x00020000  Control: 0xfff87000  Core: 0x01  Sector: 0x01 ;128k
DO ~~~~/tms470-func DeclareSector Type: FLASH     Start: 0x000C0000  Length: 0x00020000  Control: 0xfff87000  Core: 0x01  Sector: 0x02 ;128k
DO ~~~~/tms470-func DeclareSector Type: FLASH     Start: 0x000E0000  Length: 0x00020000  Control: 0xfff87000  Core: 0x01  Sector: 0x03 ;128k
DO ~~~~/tms470-func DeclareSector Type: FLASH     Start: 0x00100000  Length: 0x00020000  Control: 0xfff87000  Core: 0x02  Sector: 0x00 ;128k
DO ~~~~/tms470-func DeclareSector Type: FLASH     Start: 0x00120000  Length: 0x00020000  Control: 0xfff87000  Core: 0x02  Sector: 0x01 ;128k
DO ~~~~/tms470-func DeclareSector Type: FLASH     Start: 0x00140000  Length: 0x00020000  Control: 0xfff87000  Core: 0x02  Sector: 0x02 ;128k
DO ~~~~/tms470-func DeclareSector Type: FLASH     Start: 0x00160000  Length: 0x00020000  Control: 0xfff87000  Core: 0x02  Sector: 0x03 ;128k
    
; M3 Flash sectors
DO ~~~~/tms470-func SelectCore SLAVE_CORE0
DO ~~~~/tms470-func DeclareSector Type: FLASH     Start: 0xFD000000  Length: 0x00004000  Control: 0xfff88000  Core: 0x00  Sector: 0x00 ;M3 starts 16k
DO ~~~~/tms470-func DeclareSector Type: FLASH     Start: 0xFD004000  Length: 0x00004000  Control: 0xfff88000  Core: 0x00  Sector: 0x01 ;16k
DO ~~~~/tms470-func DeclareSector Type: FLASH     Start: 0xFD008000  Length: 0x00008000  Control: 0xfff88000  Core: 0x00  Sector: 0x02 ;32k
DO ~~~~/tms470-func DeclareSector Type: FLASH     Start: 0xFD010000  Length: 0x00010000  Control: 0xfff88000  Core: 0x00  Sector: 0x03 ;64k
DO ~~~~/tms470-func DeclareSector Type: FLASH     Start: 0xFD020000  Length: 0x00010000  Control: 0xfff88000  Core: 0x00  Sector: 0x04 ;64k
DO ~~~~/tms470-func DeclareSector Type: FLASH     Start: 0xFD030000  Length: 0x00010000  Control: 0xfff88000  Core: 0x00  Sector: 0x05 ;64k
DO ~~~~/tms470-func DeclareSector Type: FLASH     Start: 0xFD040000  Length: 0x00010000  Control: 0xfff88000  Core: 0x00  Sector: 0x06 ;64k
DO ~~~~/tms470-func DeclareSector Type: FLASH     Start: 0xFD050000  Length: 0x00010000  Control: 0xfff88000  Core: 0x00  Sector: 0x07 ;64k
DO ~~~~/tms470-func DeclareSector Type: FLASH     Start: 0xFD060000  Length: 0x00010000  Control: 0xfff88000  Core: 0x00  Sector: 0x08 ;64k
DO ~~~~/tms470-func DeclareSector Type: FLASH     Start: 0xFD070000  Length: 0x00010000  Control: 0xfff88000  Core: 0x00  Sector: 0x09 ;64k
    
; R4 Flash Parity
DO ~~~~/tms470-func SelectCore MASTER_CORE
DO ~~~~/tms470-func DeclareSector Type: FLASHECC  Start: 0x00400000  Length: 0x00002000  Control: 0xfff87000  Core: 0x00  Sector: 0x00 ;R4ECC 8k
DO ~~~~/tms470-func DeclareSector Type: FLASHECC  Start: 0x00402000  Length: 0x00002000  Control: 0xfff87000  Core: 0x00  Sector: 0x01 ;8k
DO ~~~~/tms470-func DeclareSector Type: FLASHECC  Start: 0x00404000  Length: 0x00002000  Control: 0xfff87000  Core: 0x00  Sector: 0x02 ;8k
DO ~~~~/tms470-func DeclareSector Type: FLASHECC  Start: 0x00406000  Length: 0x00002000  Control: 0xfff87000  Core: 0x00  Sector: 0x03 ;8k
DO ~~~~/tms470-func DeclareSector Type: FLASHECC  Start: 0x00408000  Length: 0x00004000  Control: 0xfff87000  Core: 0x00  Sector: 0x04 ;16k
DO ~~~~/tms470-func DeclareSector Type: FLASHECC  Start: 0x0040C000  Length: 0x00004000  Control: 0xfff87000  Core: 0x00  Sector: 0x05 ;16k
DO ~~~~/tms470-func DeclareSector Type: FLASHECC  Start: 0x00410000  Length: 0x00008000  Control: 0xfff87000  Core: 0x00  Sector: 0x06 ;32k
DO ~~~~/tms470-func DeclareSector Type: FLASHECC  Start: 0x00418000  Length: 0x00008000  Control: 0xfff87000  Core: 0x00  Sector: 0x07 ;32k
DO ~~~~/tms470-func DeclareSector Type: FLASHECC  Start: 0x00420000  Length: 0x00010000  Control: 0xfff87000  Core: 0x00  Sector: 0x08 ;64k
DO ~~~~/tms470-func DeclareSector Type: FLASHECC  Start: 0x00430000  Length: 0x00010000  Control: 0xfff87000  Core: 0x00  Sector: 0x09 ;64k
DO ~~~~/tms470-func DeclareSector Type: FLASHECC  Start: 0x00440000  Length: 0x00010000  Control: 0xfff87000  Core: 0x01  Sector: 0x00 ;64k
DO ~~~~/tms470-func DeclareSector Type: FLASHECC  Start: 0x00450000  Length: 0x00010000  Control: 0xfff87000  Core: 0x01  Sector: 0x01 ;64k
DO ~~~~/tms470-func DeclareSector Type: FLASHECC  Start: 0x00460000  Length: 0x00010000  Control: 0xfff87000  Core: 0x01  Sector: 0x02 ;64k
DO ~~~~/tms470-func DeclareSector Type: FLASHECC  Start: 0x00470000  Length: 0x00010000  Control: 0xfff87000  Core: 0x01  Sector: 0x03 ;64k
DO ~~~~/tms470-func DeclareSector Type: FLASHECC  Start: 0x00480000  Length: 0x00010000  Control: 0xfff87000  Core: 0x02  Sector: 0x00 ;64k
DO ~~~~/tms470-func DeclareSector Type: FLASHECC  Start: 0x00490000  Length: 0x00010000  Control: 0xfff87000  Core: 0x02  Sector: 0x01 ;64k
DO ~~~~/tms470-func DeclareSector Type: FLASHECC  Start: 0x004A0000  Length: 0x00010000  Control: 0xfff87000  Core: 0x02  Sector: 0x02 ;64k
DO ~~~~/tms470-func DeclareSector Type: FLASHECC  Start: 0x004B0000  Length: 0x00010000  Control: 0xfff87000  Core: 0x02  Sector: 0x03 ;64k
    
; M3 Flash Parity
DO ~~~~/tms470-func SelectCore SLAVE_CORE0
DO ~~~~/tms470-func DeclareSector Type: FLASHECC  Start: 0xFD200000  Length: 0x00002000  Control: 0xfff88000  Core: 0x00  Sector: 0x00 ;M3 8k
DO ~~~~/tms470-func DeclareSector Type: FLASHECC  Start: 0xFD202000  Length: 0x00002000  Control: 0xfff88000  Core: 0x00  Sector: 0x01 ;8k
DO ~~~~/tms470-func DeclareSector Type: FLASHECC  Start: 0xFD204000  Length: 0x00004000  Control: 0xfff88000  Core: 0x00  Sector: 0x02 ;16k
DO ~~~~/tms470-func DeclareSector Type: FLASHECC  Start: 0xFD208000  Length: 0x00008000  Control: 0xfff88000  Core: 0x00  Sector: 0x03 ;32k
DO ~~~~/tms470-func DeclareSector Type: FLASHECC  Start: 0xFD210000  Length: 0x00008000  Control: 0xfff88000  Core: 0x00  Sector: 0x04 ;32k
DO ~~~~/tms470-func DeclareSector Type: FLASHECC  Start: 0xFD218000  Length: 0x00008000  Control: 0xfff88000  Core: 0x00  Sector: 0x05 ;32k
DO ~~~~/tms470-func DeclareSector Type: FLASHECC  Start: 0xFD220000  Length: 0x00008000  Control: 0xfff88000  Core: 0x00  Sector: 0x06 ;32k
DO ~~~~/tms470-func DeclareSector Type: FLASHECC  Start: 0xFD228000  Length: 0x00008000  Control: 0xfff88000  Core: 0x00  Sector: 0x07 ;32k
DO ~~~~/tms470-func DeclareSector Type: FLASHECC  Start: 0xFD230000  Length: 0x00008000  Control: 0xfff88000  Core: 0x00  Sector: 0x08 ;32k
DO ~~~~/tms470-func DeclareSector Type: FLASHECC  Start: 0xFD238000  Length: 0x00008000  Control: 0xfff88000  Core: 0x00  Sector: 0x09 ;32k
    
; R4/M3 Flash OTP sectors
DO ~~~~/tms470-func SelectCore MASTER_CORE
DO ~~~~/tms470-func DeclareSector Type: OTP       Start: 0x00600000  Length: 0x00000800  Control: 0xfff87000  Core: 0x00  Sector: 0x00 ;R4 OTP0 2kb
DO ~~~~/tms470-func DeclareSector Type: OTP       Start: 0x00600800  Length: 0x00000800  Control: 0xfff87000  Core: 0x01  Sector: 0x00 ;R4 OTP1 2kb
DO ~~~~/tms470-func DeclareSector Type: OTP       Start: 0x00601000  Length: 0x00000800  Control: 0xfff87000  Core: 0x02  Sector: 0x00 ;R4 OTP2 2kb
DO ~~~~/tms470-func SelectCore SLAVE_CORE0
DO ~~~~/tms470-func DeclareSector Type: OTP       Start: 0xFD800000  Length: 0x00000800  Control: 0xfff88000  Core: 0x00  Sector: 0x00 ;M3 OTP  2kb
DO ~~~~/tms470-func SelectCore MASTER_CORE
DO ~~~~/tms470-func DeclareSector Type: OTPECC    Start: 0x00608000  Length: 0x00000400  Control: 0xfff87000  Core: 0x00  Sector: 0x00 ;R4 OTP0 ECC 2kb
DO ~~~~/tms470-func DeclareSector Type: OTPECC    Start: 0x00608400  Length: 0x00000400  Control: 0xfff87000  Core: 0x01  Sector: 0x00 ;R4 OTP1 ECC
DO ~~~~/tms470-func DeclareSector Type: OTPECC    Start: 0x00608800  Length: 0x00000400  Control: 0xfff87000  Core: 0x02  Sector: 0x00 ;R4 OTP2 ECC
DO ~~~~/tms470-func SelectCore SLAVE_CORE0
DO ~~~~/tms470-func DeclareSector Type: OTPECC    Start: 0xFD808000  Length: 0x00000400  Control: 0xfff88000  Core: 0x00  Sector: 0x00 ;M3 OTP  2kb

DO ~~~~/tms470-func DeclareFlashAlgortihm &ProgRoutines &RamStart &RamSize &FlashClock_Frequency

;;;;;;;;;;;;;;;;;;;;;;;;;;;;;;;;;;;;;;;;;;;;;;;;;;
; End of flash.cfg
;;;;;;;;;;;;;;;;;;;;;;;;;;;;;;;;;;;;;;;;;;;;;;;;;;
; Flash script ends here if called with parameter PREPAREONLY
IF &param_prepareonly
  ENDDO PREPAREDONE
; --------------------------------------------------------------------------------
; Flash programming example

FLASH.List

DIALOG.YESNO "Program flash memory?"
LOCAL &progflash
ENTRY &progflash

IF &progflash 
(  
  FLASH.ReProgram ALL /Erase
  Data.LOAD.auto *
  FLASH.ReProgram.off 

  ; optional
  ;Data.LOAD.auto * /ComPare
)

ENDDO
