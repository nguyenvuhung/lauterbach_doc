; --------------------------------------------------------------------------------
; @Title: Example for flash declaration of Fujitsu MB9B610T series internal flash.
;
; @Description: 
; Script arguments:
;
;   DO mb9b610t [PREPAREONLY] [CPU=<cpu>]
;
;     PREPAREONLY only declares flash but does not execute flash programming
;
;     CPU=<cpu> selects CPU derivative <cpu>
;
; Example:
;
;   DO ~~/demo/arm/flash/mb9b610t CPU=MB9BF618T PREPAREONLY
;
; List of MB9B610T series derivatives and their configuration:
;
;   CPU-Type       FlashSize  RamSize
;                     [kB]      [kB]
;   ---------------------------------
;   MB9BF616S         512.       64.
;   MB9BF616T         512.       64.
;   MB9BF617S         768.       96.
;   MB9BF617T         768.       96.
;   MB9BF618S        1024.      128.
;   MB9BF618T        1024.      128.
;
; @Chip: MB9BF61*
; @Author: WRD
; @Copyright: (C) 1989-2014 Lauterbach GmbH, licensed for use with TRACE32(R) only
; --------------------------------------------------------------------------------
; $Rev: 3485 $
; $Id: mb9b610t.cmm 3485 2015-11-05 15:55:02Z fcaron $

  LOCAL &parameters &param_prepareonly
  ENTRY %LINE &parameters
  &param_prepareonly=(STRing.SCAN(STRing.UPpeR("&parameters"),"PREPAREONLY",0)!=-1)

  LOCAL &param_cpu
  &param_cpu=STRing.SCANAndExtract(STRing.UPpeR("&parameters"),"CPU=","")

  ; --------------------------------------------------------------------------------
  ; Start debugging

  IF SYStem.MODE()<5
  (
    Break.RESet
    SYStem.RESet

    IF "&param_cpu"!=""
      SYStem.CPU &param_cpu
    IF !CPUIS(MB9BF61*)
      SYStem.CPU MB9BF61*

    IF CABLE.TWOWIRE()
      SYStem.CONFIG.DEBUGPORTTYPE SWD
    ELSE
      SYStem.CONFIG.DEBUGPORTTYPE JTAG

    SYStem.Option.ResBreak OFF
    SYStem.Up
  )

  ; --------------------------------------------------------------------------------
  ; Flash declaration

  FLASH.RESet
  GOSUB FlashDeclaration

  ; --------------------------------------------------------------------------------
  ; Flash programming example

  ; Flash script ends here if called with parameter PREPAREONLY
  IF &param_prepareonly
    ENDDO PREPAREDONE

  DIALOG.YESNO "Program flash memory?"
  LOCAL &progflash
  ENTRY &progflash
  IF &progflash 
  (
    FLASH.ReProgram.ALL /Erase
    Data.LOAD.auto *
    FLASH.ReProgram.off

    ; Reset device
    SYStem.Down
    SYStem.Up
  )

  ENDDO


; --------------------------------------------------------------------------------
; Flash declaration depending on selected CPU 

FlashDeclaration:
  LOCAL &FlashSize

  IF CPUIS("MB9BF616?")
  (
    &FlashSize=0x80000
  )
  ELSE IF CPUIS("MB9BF617?")
  (
    &FlashSize=0xC0000
  )
  ELSE IF CPUIS("MB9BF618?")
  (
    &FlashSize=0x100000
  )
  ELSE
  (
    PRINT %ERROR "FLASH size of CPU type is unknown"
    ENDDO
  )

  IF &FlashSize>=0x80000
  (
    FLASH.Create 1. 0x000000--0x007FFF  0x4000 TARGET Long
    FLASH.Create 1. 0x008000--0x01FFFF 0x18000 TARGET Long
    FLASH.Create 1. 0x020000--0x07FFFF 0x20000 TARGET Long
  )
  IF &FlashSize>=0xC0000
  (
    FLASH.Create 1. 0x080000--0x0BFFFF 0x20000 TARGET Long
  )
  IF &FlashSize>=0x100000
  (
    FLASH.Create 1. 0x0C0000--0x0FFFFF 0x20000 TARGET Long
  )

  FLASH.TARGET 0x1FFFF000 0x20000000 0x4000 ~~/demo/arm/flash/long/fm3t1.bin

  RETURN
