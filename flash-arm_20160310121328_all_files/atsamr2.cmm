; --------------------------------------------------------------------------------
; @Title: Example for flash declaration of Atmel ATSAMR21 internal flash
; @Description:
;   Script arguments:
;
;    DO atsamr2 [PREPAREONLY] [CPU=<cpu>]
;
;      PREPAREONLY only declares flash but does not execute flash programming
;
;      CPU=<cpu> selects CPU derivative <cpu>
;
;   Example:
;
;   DO ~~/demo/arm/flash/atsamr2 CPU=ATSAMR21E18A PREPAREONLY
;
;   List of ATSAMD2* derivatives and their configuration:
;
;     CPU-Type        Flash size   Page size    SRAM size
;                        [Byte]      [Byte]       [Byte]
;     ATSAMR21E16A      0x10000       0x40        0x2000
;     ATSAMR21E17A      0x20000       0x40        0x4000
;     ATSAMR21E18A      0x40000       0x40        0x8000
;     ATSAMR21G16A      0x10000       0x40        0x2000
;     ATSAMR21G17A      0x20000       0x40        0x4000
;     ATSAMR21G18A      0x40000       0x40        0x8000
;
; @Author: AME
; @Chip: ATSAMR2*
; @Copyright: (C) 1989-2015 Lauterbach GmbH, licensed for use with TRACE32(R) only
; --------------------------------------------------------------------------------
; $Rev: 3502 $
; $Id: atsamr2.cmm 3502 2015-11-20 15:34:53Z fcaron $


  LOCAL &parameters
  ENTRY %LINE &parameters

  LOCAL &param_prepareonly &param_cpu
  &param_prepareonly=(STRing.SCAN(STRing.UPpeR("&parameters"),"PREPAREONLY",0)!=-1)
  &param_cpu=STRing.SCANAndExtract(STRing.UPpeR("&parameters"),"CPU=","")

  IF VERSION.BUILD.BASE()<58485.
  (
    PRINT %ERROR "Trace32 software version is to old, please request an update."
    ENDDO
  )
  
  ; ------------------------------------------------------------------------------
  ; Setup CPU

  IF SYStem.MODE()<5
  (
    SYStem.RESet

    IF "&param_cpu"!=""
      SYStem.CPU &param_cpu
    IF !CPUIS(ATSAMR2*)
      SYStem.CPU ATSAMR2*
    SYStem.CONFIG.DEBUGPORTTYPE SWD
    SYStem.Option.ResBreak OFF
    SYStem.Up
  )

  ; ------------------------------------------------------------------------------
  ; Flash declaration

  FLASH.RESet
  GOSUB FlashDeclaration

  ; Flash script ends here if called with parameter PREPAREONLY
  IF &param_prepareonly
    ENDDO PREPAREDONE

 ; -------------------------------------------------------------------------------
  ; Flash programming example

  DIALOG.YESNO "Program flash memory?"
  LOCAL &progflash
  ENTRY &progflash
  IF &progflash 
  (
    FLASH.ReProgram.ALL
    Data.LOAD.auto *
    FLASH.ReProgram.off
    
    ; Reset device
    SYStem.Down
    SYStem.Up
  )

  ENDDO


; --------------------------------------------------------------------------------
; Flash declaration depending on selected CPU 

FlashDeclaration:
  LOCAL &FlashSize &FlashDriver

  IF CPUIS("ATSAMR2??16*")
  (
    &FlashSize=0x10000
    &FlashDriver="atsamd2.bin"
  )
  ELSE IF CPUIS("ATSAMR2??17*")
  (
    &FlashSize=0x20000
    &FlashDriver="atsamd2.bin"
  )
  ELSE IF CPUIS("ATSAMR2??18*")
  (
      &FlashSize=0x40000
      &FlashDriver="atsamd2.bin"
  )
  ELSE
  (
    PRINT %ERROR "FLASH size of CPU type is unknown"
    ENDDO
  )

  IF &FlashSize>=0x4000
    FLASH.Create  1. 0x00000000--0x00003FFF 0x100 TARGET Long
  IF &FlashSize>=0x8000
    FLASH.Create  1. 0x00004000--0x00007FFF 0x100 TARGET Long
  IF &FlashSize>=0x10000
    FLASH.Create  1. 0x00008000--0x0000FFFF 0x100 TARGET Long
  IF &FlashSize>=0x20000
    FLASH.Create  1. 0x00010000--0x0001FFFF 0x100 TARGET Long
  IF &FlashSize>=0x40000
    FLASH.Create  1. 0x00020000--0x0003FFFF 0x100 TARGET Long

  FLASH.TARGET 0x20000000 0x20000400 0x400 ~~/demo/arm/flash/long/&FlashDriver
  
  RETURN
