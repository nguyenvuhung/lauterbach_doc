; --------------------------------------------------------------------------------
; @Title: TMS470 internal flash of TMS470PVF242
;
; @Description: 
; Script arguments:
;
;   DO tms470pvf242 [PREPAREONLY] 
;
;     PREPAREONLY only declares flash but does not execute flash programming
;
; Example:
;
;   DO ~~/demo/arm/flash/tms470pvf242 PREPAREONLY
;
; @Author: WRD
; @Copyright: (C) 1989-2014 Lauterbach GmbH, licensed for use with TRACE32(R) only
; --------------------------------------------------------------------------------
; $Rev: 3152 $
; $Id: tms470pvf242.cmm 3152 2015-02-06 16:35:19Z kjmal $

LOCAL &parameters
ENTRY %LINE &parameters

DO ~~~~/tms470pvf241 TMS470PVF242 &parameters

ENDDO
