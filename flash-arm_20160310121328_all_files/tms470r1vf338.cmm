; --------------------------------------------------------------------------------
; @Title: TMS470 internal flash of TMS470R1VF338/348 rev B & D
;
; @Description: 
; Script arguments:
;
;   DO tms470r1vf338 [CPU=<cpu>|<cpu>] [PREPAREONLY]
;
;     CPU=<cpu> selects CPU derivative <cpu>
;     <cpu>     selects CPU derivative <cpu> (obsolete syntax)
;
;     PREPAREONLY only declares flash but does not execute flash programming
;
; Example:
;
;   DO ~~/demo/arm/flash/tms470r1vf338 CPU=TMS470R1VF338 PREPAREONLY
;
; internal flash is mapped to 0x00000000
; internal RAM is mapped to 0x01000000
;
; @Author: WRD
; @Copyright: (C) 1989-2014 Lauterbach GmbH, licensed for use with TRACE32(R) only
; @Chip: TMS470R1VF338 TMS470R1VF348 
; --------------------------------------------------------------------------------
; $Rev: 2881 $
; $Id: tms470r1vf338.cmm 2881 2014-07-07 10:35:48Z kjmal $

LOCAL &parameters
ENTRY %LINE &parameters

LOCAL &cpu &param_prepareonly
&param_prepareonly=(STRing.SCAN(STRing.UPpeR("&parameters"),"PREPAREONLY",0)!=-1)
IF STRing.SCAN(STRing.UPpeR("&parameters"),"TMS470R1VF348",0)!=-1
  &cpu="TMS470R1VF348"
ELSE
  &cpu="TMS470R1VF338"


; --------------------------------------------------------------------------------
; Init script variables

DO ~~~~/tms470-func Init

; --------------------------------------------------------------------------------
; Setup CPU

ON ERROR NOTHING
IF SYStem.MODE()<5
(
  SYStem.RESet
  SYStem.CPU &cpu
  SYStem.Option.BigEndian ON
  SYStem.Option NOIRCHECK ON
  SYStem.Up
)

; --------------------------------------------------------------------------------
; Flash configuration and declaration generated out of flash.cfg file
;

;;;;;;;;;;;;;;;;;;;;;;;;;;;;;;;;;;;;;;;;;;;;;;;;;;
; Config for TMS470R1VF338/348 rev B & D
;;;;;;;;;;;;;;;;;;;;;;;;;;;;;;;;;;;;;;;;;;;;;;;;;;
;Device_ID=0x857               ;TMS470R1VF338/348
;  ProgVersion: 0.27 ; Library version
LOCAL &ProgRoutines
&ProgRoutines="f05a"

;&Frequency="20.0MHz" ;Range: 10.0 - 24.0
;  Minor Revisions: 2
;    1 "TMS470R1VF338/348 rev B"
;    3 "TMS470R1VF338/348 rev D"
;  Ram Config: 0x01000000 0x00002800 0x00000600
LOCAL &RamStart &RamSize
&RamStart=0x01000000
&RamSize=0x00002800

;  Initialization: 4
Data.Set 0xFFFFFE00 %Long 0x00000000 0x00000090 0x00000000 0x00000000 0x00000100 0x00000040 0x00000100 0x00002020
Data.Set 0xFFFFFE20 %Long 0x00000000 0x00000000 0x00000000 0x00000000 0x00000000 0x00000000 0x00000000 0x00000000
Data.Set 0xFFFFFE40 %Long 0x00000000 0x00000000 0x00000000 0x00000000 0x00000000 0x00000000 0x00000000 0x00000000
Data.Set 0xFFFFFE00 %Long 0x00000000 0x00000190 ; Enable memory map

;  Memory Security 1 Keys:
;       0xffe88000 0x00001FE0: 0xffffffff 0xffffffff 0xffffffff 0xffffffff
DO ~~~~/tms470-func Memory_Security_1 0xffe88000 0x00001FE0 0xffffffff 0xffffffff 0xffffffff 0xffffffff

;  Memory Security 2 Keys:
;       0xffe88000 0x00001FD0: 0xffffffff 0xffffffff 0xffffffff 0xffffffff

Data.Set 0xFFFFFFDC %Long 0x00000007 ; configure PLL
LOCAL &FlashClock_Frequency
&FlashClock_Frequency="20MHz"      ; Setup flash clock frequency to PLL frequency

;  Engr ID: 0xffe88000 0x00000000
;  Protection Keys:
DO ~~~~/tms470-func FlashProtection 0xffe88000 0x00001FF0 0xffffffff 0xffffffff 0xffffffff 0xffffffff

;  Number of Blocks: 15
FLASH.RESet
DO ~~~~/tms470-func DeclareSector Type: OTP    Start: 0x00000000   Length: 0x00000800   Control: 0xffe88000   Core: 0x00   Sector: 0x00
DO ~~~~/tms470-func DeclareSector Type: FLASH  Start: 0x00000000   Length: 0x00002000   Control: 0xffe88000   Core: 0x00   Sector: 0x00
DO ~~~~/tms470-func DeclareSector Type: FLASH  Start: 0x00002000   Length: 0x00002000   Control: 0xffe88000   Core: 0x00   Sector: 0x01
DO ~~~~/tms470-func DeclareSector Type: FLASH  Start: 0x00004000   Length: 0x00002000   Control: 0xffe88000   Core: 0x00   Sector: 0x02
DO ~~~~/tms470-func DeclareSector Type: FLASH  Start: 0x00006000   Length: 0x00002000   Control: 0xffe88000   Core: 0x00   Sector: 0x03
DO ~~~~/tms470-func DeclareSector Type: FLASH  Start: 0x00008000   Length: 0x00008000   Control: 0xffe88000   Core: 0x00   Sector: 0x04
DO ~~~~/tms470-func DeclareSector Type: FLASH  Start: 0x00010000   Length: 0x00008000   Control: 0xffe88000   Core: 0x00   Sector: 0x05
DO ~~~~/tms470-func DeclareSector Type: FLASH  Start: 0x00018000   Length: 0x00008000   Control: 0xffe88000   Core: 0x00   Sector: 0x06
DO ~~~~/tms470-func DeclareSector Type: FLASH  Start: 0x00020000   Length: 0x00008000   Control: 0xffe88000   Core: 0x00   Sector: 0x07
DO ~~~~/tms470-func DeclareSector Type: FLASH  Start: 0x00028000   Length: 0x00008000   Control: 0xffe88000   Core: 0x00   Sector: 0x08
DO ~~~~/tms470-func DeclareSector Type: FLASH  Start: 0x00030000   Length: 0x00008000   Control: 0xffe88000   Core: 0x00   Sector: 0x09
DO ~~~~/tms470-func DeclareSector Type: FLASH  Start: 0x00038000   Length: 0x00002000   Control: 0xffe88000   Core: 0x00   Sector: 0x0A
DO ~~~~/tms470-func DeclareSector Type: FLASH  Start: 0x0003A000   Length: 0x00002000   Control: 0xffe88000   Core: 0x00   Sector: 0x0B
DO ~~~~/tms470-func DeclareSector Type: FLASH  Start: 0x0003C000   Length: 0x00002000   Control: 0xffe88000   Core: 0x00   Sector: 0x0C
DO ~~~~/tms470-func DeclareSector Type: FLASH  Start: 0x0003E000   Length: 0x00002000   Control: 0xffe88000   Core: 0x00   Sector: 0x0D

DO ~~~~/tms470-func DeclareFlashAlgortihm &ProgRoutines &RamStart &RamSize &FlashClock_Frequency

;;;;;;;;;;;;;;;;;;;;;;;;;;;;;;;;;;;;;;;;;;;;;;;;;;
; End of flash.cfg
;;;;;;;;;;;;;;;;;;;;;;;;;;;;;;;;;;;;;;;;;;;;;;;;;;

; Flash script ends here if called with parameter PREPAREONLY
IF &param_prepareonly
  ENDDO PREPAREDONE
; --------------------------------------------------------------------------------
; Flash programming example

FLASH.List

DIALOG.YESNO "Program flash memory?"
ENTRY &progflash

IF &progflash 
(  
  FLASH.Erase ALL
  FLASH.Program ALL
  Data.LOAD.auto * /Long
  FLASH.Program off
)

ENDDO
