; --------------------------------------------------------------------------------
; @Title: Example for flash declaration of Fujitsu MB9AA30N series internal flash.
;
; @Description:
; Script arguments:
;
;   DO mb9aa30n [PREPAREONLY] [CPU=<cpu>]
;
;     PREPAREONLY only declares flash but does not execute flash programming
;
;     CPU=<cpu> selects CPU derivative <cpu>
;
; Example:
;
;   DO ~~/demo/arm/flash/mb9aa30n CPU=MB9AFA32N PREPAREONLY
;
; List of MB9AA30N series derivatives and their configuration:
;
;   CPU-Type   FlashSize   RamSize
;                 [kB]       [kB]
;   ------------------------------
;   MB9AFA31L      64.       12.
;   MB9AFA31M      64.       12.
;   MB9AFA31N      64.       12.
;   MB9AFA32L     128.       16.
;   MB9AFA32M     128.       16.
;   MB9AFA32N     128.       16.
;
; @Author: WRD
; @Copyright: (C) 1989-2014 Lauterbach GmbH, licensed for use with TRACE32(R) only
; @Chip: MB9AFA3??
; --------------------------------------------------------------------------------
; $Rev: 2881 $
; $Id: mb9aa30n.cmm 2881 2014-07-07 10:35:48Z kjmal $

  LOCAL &parameters &param_prepareonly
  ENTRY %LINE &parameters
  &param_prepareonly=(STRing.SCAN(STRing.UPpeR("&parameters"),"PREPAREONLY",0)!=-1)

  LOCAL &param_cpu
  &param_cpu=STRing.SCANAndExtract(STRing.UPpeR("&parameters"),"CPU=","")

  ; --------------------------------------------------------------------------------
  ; Start debugging

  IF SYStem.MODE()<5
  (
    Break.RESet
    SYStem.RESet

    IF "&param_cpu"!=""
      SYStem.CPU &param_cpu
    IF !CPUIS(MB9AFA3??)
      SYStem.CPU MB9AFA3*

    IF CABLE.TWOWIRE()
      SYStem.CONFIG.DEBUGPORTTYPE SWD
    ELSE
      SYStem.CONFIG.DEBUGPORTTYPE JTAG

    SYStem.Option.ResBreak OFF
    SYStem.Up
  )

  ; --------------------------------------------------------------------------------
  ; Flash declaration

  FLASH.RESet
  GOSUB FlashDeclaration

  ; --------------------------------------------------------------------------------
  ; Flash programming example

  ; Flash script ends here if called with parameter PREPAREONLY
  IF &param_prepareonly
    ENDDO PREPAREDONE

  DIALOG.YESNO "Program flash memory?"
  LOCAL &progflash
  ENTRY &progflash
  IF &progflash 
  (
    FLASH.ReProgram.ALL /Erase
    Data.LOAD.auto *
    FLASH.ReProgram.off

    ; Reset device
    SYStem.Down
    SYStem.Up
  )

  ENDDO


; --------------------------------------------------------------------------------
; Flash declaration depending on selected CPU 

FlashDeclaration:
  LOCAL &FlashSize

  IF CPUIS("MB9AFA31?")
  (
    &FlashSize=0x10000
  )
  ELSE IF CPUIS("MB9AFA32?")
  (
    &FlashSize=0x20000
  )
  ELSE
  (
    PRINT %ERROR "FLASH size of CPU type is unknown"
    ENDDO
  )

  IF &FlashSize>=0x10000
  (
    FLASH.Create 1. 0x000000--0x000FFF  0x1000 TARGET Word
    FLASH.Create 1. 0x001000--0x00FFFF  0xF000 TARGET Word
  )
  IF &FlashSize>=0x20000
  (
    FLASH.Create 1. 0x010000--0x01FFFF 0x10000 TARGET Word
  )

  FLASH.TARGET 0x20000000 0x20000800 0x1000 ~~/demo/arm/flash/word/fm3t3.bin

  RETURN
