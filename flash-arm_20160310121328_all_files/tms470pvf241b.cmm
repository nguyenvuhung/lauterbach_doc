; --------------------------------------------------------------------------------
; @Title: TMS470 internal flash of TMS470PVF241B/242B/243Bx
;
; @Description: 
; Script arguments:
;
;   DO tms470pvf241b [CPU=<cpu>|<cpu>] [PREPAREONLY]
;
;     CPU=<cpu> selects CPU derivative <cpu>
;     <cpu>     selects CPU derivative <cpu> (obsolete syntax)
;
;     PREPAREONLY only declares flash but does not execute flash programming
;
; Example:
;
;   DO ~~/demo/arm/flash/tms470pvf241b CPU=TMS470PVF241 PREPAREONLY
;
; internal flash is mapped to: 0x00000000
; internal RAM is mapped to:   0x08000000
;
; @Author: WRD
; @Copyright: (C) 1989-2014 Lauterbach GmbH, licensed for use with TRACE32(R) only
; --------------------------------------------------------------------------------
; $Rev: 3152 $
; $Id: tms470pvf241b.cmm 3152 2015-02-06 16:35:19Z kjmal $

LOCAL &parameters
ENTRY %LINE &parameters

LOCAL &cpu &param_prepareonly
&param_prepareonly=(STRing.SCAN(STRing.UPpeR("&parameters"),"PREPAREONLY",0)!=-1)
IF STRing.SCAN(STRing.UPpeR("&parameters"),"TMS470PVF242",0)!=-1
  &cpu="TMS470PVF242"
ELSE IF STRing.SCAN(STRing.UPpeR("&parameters"),"TMS470PVF243",0)!=-1
  &cpu="TMS470PVF243"
ELSE
  &cpu="TMS470PVF241"
  
; --------------------------------------------------------------------------------
; Init script variables

DO ~~~~/tms470-func Init

; --------------------------------------------------------------------------------
; Setup CPU
IF SYStem.MODE()<5
(
  SYStem.RESet
  SYStem.CPU &cpu
  SYStem.Option.BigEndian ON
  SYStem.Up
)

; --------------------------------------------------------------------------------
; Flash configuration and declaration generated out of flash470.cfg file

;;;;;;;;;;;;;;;;;;;;;;;;;;;;;;;;;;;;;;;;;;;;;;;;;;
; Config for TMS470PVF241B/242B/243Bx Rev A & B
;;;;;;;;;;;;;;;;;;;;;;;;;;;;;;;;;;;;;;;;;;;;;;;;;;
; actual device ID is 0x801621xx (Unique id is bits 30-17, revision is bits 7-3)
;;;;;;;;;;;;;;;;;;;;;;;;;;;;;;;;;;;;;;;;;;;;;;;;;;
;Device_ID=0x000b        ; TMS470PVF241B/242B/243Bx
;  ProgVersion: 0.33 ; Library Version
LOCAL &ProgRoutines
&ProgRoutines="pf05a"

;  Frequency: 24.0 Range: 10.0 - 24.0
;  Minor Revisions: 1
;    0 "TMS470PVF241B/242B/243Bx Rev 0"
;  Ram Config: 0x08000000 0x00003000 ; 12KB
LOCAL &RamStart &RamSize
RamStart=0x08000000
&RamSize=0x00003000

;  Initialization: 3
Data.Set 0xffffff74 %Long 0x00000000 ; FMENA off
Data.Set 0xfff87100 %Long 0x00000000 ; disable pipeline mode
Data.Set 0xffffffc4 %Long 0x0000000a ; MEMSW='1010' => Flash at 0x00000000, RAM at 0x08000000)

;  PLL Config: 0xffffff70 0x00000704 0x00c01f0f ; configure FMZPLL *8/5 (assuming 15.0 Mhz OSCIN)
Data.Set 0xffffff70 %Long 0x00000707 ; configure PLL *8/8
LOCAL &FlashClock_Frequency
&FlashClock_Frequency="15MHz"      ; Setup flash clock frequency to PLL frequency

;  Engr ID: 0xfff87000 0x00000000
;  Aux Engr ID: 0xfff87000 0x00000100 0x00c0 ; 192KB
;  Protection Keys:
;    0xfff87000 0x00003ff0: 0xffffffff 0xffffffff 0xffffffff 0xffffffff
DO ~~~~/tms470-func FlashProtection 0xfff87000 0x00003ff0 0xffffffff 0xffffffff 0xffffffff 0xffffffff

;  Number of Blocks: 8
FLASH.RESet
DO ~~~~/tms470-func DeclareSector Type: OTP    Start: 0x00000000   Length: 0x00000800   Control: 0xfff87000   Core: 0x00   Sector: 0x00
DO ~~~~/tms470-func DeclareSector Type: FLASH  Start: 0x00000000   Length: 0x00004000   Control: 0xfff87000   Core: 0x00   Sector: 0x00
DO ~~~~/tms470-func DeclareSector Type: FLASH  Start: 0x00004000   Length: 0x00004000   Control: 0xfff87000   Core: 0x00   Sector: 0x01
DO ~~~~/tms470-func DeclareSector Type: FLASH  Start: 0x00008000   Length: 0x00008000   Control: 0xfff87000   Core: 0x00   Sector: 0x02
DO ~~~~/tms470-func DeclareSector Type: FLASH  Start: 0x00010000   Length: 0x00008000   Control: 0xfff87000   Core: 0x00   Sector: 0x03
DO ~~~~/tms470-func DeclareSector Type: FLASH  Start: 0x00018000   Length: 0x00008000   Control: 0xfff87000   Core: 0x00   Sector: 0x04
DO ~~~~/tms470-func DeclareSector Type: FLASH  Start: 0x00020000   Length: 0x00008000   Control: 0xfff87000   Core: 0x00   Sector: 0x05
DO ~~~~/tms470-func DeclareSector Type: FLASH  Start: 0x00028000   Length: 0x00008000   Control: 0xfff87000   Core: 0x00   Sector: 0x06

DO ~~~~/tms470-func DeclareFlashAlgortihm &ProgRoutines &RamStart &RamSize &FlashClock_Frequency

;;;;;;;;;;;;;;;;;;;;;;;;;;;;;;;;;;;;;;;;;;;;;;;;;;
; End of flash.cfg
;;;;;;;;;;;;;;;;;;;;;;;;;;;;;;;;;;;;;;;;;;;;;;;;;;

; Flash script ends here if called with parameter PREPAREONLY
IF &param_prepareonly
  ENDDO PREPAREDONE

; --------------------------------------------------------------------------------
; Flash programming example

FLASH.List

DIALOG.YESNO "Program flash memory?"
ENTRY &progflash

IF &progflash 
(  
  FLASH.Erase ALL
  FLASH.Program ALL
  Data.LOAD.auto * /Long
  FLASH.Program off
  Data.LOAD.auto * /ComPare
)

ENDDO
