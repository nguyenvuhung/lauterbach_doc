; --------------------------------------------------------------------------------
; @Title: Generic script for Fujitsu MB9A100 and MB9A100A series internal flash
;
; @Description: 
; Example for flash declaration of Fujitsu MB9A100 and MB9A100A series
; internal flash.
;
; Script arguments:
;
;   DO mb9a100 [PREPAREONLY] [CPU=<cpu>]
;
;     PREPAREONLY only declares flash but does not execute flash programming
;
;     CPU=<cpu> selects CPU derivative <cpu>
;
; Example:
;
;   DO ~~/demo/arm/flash/mb9a100 CPU=MB9AF105N PREPAREONLY
;
; List of MB9A100 and MB9A100A series derivatives and their configuration:
;
;   CPU-Type   Derivatives   FlashSize   RamSize
;                               [kB]       [kB]
; --------------------------------------------------------------------------------
;   MB9AF102N  MB9AF102N        128.       16.
;              MB9AF102NA
;   MB9AF102R  MB9AF102R        128.       16.
;              MB9AF102RA
;   MB9AF104N  MB9AF104N        256.       32.
;              MB9AF104NA
;   MB9AF104R  MB9AF104R        256.       32.
;              MB9AF104RA
;   MB9AF105N  MB9AF105NA       384.       48.
;   MB9AF105R  MB9AF105RA       384.       48.
;
; @Author: WRD
; @Copyright: (C) 1989-2014 Lauterbach GmbH, licensed for use with TRACE32(R) only
; @Chip: MB9AF10* 
; --------------------------------------------------------------------------------
; $Rev: 3513 $
; $Id: mb9a100.cmm 3513 2015-12-02 16:10:14Z fcaron $

  LOCAL &parameters &param_prepareonly
  ENTRY %LINE &parameters
  &param_prepareonly=(STRing.SCAN(STRing.UPpeR("&parameters"),"PREPAREONLY",0)!=-1)

  LOCAL &param_cpu
  &param_cpu=STRing.SCANAndExtract(STRing.UPpeR("&parameters"),"CPU=","")

  ; ------------------------------------------------------------------------------
  ; Start debugging

  IF SYStem.MODE()<5
  (
    Break.RESet
    SYStem.RESet

    IF "&param_cpu"!=""
      SYStem.CPU &param_cpu
    IF !CPUIS(MB9AF10*)
      SYStem.CPU MB9AF10*

    IF CABLE.TWOWIRE()
      SYStem.CONFIG.DEBUGPORTTYPE SWD
    ELSE
      SYStem.CONFIG.DEBUGPORTTYPE JTAG

    SYStem.Option.ResBreak OFF
    SYStem.Up
  )

  ; ------------------------------------------------------------------------------
  ; Flash declaration

  FLASH.RESet
  GOSUB FlashDeclaration

  ; ------------------------------------------------------------------------------
  ; Flash programming example

  ; Flash script ends here if called with parameter PREPAREONLY
  IF &param_prepareonly
    ENDDO PREPAREDONE

  DIALOG.YESNO "Program flash memory?"
  LOCAL &progflash
  ENTRY &progflash
  IF &progflash 
  (
    FLASH.ReProgram.ALL /Erase
    Data.LOAD.auto *
    FLASH.ReProgram.off

    ; Reset device
    SYStem.Down
    SYStem.Up
  )

  ENDDO


; --------------------------------------------------------------------------------
; Flash declaration depending on selected CPU 

FlashDeclaration:
  LOCAL &FlashSize

  IF CPUIS("MB9AF102?")
  (
    &FlashSize=0x20000
  )
  ELSE IF CPUIS("MB9AF104?")
  (
    &FlashSize=0x40000
  )              
  ELSE IF CPUIS("MB9AF105*")
  (
    &FlashSize=0x60000
  )
  ELSE
  (
    PRINT %ERROR "FLASH size of CPU type is unknown"
    ENDDO
  )

  IF &FlashSize>=0x20000
  (
    FLASH.Create 1. 0x000000--0x007FFF  0x4000 TARGET Word
    FLASH.Create 1. 0x008000--0x01FFFF 0x18000 TARGET Word
  )
  IF &FlashSize>=0x40000
  (
    FLASH.Create 1. 0x020000--0x03FFFF 0x20000 TARGET Word
  )
  IF &FlashSize>=0x60000
  (
    FLASH.Create 1. 0x040000--0x05FFFF 0x20000 TARGET Word
  )

  FLASH.TARGET 0x1FFFF000 0x20000000 0x1000 ~~/demo/arm/flash/word/fm3t0.bin

  RETURN
