; --------------------------------------------------------------------------------
; @Title: Generic script for Freescale MK20, MK21, MK22 and MK26 internal flash
;
; @Description:
;
; Example for flash declaration of Freescale MK20, MK21, MK22 and MK26 internal
; flash.
;
; Script arguments:
;
;   DO mk20 [PREPAREONLY] [CPU=<cpu>] [DUALPORT=0|1] [MASSERASE]
;
;     PREPAREONLY only declares flash but does not execute flash programming
;
;     CPU=<cpu> selects CPU derivative <cpu>. <cpu> can be CPU name out of the
;             table listed below. For these derivatives the flash declaration
;             is done by the script.
;
;     DUALPORT default value is 0 (disabled). If DualPort mode is enabled
;             flash algorithm stays running until flash programming is
;             finished. Data is tranferred via dual port memory access. 
;
;     MASSERASE forces mass erase of device before establishing debug connection
;
; For example:
;
;   DO ~~/demo/arm/flash/mk20 CPU=MK20DN512VLK10 DUALPORT=1 PREPAREONLY
;
; List of MK20/MK21/MK22/MK26 derivatives and their configuration:
;
;   CPU-Type       Flash   ProgFlash   FlexNVM   EEPROM   RamSize
;                   type     [Byte]     [Byte]    [Byte]   [Byte]
; --------------------------------------------------------------------------------
;   MK20DN32VEX5      0       32KB          -         -      8KB
;   MK20DN32VFM5      0       32KB          -         -      8KB
;   MK20DN32VFT5      0       32KB          -         -      8KB
;   MK20DN32VLF5      0       32KB          -         -      8KB
;   MK20DN32VLH5      0       32KB          -         -      8KB
;   MK20DX32VEX5      0       32KB       32KB       2KB      8KB
;   MK20DX32VFM5      0       32KB       32KB       2KB      8KB
;   MK20DX32VFT5      0       32KB       32KB       2KB      8KB
;   MK20DX32VLF5      0       32KB       32KB       2KB      8KB
;   MK20DX32VLH5      0       32KB       32KB       2KB      8KB
;   MK20DN64VEX5      0       64KB          -         -     16KB
;   MK20DN64VFM5      0       64KB          -         -     16KB
;   MK20DN64VFT5      0       64KB          -         -     16KB
;   MK20DN64VLF5      0       64KB          -         -     16KB
;   MK20DN64VLH5      0       64KB          -         -     16KB
;   MK20DX64VEX5      0       64KB       32KB       2KB     16KB
;   MK20DX64VEX7      1       64KB       32KB       2KB     16KB
;   MK20DX64VFM5      0       64KB       32KB       2KB     16KB
;   MK20DX64VFT5      0       64KB       32KB       2KB     16KB
;   MK20DX64VLF5      0       64KB       32KB       2KB     16KB
;   MK20DX64VLH5      0       64KB       32KB       2KB     16KB
;   MK20DX64VLH7      1       64KB       32KB       2KB     16KB
;   MK20DX64VLK7      1       64KB       32KB       2KB     16KB
;   MK20DX64VMB7      1       64KB       32KB       2KB     16KB
;   MK20DN128VEX5     0      128KB          -         -     16KB
;   MK20DN128VFM5     0      128KB          -         -     16KB
;   MK20DN128VFT5     0      128KB          -         -     16KB
;   MK20DN128VLF5     0      128KB          -         -     16KB
;   MK20DN128VLH5     0      128KB          -         -     16KB
;   MK20DX128VEX5     0      128KB       32KB       2KB     16KB
;   MK20DX128VEX7     1      128KB       32KB       2KB     32KB
;   MK20DX128VFM5     0      128KB       32KB       2KB     16KB
;   MK20DX128VFT5     0      128KB       32KB       2KB     16KB
;   MK20DX128VLF5     0      128KB       32KB       2KB     16KB
;   MK20DX128VLH5     0      128KB       32KB       2KB     16KB
;   MK20DX128VLH7     1      128KB       32KB       2KB     32KB
;   MK20DX128VLK7     1      128KB       32KB       2KB     32KB
;   MK20DX128VLL7     1      128KB       32KB       2KB     32KB
;   MK20DX128VLQ10   2X      128KB      128KB       4KB     32KB
;   MK20DX128VMB7     1      128KB       32KB       2KB     32KB
;   MK20DX128VMD10   2X      128KB      128KB       4KB     32KB
;   MK20DX128VML7     1      128KB       32KB       2KB     32KB
;   MK20DX256VEX7     1      256KB       32KB       2KB     64KB
;   MK20DX256VLH7     1      256KB       32KB       2KB     64KB
;   MK20DX256VLK10   2X      256KB      256KB       4KB     64KB
;   MK20DX256VLK7     1      256KB       32KB       2KB     64KB
;   MK20DX256VLL10   2X      256KB      256KB       4KB     64KB
;   MK20DX256VLL7     1      256KB       32KB       2KB     64KB
;   MK20DX256VLQ10   2X      256KB      256KB       4KB     64KB
;   MK20DX256VMB10   2X      256KB      256KB       4KB     64KB
;   MK20DX256VMB7     1      256KB       32KB       2KB     64KB
;   MK20DX256VMC10   2X      256KB      256KB       4KB     64KB
;   MK20DX256VMD10   2X      256KB      256KB       4KB     64KB
;   MK20DX256VML7     1      256KB       32KB       2KB     64KB
;   MK20DN512VLK10   2N      512KB          -         -    128KB
;   MK20DN512VLL10   2N      512KB          -         -    128KB
;   MK20DN512VLQ10   2N      512KB          -         -    128KB
;   MK20DN512VMB10   2N      512KB          -         -    128KB
;   MK20DN512VMC10   2N      512KB          -         -    128KB
;   MK20DN512VMD10   2N      512KB          -         -    128KB
;   MK20FX512VLQ12   3X      512KB      512KB      16KB    128KB
;   MK20FX512VMD12   3X      512KB      512KB      16KB    128KB
;   MK20FN1M0VLQ12   3N        1MB          -         -    128KB
;   MK20FN1M0VMD12   3N        1MB          -         -    128KB
; --------------------------------------------------------------------------------
;
;   MK21DX128VLK5    4X      128KB       64KB       4KB     32KB
;   MK21DX128AVLK5   4X      128KB       64KB       4KB     32KB
;   MK21DX128VMC5    4X      128KB       64KB       4KB     32KB
;   MK21DX128AVMC5   4X      128KB       64KB       4KB     32KB
;   MK21DX256VLK5    4X      256KB       64KB       4KB     32KB
;   MK21DX256AVLK5   4X      256KB       64KB       4KB     32KB
;   MK21DX256VMC5    4X      256KB       64KB       4KB     32KB
;   MK21DX256AVMC5   4X      256KB       64KB       4KB     32KB
;   MK21DN512VLK5    4N      512KB          -         -     64KB
;   MK21DN512AVLK5   4N      512KB          -         -     64KB
;   MK21DN512VMC5    4N      512KB          -         -     64KB
;   MK21DN512AVMC5   4N      512KB          -         -     64KB
;   MK21FX512VMC10   5X      512KB      128KB       4KB     64KB
; //MK21FX512VMD10
;   MK21FN1M0VMC10   3N        1MB          -         -    128KB
; //MK21FN1M0VMD10
; --------------------------------------------------------------------------------
;   MK22DX128VLF5    4X      128KB       64KB       4KB     32KB
;   MK22DX128VLH5    4X      128KB       64KB       4KB     32KB
;   MK22DX128VLK5    4X      128KB       64KB       4KB     32KB
;   MK22DX128VMC5    4X      128KB       64KB       4KB     32KB
;   MK22DX256VLF5    4X      256KB       64KB       4KB     32KB
;   MK22DX256VLH5    4X      256KB       64KB       4KB     32KB
;   MK22DX256VLK5    4X      256KB       64KB       4KB     32KB
;   MK22DX256VMC5    4X      256KB       64KB       4KB     32KB
;   MK22DN512VLH5    4N      512KB          -         -     64KB
;   MK22DN512VLK5    4N      512KB          -         -     64KB
;   MK22DN512VMC5    4N      512KB          -         -     64KB
;   MK22FX512VMC10   5X      512KB      128KB       4KB     64KB
;   MK22FN128VDC10   2N      128KB          -         -     24KB
;   MK22FN128VLH10   2N      128KB          -         -     24KB
;   MK22FN128VLL10   2N      128KB          -         -     24KB
;   MK22FN128VMP10   2N      128KB          -         -     24KB
;   MK22FN256VDC12   4N      256KB          -         -     48KB
;   MK22FN256VDC12   4N      256KB          -         -     48KB
;   MK22FN256VLL12   4N      256KB          -         -     48KB
;   MK22FN256VLL12   4N      256KB          -         -     48KB
;   MK22FN512VDC12   4N      512KB          -         -    128KB
;   MK22FN512VLH12   4N      512KB          -         -    128KB
;   MK22FN512VLL12   4N      512KB          -         -    128KB
;   MK22FN512VMP12   4N      512KB          -         -    128KB
;   MK22FX512VLH12   5X      512KB      128KB       4KB    128KB
;   MK22FX512VLK12   5X      512KB      128KB       4KB    128KB
;   MK22FX512VLL12   5X      512KB      128KB       4KB    128KB
;   MK22FX512VMC12   5X      512KB      128KB       4KB    128KB
;   MK22FX512VLQ12   5X      512KB      128KB       4KB    128KB
;   MK22FX512VMD12   5X      512KB      128KB       4KB    128KB
; //MK22FN1M0VLH10
; //MK22FN1M0VLK10
; //MK22FN1M0VLL10
; //MK22FN1M0VLQ10
;   MK22FN1M0VLH12   3N        1MB          -         -    128KB
;   MK22FN1M0VMC10   3N        1MB          -         -    128KB
; --------------------------------------------------------------------------------
;   MK26FN2M0CAC18R  5N        2MB          -         -    256KB
;   MK26FN2M0VLQ18   5N        2MB          -         -    256KB       
;   MK26FN2M0VMD18   5N        2MB          -         -    256KB
;   MK26FN2M0VMI18   5N        2MB          -         -    256KB
;
; Flash Configuration Field:
;
;   Byte address    Width   Description
; --------------------------------------------------------------------------------
;   0x0400--0x0407    8    Backdoor Comparison Key.
;   0x0408--0x040B    4    Program flash protection bytes (FPROT0-3).
;   0x040F            1    Program flash only devices: Reserved
;                          FlexNVM devices: Data flash protection byte
;                          (FDPROT).
;   0x040E            1    Program flash only devices: Reserved
;                          FlexNVM devices: EEPROM protection byte
;                          (FEPROT).
;   0x040D            1    Flash nonvolatile option byte (FOPT).
;   0x040C            1    Flash security byte (FSEC).
;
;   Flash Configuration Field can be programmed using FLASH.AUTO command 
;   with /CENSORSHIP option.
;
; @Chip: MK20* MK21* MK22* MK26*
; @Author: WRD
; @Copyright: (C) 1989-2015 Lauterbach GmbH, licensed for use with TRACE32(R) only
; --------------------------------------------------------------------------------
; $Rev: 3524 $
; $Id: mk20.cmm 3524 2015-12-09 14:37:14Z fcaron $
;

  LOCAL &parameters
  ENTRY %LINE &parameters

  LOCAL &param_prepareonly &param_masserase
  &param_prepareonly=(STRing.SCAN(STRing.UPpeR("&parameters"),"PREPAREONLY",0)!=-1)
  &param_masserase=(STRing.SCAN(STRing.UPpeR("&parameters"),"MASSERASE",0)!=-1)

  LOCAL &param_cpu
  &param_cpu=STRing.SCANAndExtract(STRing.UPpeR("&parameters"),"CPU=","")
  IF "&param_cpu"==""
  (
    ; For script backward compatibility
    &param_cpu=STRing.SCANAndExtract(STRing.UPpeR("&parameters"),"MK2","")
    IF "&param_cpu"!=""
      &param_cpu="MK2"+"&param_cpu"
    ELSE
    (
      &param_cpu=STRing.SCANAndExtract(STRing.UPpeR("&parameters"),"K20","")
      IF "&param_cpu"!=""
        &param_cpu="K20"+"&param_cpu"
    )
  )

  LOCAL &param_dualport
  &param_dualport=0
  IF VERSION.BUILD.BASE()>=43441.
    &param_dualport=STRing.SCANAndExtract(STRing.UPpeR("&parameters"),"DUALPORT=","0")

  ; ------------------------------------------------------------------------------
  ; Setup CPU

  IF (SYStem.MODE()<5)||&param_masserase
  (
    SYStem.RESet

    IF "&param_cpu"!=""
      SYStem.CPU &param_cpu
    IF !CPUIS(MK2*)&&!CPUIS(K20*)
      SYStem.CPU MK2*

    IF CABLE.TWOWIRE()
      SYStem.CONFIG.DEBUGPORTTYPE SWD
    ELSE
      SYStem.CONFIG.DEBUGPORTTYPE JTAG

    IF &param_masserase
      GOSUB MassErase

    ON.ERROR GOSUB Unsecure
    SYStem.Up
    ON.ERROR
  )

  ; Unsecure device
  IF VERSION.BUILD()>=34133.
  (
    IF (Data.Long(EDBG:0x40000100)&0x04)==0x04
      GOSUB Unsecure
  )

  ; Disable watchdog
  ON.ERROR GOSUB Unsecure
  GOSUB DisableWatchdog
  ON.ERROR

  ; ------------------------------------------------------------------------------
  ; Flash declaration

  FLASH.RESet
  GOSUB FlashDeclaration &param_dualport

  ; Flash script ends here if called with parameter PREPAREONLY
  IF &param_prepareonly
    ENDDO PREPAREDONE

  ; ------------------------------------------------------------------------------
  ; Flash programming example

  DIALOG.YESNO "Program flash memory?"
  LOCAL &progflash
  ENTRY &progflash
  IF &progflash 
  (
    FLASH.ReProgram.ALL /Erase
    Data.LOAD.auto *
    FLASH.ReProgram.off

    ; Reset device
    SYStem.Down
    SYStem.Up

    ; Disable watchdog
    GOSUB DisableWatchdog
  )

  ENDDO


; --------------------------------------------------------------------------------
; Disable watchdog

DisableWatchdog:

  LOCAL &tmp1 &tmp2
  &tmp1=Data.Long(ST:0x20000000)
  &tmp2=Data.Long(ST:0x20000004)

  ; The watchdog has a restrictive timing. It has to be configured and unlocked within a peripod
  ; of 20+256 cycles. Therefor the unlock sequence need to be done by a small target program.
  Data.Assemble ST:0x20000000  strh r1,[r0]  ;SD:0x4005200E = 0xC520   (Key 1)
  Data.Assemble ,              strh r2,[r0]  ;SD:0x4005200E = 0xD928   (Key 2)
  Data.Assemble ,              strh r4,[r3]  ;SD:0x40052000 = 0x0000   (Config register)
  Data.Assemble ,              bkpt #0
  Register.Set PC 0x20000000
  Register.Set R0 0x4005200E
  Register.Set R1 0xC520
  Register.Set R2 0xD928
  Register.Set R3 0x40052000
  Register.Set R4 0x0
  Go.direct
  WAIT !RUN()

  Data.Set ST:0x20000000 %Long &tmp1
  Data.Set ST:0x20000004 %Long &tmp2

  RETURN


; --------------------------------------------------------------------------------
; Try to unsecure a secured device

Unsecure:
  IF VERSION.BUILD()<48722.
    DO ~~~~/kinetis-unsecure
  ELSE
  (
    ; Print security state information
    SYStem.Mode.Prepare
    PRINT "MDM-AP Status Register is 0x" Data.Long(EDBG:0x40000100)

    DIALOG.YESNO "Execute mass erase to unsecure chip?"
    LOCAL &masserase
    ENTRY &masserase
    IF &masserase
    (
      ON.ERROR DEFault

      ; Unsecure device
      SYStem.Down
      FLASH.UNSECUREerase
      SYStem.Mode.Prepare
      IF (Data.Long(EDBG:0x40000100)&0x04)==0x04
      (
        PRINT %ERROR "Unsecure failed, MDM-AP Status Register is 0x" Data.Long(EDBG:0x40000100)
        SYStem.Down
        ENDDO
      )
    )
    ELSE
      ENDDO
  )

  SYStem.Up

  ; Disable watchdog
  GOSUB DisableWatchdog

  RETURN


; --------------------------------------------------------------------------------
; Try to mass erase the device

MassErase:
  IF VERSION.BUILD.BASE()<49714.
    DO ~~~~/kinetis-unsecure
  ELSE
  (
    ; Mass erase device by unsecure command
    SYStem.Down
    FLASH.UNSECUREerase
    SYStem.Mode.Prepare
    IF (Data.Long(EDBG:0x40000100)&0x24)!=0x20
    (
      PRINT %ERROR "Mass erase failed, MDM-AP Status Register is 0x" Data.Long(EDBG:0x40000100)
      SYStem.Down
      ENDDO
    )
  )

  RETURN


; --------------------------------------------------------------------------------
; Flash declaration depending on selected CPU 

FlashDeclaration:
  LOCAL &DualPort
  ENTRY &DualPort

  LOCAL &PFlashSize &FlexNVMSize
  LOCAL &PSectorSize &DSectorSize
  LOCAL &flashdriver
  ;LOCAL &EEPROMSize

  &FlexNVMSize=0x0
  &DSectorSize=0x0
  ;&EEPROMSize=0x0
  &flashdriver="t.b.d."

  ; Setup configuration values
  IF CPUIS("MK20DN32V??5")||CPUIS("K20N32VYY50")
  (
    &PFlashSize=0x8000
    &PSectorSize=0x400
    &flashdriver="ftfl0n.bin"
  )
  ELSE IF CPUIS("MK20DX32V??5")||CPUIS("K20X32VYY50")
  (
    &PFlashSize=0x8000
    &PSectorSize=0x400
    &FlexNVMSize=0x8000
    &DSectorSize=0x400
    ;&EEPROMSize=0x800
    &flashdriver="ftfl0x.bin"
  )
  ELSE IF CPUIS("MK20DN64V??5")||CPUIS("K20N64VYY50")
  (
    &PFlashSize=0x10000
    &PSectorSize=0x400
    &flashdriver="ftfl0n.bin"
  )
  ELSE IF CPUIS("MK20DX64V??5")||CPUIS("K20X64VYY50")
  (
    &PFlashSize=0x10000
    &PSectorSize=0x400
    &FlexNVMSize=0x8000
    &DSectorSize=0x400
    ;&EEPROMSize=0x800
    &flashdriver="ftfl0n.bin"
  )
  ELSE IF CPUIS("MK20DX64V??7")
  (
    &PFlashSize=0x10000
    &PSectorSize=0x800
    &FlexNVMSize=0x8000
    &DSectorSize=0x400
    ;&EEPROMSize=0x800
    &flashdriver="ftfl1x.bin"
  )
  ELSE IF CPUIS("MK20DN128V??5")
  (
    &PFlashSize=0x20000
    &PSectorSize=0x400
    &flashdriver="ftfl0n.bin"
  )
  ELSE IF CPUIS("MK20DX128V??5")||CPUIS("K20X128VYY50")
  (
    &PFlashSize=0x20000
    &PSectorSize=0x400
    &FlexNVMSize=0x8000
    &DSectorSize=0x400
    ;&EEPROMSize=0x800
    &flashdriver="ftfl0x.bin"
  )
  ELSE IF CPUIS("MK21DX128*V??5")||CPUIS("MK22DX128*V??5")
  (
    &PFlashSize=0x20000
    &PSectorSize=0x800
    &FlexNVMSize=0x10000
    &DSectorSize=0x800
    ;&EEPROMSize=0x1000
    &flashdriver="ftfl4x.bin"
  )
  ELSE IF CPUIS("MK20DX128V??7")||CPUIS("K20X128VYY72")
  (
    &PFlashSize=0x20000
    &PSectorSize=0x800
    &FlexNVMSize=0x8000
    &DSectorSize=0x400
    ;&EEPROMSize=0x800
    &flashdriver="ftfl1x.bin"
  )
  ELSE IF CPUIS("MK20DN128V??10")||CPUIS("MK22FN128V??10")
  (
    &PFlashSize=0x20000
    &PSectorSize=0x800
    &flashdriver="ftfl2n.bin"
  )
  ELSE IF CPUIS("MK20DX128V??10")||CPUIS("K20X128VYY100")
  (
    &PFlashSize=0x20000
    &PSectorSize=0x800
    &FlexNVMSize=0x20000
    &DSectorSize=0x800
    ;&EEPROMSize=0x1000
    &flashdriver="ftfl2x.bin"
  )
  ELSE IF CPUIS("MK22FN256V??12")
  (
    &PFlashSize=0x40000
    &PSectorSize=0x800
    &flashdriver="ftfl4n.bin"
  )
  ELSE IF CPUIS("MK21DX256*V??5")||CPUIS("MK22DX256*V??5")
  (
    &PFlashSize=0x40000
    &PSectorSize=0x800
    &FlexNVMSize=0x10000
    &DSectorSize=0x800
    ;&EEPROMSize=0x1000
    &flashdriver="ftfl4x.bin"
  )
  ELSE IF CPUIS("MK20DX256V??7")||CPUIS("K20X256VYY72")
  (
    &PFlashSize=0x40000
    &PSectorSize=0x800
    &FlexNVMSize=0x8000
    &DSectorSize=0x400
    ;&EEPROMSize=0x1000
    &flashdriver="ftfl1x.bin"
  )
  ELSE IF CPUIS("MK20DX256V??10")||CPUIS("K20X256VYY100")
  (
    &PFlashSize=0x40000
    &PSectorSize=0x800
    &FlexNVMSize=0x40000
    &DSectorSize=0x800
    ;&EEPROMSize=0x1000
    &flashdriver="ftfl2x.bin"
  )
  ELSE IF CPUIS("MK20DN512*")||CPUIS("K20N512VYY100")
  (
    &PFlashSize=0x80000
    &PSectorSize=0x800
    &flashdriver="ftfl2n.bin"
  )
  ELSE IF CPUIS("MK21DN512*V??5")||CPUIS("MK22DN512*V??5")||CPUIS("MK22FN512V??12")
  (
    &PFlashSize=0x80000
    &PSectorSize=0x800
    &flashdriver="ftfl4n.bin"
  )
  ELSE IF CPUIS("MK20FX512*")||CPUIS("K20X512VYY120")
  (
    &PFlashSize=0x80000
    &PSectorSize=0x1000
    &FlexNVMSize=0x80000
    &DSectorSize=0x1000
    ;&EEPROMSize=0x4000
    &flashdriver="ftfe3x.bin"
  )
  ELSE IF CPUIS("MK21FX512*")||CPUIS("MK22FX512V??12")
  (
    &PFlashSize=0x80000
    &PSectorSize=0x1000
    &FlexNVMSize=0x20000
    &DSectorSize=0x1000
    ;&EEPROMSize=0x1000
    &flashdriver="ftfe5x.bin"
  )
  ELSE IF CPUIS("MK20FN1M0*")||CPUIS("K20N1M0VYY120")||CPUIS("MK21FN1M0*")||CPUIS("MK22FN1M0*")
  (
    &PFlashSize=0x100000
    &PSectorSize=0x1000
    &flashdriver="ftfe3n.bin"
  )
  ELSE IF CPUIS("MK26*")
  (
    &PFlashSize=0x200000
    &PSectorSize=0x1000
    &flashdriver="ftfe5n.bin"
  )
  ELSE
  (
    PRINT %ERROR "FLASH size of CPU type is not supported by the script"
    ENDDO
  )

  IF ("&flashdriver"=="ftfe3n.bin")||("&flashdriver"=="ftfe3x.bin")||("&flashdriver"=="ftfe5n.bin")||("&flashdriver"=="ftfe5x.bin")
  (
    ; Program Flash
    IF &PFlashSize>=0x80000
    (
      FLASH.Create 1. 0x00000000--0x0003FFFF 0x1000 TARGET Quad
      FLASH.Create 2. 0x00040000--0x0007FFFF 0x1000 TARGET Quad
    )
    IF &PFlashSize>=0x100000
    (
      FLASH.Create 3. 0x00080000--0x000BFFFF 0x1000 TARGET Quad
      FLASH.Create 4. 0x000C0000--0x000FFFFF 0x1000 TARGET Quad
    )
    IF &PFlashSize>=0x200000
    (
      FLASH.Create 5. 0x00100000--0x0017FFFF 0x1000 TARGET Quad
      FLASH.Create 6. 0x00180000--0x001FFFFF 0x1000 TARGET Quad
    )

    ; FlexNVM
    IF &FlexNVMSize>=0x20000
      FLASH.Create 3. 0x10000000--0x1001FFFF 0x1000 TARGET Quad
    IF &FlexNVMSize>=0x80000
    (
      FLASH.Create 3. 0x10020000--0x1003FFFF 0x1000 TARGET Quad
      FLASH.Create 4. 0x10040000--0x1007FFFF 0x1000 TARGET Quad
    )

    ; EEPROM
    ; preliminary not supported
    ;IF &EEPROMSize>=0x4000
    ;  FLASH.Create 5. 0x14000000--0x14003FFF "t.b.d." TARGET Quad

    IF &DualPort==0
      FLASH.TARGET 0x1FFFF000 0x20000000 0x1000 ~~/demo/arm/flash/quad/&flashdriver
    ELSE
      FLASH.TARGET 0x1FFFF000 EAHB:0x20000000 0x1000 ~~/demo/arm/flash/quad/&flashdriver /DualPort
  )
  ELSE
  (
    ; Program Flash
    IF &PFlashSize>=0x8000
      FLASH.Create 1. 0x00000000--0x00007FFF &PSectorSize TARGET Long
    IF &PFlashSize>=0x10000
      FLASH.Create 1. 0x00008000--0x0000FFFF &PSectorSize TARGET Long
    IF &PFlashSize>=0x20000
      FLASH.Create 1. 0x00010000--0x0001FFFF &PSectorSize TARGET Long
    IF &PFlashSize>=0x40000
      FLASH.Create 1. 0x00020000--0x0003FFFF &PSectorSize TARGET Long
    IF &PFlashSize>=0x80000
      FLASH.Create 2. 0x00040000--0x0007FFFF &PSectorSize TARGET Long

    ; FlexNVM
    IF &FlexNVMSize>=0x8000
      FLASH.Create 2. 0x10000000--0x10007FFF &DSectorSize TARGET Long
    IF &FlexNVMSize>=0x20000
      FLASH.Create 2. 0x10008000--0x1001FFFF &DSectorSize TARGET Long
    IF &FlexNVMSize>=0x40000
      FLASH.Create 2. 0x10020000--0x1003FFFF &DSectorSize TARGET Long

    ; EEPROM
    ; preliminary not supported
    ;IF &EEPROMSize>=0x800
    ;  FLASH.Create 3. 0x14000000--0x140007ff "t.b.d." TARGET Long
    ;IF &EEPROMSize>=0x1000
    ;  FLASH.Create 3. 0x14000800--0x14000fff "t.b.d." TARGET Long

    IF &DualPort==0
      FLASH.TARGET 0x1FFFF000 0x20000000 &PSectorSize ~~/demo/arm/flash/long/&flashdriver
    ELSE
      FLASH.TARGET 0x1FFFF000 EAHB:0x20000000 &PSectorSize ~~/demo/arm/flash/long/&flashdriver /DualPort
  )

  RETURN
