; --------------------------------------------------------------------------------
; @Title: Setup of TMS570LS21xx internal flash
;
; @Description:
; Script arguments:
;
;  do tms570ls21xx [AUTOECC=0|1] [PREPAREONLY]
;
;   AUTOECC default value is 1
;
;   PREPAREONLY only declares flash but does not execute flash programming example
;
; List of TMS570LS21xx derivatives and their configuration:
;
;   CPU-Type           Flash    RAM
;   --------------------------------
;   TMS570LS2124-PGE    2MB    192kB
;   TMS570LS2124-ZWT    2MB    192kB
;   TMS570LS2125-PGE    2MB    192kB
;   TMS570LS2125-ZWT    2MB    192kB
;   TMS570LS2134-PGE    2MB    256kB
;   TMS570LS2134-ZWT    2MB    256kB
;   TMS570LS2135-PGE    2MB    256kB
;   TMS570LS2135-ZWT    2MB    256kB
;
; HINTS:
;
;   Flash programming algorithm is linked to address 0x08000000 and is not
;   position independent. Code address of FLASH.TARGET command has not be
;   changed.
;
; @Author: WRD
; @Copyright: (C) 1989-2014 Lauterbach GmbH, licensed for use with TRACE32(R) only
; @Chip: TMS570LS21*
; --------------------------------------------------------------------------------
; $Rev: 2881 $
; $Id: tms570ls21xx.cmm 2881 2014-07-07 10:35:48Z kjmal $

  ; --------------------------------------------------------------------------------
  ; Setup script configuration. If auto ECC generation is disabled then
  ; flash sectors are programmed without generating ECC. ECC sectors can be
  ; programmed separately or ECC sector programming can be omitted.

  LOCAL &parameters
  ENTRY %LINE &parameters

  LOCAL &param_prepareonly
  &param_prepareonly=(STRing.SCAN(STRing.UPpeR("&parameters"),"PREPAREONLY",0)!=-1)

  LOCAL &AutoECCGeneration
  &AutoECCGeneration=STRing.SCANAndExtract(STRing.UPpeR("&parameters"),"AUTOECC=","1")

  ; --------------------------------------------------------------------------------
  ; Setup CPU

  IF SYStem.MODE()<5
  (
    SYStem.RESet
    MAP.RESet

    SYStem.CPU TMS570LS2135-ZWT
    ETM.OFF
    SYStem.Up
  )

  ; --------------------------------------------------------------------------------
  ; Flash declaration

  FLASH.RESet

  IF &AutoECCGeneration!=0
  (
    ; Program flash
    FLASH.Create 1. 0x00000000--0x0001ffff  0x8000 TARGET Byte 0.  ; Bank 0
    FLASH.Create 1. 0x00020000--0x0017ffff 0x20000 TARGET Byte 0.  ; Bank 0
    FLASH.Create 2. 0x00180000--0x001fffff 0x20000 TARGET Byte 1.  ; Bank 1
    ; EEPROM emulation flash
    FLASH.Create 8. 0xf0200000--0xf020ffff  0x4000 TARGET Byte 7.  ; Bank 7

    FLASH.TARGET 0x08000000 0x08001000 0x4000 ~~/demo/arm/flash/byte_be/f021r4.bin
  )
  ELSE
  (
    ; Program flash
    FLASH.Create 1. 0x00000000--0x0001ffff  0x8000 TARGET Byte 0. /EraseALIAS 0xf0400000--0xf0403fff  ; Bank 0
    FLASH.Create 1. 0x00020000--0x0017ffff 0x20000 TARGET Byte 0. /EraseALIAS 0xf0404000--0xf042ffff  ; Bank 0
    FLASH.Create 2. 0x00180000--0x001fffff 0x20000 TARGET Byte 1. /EraseALIAS 0xf0430000--0xf043ffff  ; Bank 1
    ; Program flash ECC
    FLASH.Create 1. 0xf0400000--0xf0403fff  0x1000 TARGET Byte 0. /EraseALIAS 0x00000000--0x0001ffff  ; Bank 0
    FLASH.Create 1. 0xf0404000--0xf042ffff  0x4000 TARGET Byte 0. /EraseALIAS 0x00020000--0x0017ffff  ; Bank 0
    FLASH.Create 2. 0xf0430000--0xf043ffff  0x4000 TARGET Byte 1. /EraseALIAS 0x00180000--0x001fffff  ; Bank 1
    ; EEPROM emulation flash
    FLASH.Create 8. 0xf0200000--0xf020ffff  0x4000 TARGET Byte 7. /EraseALIAS 0xf0100000--0xf0101fff  ; Bank 7
    ; EEPROM emulation flash ECC
    FLASH.Create 8. 0xf0100000--0xf0101fff   0x800 TARGET Byte 7. /EraseALIAS 0xf0200000--0xf020ffff  ; Bank 7

    FLASH.TARGET 0x08000000 0x08001000 0x4000 ~~/demo/arm/flash/byte_be/f021r4noecc.bin
  )

  FLASH.CLocK AUTO

  MAP.BUS16 0xf0400000--0xf043ffff
  MAP.BUS16 0xf0100000--0xf0101fff
  MAP.BUS16 0xf0040000--0xf0041fff

  ; Flash script ends here if called with parameter PREPAREONLY
  IF &param_prepareonly
    ENDDO PREPAREDONE

  ; --------------------------------------------------------------------------------
  ; Flash programming example

  DIALOG.YESNO "Program flash memory?"
  LOCAL &progflash
  ENTRY &progflash

  IF &progflash 
  (
    FLASH.ReProgram ALL /Erase
    Data.LOAD.auto *
    FLASH.ReProgram.off 
  )

  ENDDO
