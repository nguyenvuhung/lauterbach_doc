; --------------------------------------------------------------------------------
; @Title: Example for flash declaration of ST STM32F7xx internal flash
; @Description:
;   Script arguments:
;
;    DO stm32f7xx [PREPAREONLY] [CPU=<cpu>]
;
;      PREPAREONLY only declares flash but does not execute flash programming
;
;      CPU=<cpu> selects CPU derivative <cpu>
;
;   Example:
;
;   DO ~~/demo/arm/flash/stm32f7xx CPU=STM32F756NG PREPAREONLY
;
;   List of STM32F7xx derivatives and their configuration:
;
;     CPU-Type        Flash size   Page size    SRAM size
;                       [Byte]      [Byte]        [Byte]
; --------------------------------------------------------------------------------
;     STM32F745IE        0x80000     0x800       0x50000
;     STM32F745IG        0x80000     0x800       0x50000
;     STM32F745VE        0x80000     0x800       0x50000
;     STM32F745VG       0x100000     0x800       0x50000
;     STM32F745ZE        0x80000     0x800       0x50000
;     STM32F745ZG       0x100000     0x800       0x50000
;     STM32F746BE        0x80000     0x800       0x50000
;     STM32F746BG       0x100000     0x800       0x50000
;     STM32F746IE        0x80000     0x800       0x50000
;     STM32F746IG       0x100000     0x800       0x50000
;     STM32F746NE        0x80000     0x800       0x50000
;     STM32F746NG       0x100000     0x800       0x50000
;     STM32F746VE        0x80000     0x800       0x50000
;     STM32F746VG       0x100000     0x800       0x50000
;     STM32F746ZE        0x80000     0x800       0x50000
;     STM32F746ZG       0x100000     0x800       0x50000
;     STM32F756BG       0x100000     0x800       0x50000
;     STM32F756IG       0x100000     0x800       0x50000
;     STM32F756NG       0x100000     0x800       0x50000
;     STM32F756VG       0x100000     0x800       0x50000
;     STM32F756ZG       0x100000     0x800       0x50000
;
; @Author: FLC
; @Copyright: (C) 1989-2015 Lauterbach GmbH, licensed for use with TRACE32(R) only
; --------------------------------------------------------------------------------
; $Rev: 3423 $
; $Id: stm32f7xx.cmm 3423 2015-10-01 15:58:13Z fcaron $


  LOCAL &parameters
  ENTRY %LINE &parameters

  LOCAL &param_prepareonly &param_cpu
  &param_prepareonly=(STRing.SCAN(STRing.UPpeR("&parameters"),"PREPAREONLY",0)!=-1)
  &param_cpu=STRing.SCANAndExtract(STRing.UPpeR("&parameters"),"CPU=","")

  ; ------------------------------------------------------------------------------
  ; Setup CPU

  IF SYStem.MODE()<5
  (
    SYStem.RESet

    IF "&param_cpu"!=""
      SYStem.CPU &param_cpu
    IF !CPUIS(STM32F7*)
      SYStem.CPU STM32F7*
    
    SYStem.Up
  )
  
  ; Disable Watchdog
  Data.Set C:0x40002C00  %Long Data.Long(C:0x40002C00)&~0x80

  ; ------------------------------------------------------------------------------
  ; Flash declaration

  FLASH.RESet
  GOSUB FlashDeclaration

  ; Flash script ends here if called with parameter PREPAREONLY
  IF &param_prepareonly
    ENDDO PREPAREDONE

 ; -------------------------------------------------------------------------------
  ; Flash programming example

  DIALOG.YESNO "Program flash memory?"
  LOCAL &progflash
  ENTRY &progflash
  IF &progflash 
  (
    FLASH.ReProgram.ALL
    Data.LOAD.auto *
    FLASH.ReProgram.off
    
    ; Reset device
    SYStem.Down
    SYStem.Up
  )

  ENDDO


; --------------------------------------------------------------------------------
; Flash declaration depending on selected CPU 

FlashDeclaration:
  LOCAL &FlashSize &FlashDriver

  IF CPUIS("STM32F7???E")
  (
    &FlashSize=0x80000
    &FlashDriver="stm32f7.bin"
  )
  ELSE IF CPUIS("STM32F7???G")
  (
    &FlashSize=0x100000
    &FlashDriver="stm32f7.bin"
  )
  ELSE
  (
    PRINT %ERROR "FLASH size of CPU type is unknown"
    ENDDO
  )

  IF &FlashSize>=0x80000
  (
    FLASH.Create  1. 0x08000000--0x08007FFF 0x8000 TARGET Long
    FLASH.Create  2. 0x08008000--0x0800FFFF 0x8000 TARGET Long
    FLASH.Create  3. 0x08010000--0x08017FFF 0x8000 TARGET Long
    FLASH.Create  4. 0x08018000--0x0801FFFF 0x8000 TARGET Long
    FLASH.Create  5. 0x08020000--0x0803FFFF 0x20000 TARGET Long
    FLASH.Create  6. 0x08040000--0x0807FFFF 0x40000 TARGET Long
  )
  IF &FlashSize>=0x100000
  (
    FLASH.Create  7. 0x08080000--0x080BFFFF 0x40000 TARGET Long
    FLASH.Create  8. 0x080C0000--0x080FFFFF 0x40000 TARGET Long
  )
  ELSE
  (
    PRINT %ERROR "FLASH size of CPU type is unknown"
    ENDDO
  )
  
  FLASH.TARGET 0x20000000 0x20001000 0x40000 ~~/demo/arm/flash/byte/&FlashDriver
  
  RETURN
