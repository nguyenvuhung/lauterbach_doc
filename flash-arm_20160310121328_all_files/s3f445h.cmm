; --------------------------------------------------------------------------------
; @Title: Example for flash declaration of Samsung S3F445HX internal flash 
;
; @Description:
; preliminary
;
; 512 kBytes internal Flash organized in 1024 sectors, 512 Byte each.
; Flash start address is 0x0 or 0x1f00000. Select your setting with
; LOCAL variable flashbase as required.
;
; S3F445HX has 16 kByte internal RAM from 0x1ff0000--0x1ff3fff.
;
; Processor is working in big endian mode.
;
; @Author: WRD
; @Copyright: (C) 1989-2014 Lauterbach GmbH, licensed for use with TRACE32(R) only
; --------------------------------------------------------------------------------
; $Rev: 3152 $
; $Id: s3f445h.cmm 3152 2015-02-06 16:35:19Z kjmal $

  LOCAL &flashbase

  &flashbase=0x0
  ; &flashbase=0x1f00000

  FLASH.RESet
  FLASH.TARGET 0x1ff0000 0x1ff0800 0x1000 ~~/demo/arm/flash/long_be/s3f445hx.bin
  FLASH.Create 1. &flashbase++0x7ffff 0x200 TARGET Long

  ENDDO
