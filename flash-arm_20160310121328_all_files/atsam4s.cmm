; --------------------------------------------------------------------------------
; @Title: Example for flash declaration of Atmel ATSAM4S internal flash. 
; 
; @Description: 
; Script arguments:
;
;   DO atsam4s [PREPAREONLY] [CPU=<cpu>] [DUALPORT=0|1]
;
;     PREPAREONLY only declares flash but does not execute flash programming
;
;     CPU=<cpu> selects CPU derivative <cpu>
;
;     DUALPORT default value is 0 (disabled). If DualPort mode is enabled
;             flash algorithm stays running until flash programming is
;             finished. Data is tranferred via dual port memory access. 
;
; Example:
;
;   DO ~~/demo/arm/flash/atsam4s CPU=ATSAM4SD32C DUALPORT=1 PREPAREONLY
;
; List of ATSAM4S derivatives and their configuration:
;
;   CPU-Type        Flash size   Page size    SRAM size 
;                    [Byte]       [Byte]        [Byte]   
; --------------------------------------------------------------------------------
;   ATSAM4S2A         0x20000      0x200       0x10000 
;   ATSAM4S2B         0x20000      0x200       0x10000 
;   ATSAM4S2C         0x20000      0x200       0x10000 
;   ATSAM4S4A         0x40000      0x200       0x10000 
;   ATSAM4S4B         0x40000      0x200       0x10000 
;   ATSAM4S4C         0x40000      0x200       0x10000 
;   ATSAM4S8A         0x80000      0x200       0x20000   
;   ATSAM4S8B         0x80000      0x200       0x20000   
;   ATSAM4S8C         0x80000      0x200       0x20000   
;   ATSAM4S16A       0x100000      0x200       0x20000   
;   ATSAM4S16B       0x100000      0x200       0x20000   
;   ATSAM4S16C       0x100000      0x200       0x20000   
;   ATSAM4SA16B      0x100000      0x200       0x28000   
;   ATSAM4SA16C      0x100000      0x200       0x28000   
;   ATSAM4SD16B      0x100000      0x200       0x28000   
;   ATSAM4SD16C      0x100000      0x200       0x28000   
;   ATSAM4SD32B      0x200000      0x200       0x28000   
;   ATSAM4SD32C      0x200000      0x200       0x28000   
;
; The internal flash is located at 0x00400000
; The internal SRAM is located at  0x20000000
; The internal ROM is located at   0x00800000.
;
; The system always boot at address 0x0. If GPNVM bit 1 is set the 
; internal flash is mirrored to address 0x0 otherwise ROM is mapped
; to address 0x0.
;
; HINTS:
;
;   Locked pages can be unlocked with FLASH.UNLOCK command and can be 
;   locked again with FLASH.LOCK command.
;
;   Watchdog is critical for flash programming. The flash algorithm is 
;   serving the watchdog if the watchdog is not used in window mode.
;
;   If the watchdog is setup to window mode by a running application 
;   the watchdog should be either disabled after first power-up or the 
;   board should be power-up before every flash programming. If the 
;   watchdog is disabled after power-up it cannot be enabled again by 
;   the application because WDT_MR register is write once. Please see 
;   below the command to disable the watchdog.
;
;   GPNVM bit values can be changed via atsam4-nvm.cmm script.
;
; @Author: WRD
; @Copyright: (C) 1989-2014 Lauterbach GmbH, licensed for use with TRACE32(R) only
; @Chip: ATSAM4S*
; --------------------------------------------------------------------------------
; $Rev: 3270 $
; $Id: atsam4s.cmm 3270 2015-04-23 11:47:25Z fcaron $

  LOCAL &parameters
  ENTRY %LINE &parameters

  LOCAL &param_prepareonly &param_cpu &param_dualport
  &param_prepareonly=(STRing.SCAN(STRing.UPpeR("&parameters"),"PREPAREONLY",0)!=-1)
  &param_cpu=STRing.SCANAndExtract(STRing.UPpeR("&parameters"),"CPU=","")
  &param_dualport=0
  IF VERSION.BUILD.BASE()>=43441.
    &param_dualport=STRing.SCANAndExtract(STRing.UPpeR("&parameters"),"DUALPORT=","0")

  ; ------------------------------------------------------------------------------
  ; Setup CPU

  IF SYStem.MODE()<5
  (
    SYStem.RESet

    IF "&param_cpu"!=""
      SYStem.CPU &param_cpu
    IF !CPUIS(ATSAM4S*)
      SYStem.CPU ATSAM4S*

    SYStem.Option.ResBreak OFF
    IF CABLE.TWOWIRE()
      SYStem.CONFIG.DEBUGPORTTYPE SWD
    ELSE
      SYStem.CONFIG.DEBUGPORTTYPE JTAG

    SYStem.Up
  )

  ; Disable watchdog for flash programming if watchdog may be used in 
  ; window mode.
  //DATA.SET 0x400E1454 %LONG DATA.LONG(ASD:0x400E1454)|0x00008000

  ; ------------------------------------------------------------------------------
  ; Flash declaration

  FLASH.RESet
  GOSUB FlashDeclaration &param_dualport

  ; Setup EEFC wait states in EEFC_FMR register
  //Data.Set ASD:0x400E0800 %Long (Data.Long(ASD:0x400E0800)&0xFFFFF0FF)|0x00000300

  ; Flash script ends here if called with parameter PREPAREONLY
  IF &param_prepareonly
    ENDDO PREPAREDONE

  ; ------------------------------------------------------------------------------
  ; Flash NVM bit programming example

  DIALOG.YESNO "Program flash NVM bits"
  LOCAL &prognvm
  ENTRY &prognvm
  IF &prognvm 
  (
    DO ~~~~/atsam4-nvm
  )

  ; ------------------------------------------------------------------------------
  ; Flash programming example

  DIALOG.YESNO "Program flash memory?"
  LOCAL &progflash
  ENTRY &progflash
  IF &progflash 
  (
    ; Unlock locked pages if necessary
    //FLASH.UNLOCK ALL

    FLASH.ReProgram.ALL
    Data.LOAD.auto *
    FLASH.ReProgram.off
    
    ; Reset device
		SYStem.Down
		SYStem.Up
  )

  ENDDO


; --------------------------------------------------------------------------------
; Flash declaration depending on selected CPU 

FlashDeclaration:
  LOCAL &DualPort
  ENTRY &DualPort

  LOCAL &EFC0flashsize
  LOCAL &EFC1flashsize
  
  
  IF CPUIS("ATSAM4S2?")
  (
      &EFC0flashsize=0x20000
      &EFC1flashsize=0x0
  )
  ELSE IF CPUIS("ATSAM4S4?")
  (
      &EFC0flashsize=0x40000
      &EFC1flashsize=0x0
  )
  ELSE IF CPUIS("ATSAM4S8?")
  (
    &EFC0flashsize=0x80000
    &EFC1flashsize=0x0
  )
  ELSE IF CPUIS("ATSAM4S16?")
  (
    &EFC0flashsize=0x100000
    &EFC1flashsize=0x0
  )
  ELSE IF CPUIS("ATSAM4SA16?")||CPUIS("ATSAM4SD16?")
  (
    &EFC0flashsize=0x80000
    &EFC1flashsize=0x80000
  )
  ELSE IF CPUIS("ATSAM4S?32?")
  (
    &EFC0flashsize=0x100000
    &EFC1flashsize=0x100000
  )
  ELSE
  (
    PRINT %ERROR "FLASH size of CPU type is unknown"
    ENDDO
  )

  FLASH.Create  1. 0x00400000--0x00401FFF 0x1000 TARGET Long 0.
  FLASH.Create  2. 0x00402000--0x00403FFF 0x1000 TARGET Long 0.
  FLASH.Create  3. 0x00404000--0x0040FFFF 0x1000 TARGET Long 0.
  FLASH.Create  4. 0x00410000--0x0041FFFF 0x1000 TARGET Long 0.
  IF &EFC0flashsize>=0x40000
  (
    FLASH.Create  5. 0x00420000--0x0042FFFF 0x1000 TARGET Long 0.
    FLASH.Create  6. 0x00430000--0x0043FFFF 0x1000 TARGET Long 0.
  )
  IF &EFC0flashsize>=0x80000
  (
    FLASH.Create  7. 0x00440000--0x0044FFFF 0x1000 TARGET Long 0.
    FLASH.Create  8. 0x00450000--0x0045FFFF 0x1000 TARGET Long 0.
    FLASH.Create  9. 0x00460000--0x0046FFFF 0x1000 TARGET Long 0.
    FLASH.Create 10. 0x00470000--0x0047FFFF 0x1000 TARGET Long 0.
  )
  IF &EFC0flashsize>=0x100000
  (
    FLASH.Create 11. 0x00480000--0x0048FFFF 0x1000 TARGET Long 0.
    FLASH.Create 12. 0x00490000--0x0049FFFF 0x1000 TARGET Long 0.
    FLASH.Create 13. 0x004A0000--0x004AFFFF 0x1000 TARGET Long 0.
    FLASH.Create 14. 0x004B0000--0x004BFFFF 0x1000 TARGET Long 0.
    FLASH.Create 15. 0x004C0000--0x004CFFFF 0x1000 TARGET Long 0.
    FLASH.Create 16. 0x004D0000--0x004DFFFF 0x1000 TARGET Long 0.
    FLASH.Create 17. 0x004E0000--0x004EFFFF 0x1000 TARGET Long 0.
    FLASH.Create 18. 0x004F0000--0x004FFFFF 0x1000 TARGET Long 0.
  )

  IF &EFC1flashsize>0x0
  (
    LOCAL &EFC1flashbase
    &EFC1flashbase=0x00400000+&EFC0flashsize
    FLASH.Create 19. (&EFC1flashbase+0x00000)--(&EFC1flashbase+0x01FFF) 0x1000 TARGET Long 1.
    FLASH.Create 20. (&EFC1flashbase+0x02000)--(&EFC1flashbase+0x03FFF) 0x1000 TARGET Long 1.
    FLASH.Create 21. (&EFC1flashbase+0x04000)--(&EFC1flashbase+0x0FFFF) 0x1000 TARGET Long 1.
    FLASH.Create 22. (&EFC1flashbase+0x10000)--(&EFC1flashbase+0x1FFFF) 0x1000 TARGET Long 1.
    FLASH.Create 23. (&EFC1flashbase+0x20000)--(&EFC1flashbase+0x2FFFF) 0x1000 TARGET Long 1.
    FLASH.Create 24. (&EFC1flashbase+0x30000)--(&EFC1flashbase+0x3FFFF) 0x1000 TARGET Long 1.
    FLASH.Create 25. (&EFC1flashbase+0x40000)--(&EFC1flashbase+0x4FFFF) 0x1000 TARGET Long 1.
    FLASH.Create 26. (&EFC1flashbase+0x50000)--(&EFC1flashbase+0x5FFFF) 0x1000 TARGET Long 1.
    FLASH.Create 27. (&EFC1flashbase+0x60000)--(&EFC1flashbase+0x6FFFF) 0x1000 TARGET Long 1.
    FLASH.Create 28. (&EFC1flashbase+0x70000)--(&EFC1flashbase+0x7FFFF) 0x1000 TARGET Long 1.
    IF &EFC1flashsize>=0x100000
    (
      FLASH.Create 29. (&EFC1flashbase+0x80000)--(&EFC1flashbase+0x8FFFF) 0x1000 TARGET Long 1.
      FLASH.Create 30. (&EFC1flashbase+0x90000)--(&EFC1flashbase+0x9FFFF) 0x1000 TARGET Long 1.
      FLASH.Create 31. (&EFC1flashbase+0xA0000)--(&EFC1flashbase+0xAFFFF) 0x1000 TARGET Long 1.
      FLASH.Create 32. (&EFC1flashbase+0xB0000)--(&EFC1flashbase+0xBFFFF) 0x1000 TARGET Long 1.
      FLASH.Create 33. (&EFC1flashbase+0xC0000)--(&EFC1flashbase+0xCFFFF) 0x1000 TARGET Long 1.
      FLASH.Create 34. (&EFC1flashbase+0xD0000)--(&EFC1flashbase+0xDFFFF) 0x1000 TARGET Long 1.
      FLASH.Create 35. (&EFC1flashbase+0xE0000)--(&EFC1flashbase+0xEFFFF) 0x1000 TARGET Long 1.
      FLASH.Create 36. (&EFC1flashbase+0xF0000)--(&EFC1flashbase+0xFFFFF) 0x1000 TARGET Long 1.
    )
  )

  IF &DualPort==0
    FLASH.TARGET 0x20000000 0x20000800 0x1000 ~~/demo/arm/flash/long/eefcsam4s.bin
  ELSE
    FLASH.TARGET 0x20000000 EAHB:0x20000800 0x1000 ~~/demo/arm/flash/long/eefcsam4s.bin /DualPort

  RETURN
