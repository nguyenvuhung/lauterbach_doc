;Default startup program for TRACE32
;
;This startup program can be modified according to your needs.

;choose hex mode for input
 radix hex

;Add some extra buttons to the toolbar

 menu.rp
 (
  add
  toolbar
  (
   separator
   toolitem "Source/List" "list" "Data.List"
   toolitem "Memory Dump" "dump" "Data.dump"
   toolitem "Register" "reg" "Register /SpotLight"
   separator
   toolitem "Watch" ":var" "Var.Watch"
   toolitem "Stack" ":varframe" "Var.Frame /l /c"
   toolitem "Automatic Watch" ":varref" "Var.Ref"
   separator
   toolitem "List Breakpoints" "break" "Break.List"
   toolitem "List Symbols" "symbols" "sYmbol.Browse"
   separator
   toolitem "Target Settings" ":config" "system"
  )
 )

;Select CPU type
 system.cpu arm720t

;Recall and Define History File
 autostore , history

 enddo

