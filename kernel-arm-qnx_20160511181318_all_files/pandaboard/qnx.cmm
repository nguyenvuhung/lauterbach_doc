; --------------------------------------------------------------------------------
; @Title: QNX Demo for TRACE32 RTOS Debugger
; @Description: 
;   
;   This batchfile demonstrates the use of the RTOS Debugger for QNX
;   
;   The example is generated for the PandaBoard using an ICD.
;   It will NOT run on any other board, but may be used as a template
;   for others.
;   QNX is downloaded to the board via ICD.
;   
;   This script initializes the target by the debugger.
;   Neither X-Loader nor u-boot are used.
;   
; @Keywords: awareness, qnx, RTOS
; @Props: Template
; @Author: DIE
; @Board: PandaBoard
; @Chip: OMAP4430
; @Copyright: (C) 1989-2014 Lauterbach GmbH, licensed for use with TRACE32(R) only
; --------------------------------------------------------------------------------
; $Id: qnx.cmm 7821 2014-10-29 11:06:58Z kjmal $


; Starting QNX example with TRACE32:
; - Connect STRAIGHT modem cable to RS232
;   - 115200 baud, 8/N/1, no(!) handshake
; - Start TRACE32
; - Switch on the board
; - TRACE32: "do qnx"
; - Terminal: start "sieve_g"


 SCREEN.ALways      ; permanent update for internal terminal window
 ; screen.on        ; if you use external terminal


; Debugger Reset

 WinPAGE.RESet
 AREA.RESet
 WinPOS 0. 21. 70. 9. 0. 0. W000
 AREA.view
 
 PRINT "resetting..."

 RESet

 DIALOG.OK "Please reset the target and continue"


; Initializing Debugger

 PRINT "initializing..."
 SYStem.CPU OMAP4430
 SYStem.JtagClock RTCK
 SYStem.Option ResBreak OFF     ; hardware dependent (see manual)
 SYStem.Option WaitReset ON     ; hardware dependent (see manual)
 SYStem.Option DACR ON          ; give Debugger global write permissions
 TrOnchip.Set DABORT OFF        ; used by QNX for page miss!
 TrOnchip.Set PABORT OFF        ; used by QNX for page miss!
 TrOnchip.Set UNDEF OFF         ; my be used by QNX for FPU detection
 SYStem.Option MMUSPACES ON     ; enable space ids to virtual addresses
 
 SYStem.Up
 
 SETUP.IMASKASM ON             ; lock interrupts while single stepping
 
 MAP.DenyAccess 0xC0000000--0xDFFFFFFF  ; disable access to non-existent memory
 
 
; Open a Code Window -- we like to see something

 WinPOS 0. 0. 75. 20.
 List.auto
 

; Open serial terminal window on COM1
 
 WinPOS 35. 0. ,,,,, TERM.view
; TERM.METHOD COM COM1 115200. 8 NONE 1STOP NONE
 TERM.METHOD COM \\.\COM11 115200. 8 NONE 1STOP NONE
 TERM.SIZE 80. 1000.
 TERM.Mode VT100
 TERM.SCROLL ON
 TERM.view
 

; Target Setup: initialize DRAM controller and peripherals
 
 ; Either let the boot monitor setup the board
    ; start u-boot to initialize the board
    Go
    PRINT "target setup..."
    WAIT 2.s
    Break
    
 ; or use the debugger to initialize it
    ;print "target setup..."
    ;do panda_setup_1.cmm
    ;do panda_setup_2.cmm


; Download QNX IFS

 PRINT "loading QNX image..."

 ; specify download address
 ; see "System->Image Address" property of your system builder project
 &DNLD_ADDR=0x80100000
 
 ; load the QNX image onto the target
 Data.LOAD.Binary bsp-TI-OMAP4430-Panda.ifs &DNLD_ADDR
 
 Register.Set PC &DNLD_ADDR


; if you want to debug the startup
 ; Data.LOAD.Elf startup-panda.sym /nocode
 

; Load the symbols of procnto
 PRINT "loading procnto symbols..."
 Data.LOAD.Elf procnto-smp-instr-201007091524.sym /NoCODE 


; Configure ETM or STM trace probe
 PRINT "configuring trace probe..."
 DO trace.cmm
 

; Run over MMU initialization

 Break.Set _main /Program /Onchip   ; use onchip because of virtual address
 Go
 PRINT "initilizing QNX..."
 WAIT !run()
 Break.Delete _main
 

; Declare the MMU format to the debugger
 PRINT "initializing debugger MMU..."
 ;MMU.FORMAT QNX
 MMU.SCAN                                   ; scan initial kernel tables
 TRANSlation.COMMON 0xe0000000--0xffffffff  ; kernel area is common for all MMU space ids
 TRANSlation.TableWalk ON   ; debugger uses a table walk to decode virtual addresses
 TRANSlation.ON             ; switch on debugger(!) address translation 
 

; Initialize QNX Support

 PRINT "initializing QNX support..."
 TASK.CONFIG ~~/demo/arm/kernel/qnx/qnx.t32     ; loads QNX awareness
 MENU.ReProgram ~~/demo/arm/kernel/qnx/qnx.men  ; loads QNX menu
 HELP.FILTER.Add rtosqnx    ; add QNX awareness manual to help system
 
 TASK.sYmbol.Option MMUSCAN OFF  ; not necessary with tablewalk

 ; switch on autoloader
 sYmbol.AutoLoad.CHECKQNX "do ~~/demo/arm/kernel/qnx/autoload "

 ; Group kernel area to be displayed with red bar
 GROUP.Create "kernel" 0xfc000000--0xffffffff /RED

 ; activate autoloader for processes:
 TASK.sYmbol.Option AutoLoad Process
 
 
; adapt source paths
 sYmbol.SourcePATH.Translate "C:/ide-4.7-workspace/" "X:\QNX\QNX650\Trace32\arm\PandaBoard\sievelib\"
 

; Now let's boot and start QNX!
 
 wintop TERM.view        ; set terminal window to front
 Go
 PRINT "starting QNX... (please wait)"
 WAIT 5.s       ; let it run for 3 seconds
 ;Break
 
 PRINT "done."
 
 ENDDO
 

; --------------------------------------------------------------------------------
; Application Debugging
; e.g. "sieve_g"
; --------------------------------------------------------------------------------

 PRINT "please start 'sieve_g'"

 ; script based
   ; using the script based application debugging
   ; gives more control over the single commands
   ; see file "app_debug.cmm"
   
   ;do ~~/demo/arm/kernel/qnx/app_debug sieve_g
   
 ; process watch system
   ; the process watch system automates the actions
   ; for application debugging
   
   WinPOS 55. 24. 40. 4.
   TASK.Watch.View  "sieve_g"
   Go

ENDDO
 
