; --------------------------------------------------------------------------------
; @Title: QNX Demo for TRACE32 RTOS Debugger on the OMAP3530 BeagleBoard
; @Description: 
;   
;   This batchfile demonstrates the use of the RTOS Debugger for QNX
;   
;   The example is generated for the OMAP3530 BeagleBoard using an ICD.
;   It will NOT run on any other board, but may be used as a template
;   for others.
;   QNX is downloaded to the board via ICD.
;   
; @Keywords: awareness, qnx, RTOS
; @Props: Template
; @Author: DIE
; @Board: BeagleBoard
; @Chip: OMAP3530
; @Copyright: (C) 1989-2014 Lauterbach GmbH, licensed for use with TRACE32(R) only
; --------------------------------------------------------------------------------
; $Id: qnx.cmm 7821 2014-10-29 11:06:58Z kjmal $


; Starting QNX example with TRACE32:
; - Connect STRAIGHT modem cable to RS232
;   - 115200 baud, 8/N/1, no(!) handshake
; - Start TRACE32
; - Switch on the board
; - TRACE32: "do qnx"
; - terminal: start "sieve"


 SCREEN.ALways      ; permanent update for internal terminal window
 ; screen.on        ; if you use external terminal


; Debugger Reset

 WinPAGE.RESet
 AREA.RESet
 WinPOS 0. 25. 75. 8. 0. 0. W000
 AREA.view
 
 PRINT "resetting..."
 
 RESet


; Initializing Debugger
 
 PRINT "initializing..."
 SYStem.CPU OMAP3530
 SYStem.JtagClock RTCK
 SYStem.Option DACR ON          ; give Debugger global write permissions
 SYStem.Option ResBreak OFF     ; hardware dependent (see manual)
 SYStem.Option WaitReset ON     ; hardware dependent (see manual)
 TrOnchip.Set DABORT OFF        ; used by qnx for page miss!
 TrOnchip.Set PABORT OFF        ; used by qnx for page miss!
 SYStem.Option MMUSPACES ON     ; enable space ids to virtual addresses

 SYStem.Up

 SETUP.IMASKASM ON          ; lock interrupts while single stepping


; Open serial terminal window on COM1
 
 WinPOS 35. 0. ,,,,, TERM.view
 TERM.METHOD COM COM1 115200. 8 NONE 1STOP NONE
 TERM.SIZE 80. 1000.
 TERM.SCROLL ON
 TERM.Mode VT100
 TERM.view
 

; Target Setup: initialize DRAM controller and peripherals
 
 ; Either let the boot monitor setup the board
    ; Ensure, that the proper IPL is programmed into flash!
    Go
    PRINT "target setup..."
    WAIT 5.s
    Break
 ; or use the debugger to initialize it
    ;print "target setup..."
    ;do init_beagleboard   ; do basic setup

 
; Download QNX IFS

 PRINT "loading QNX image..."

 ; specify download address
 ; see "System->Image Address" property of your system builder project
 &DNLD_ADDR=0x80100000
 
 ; load the QNX image onto the target
 Data.LOAD.Binary bsp-TI-omap3530.ifs &DNLD_ADDR
 
 Register.Set PC &DNLD_ADDR
 

; Generating symbol files
 ; The QNX Awareness needs the symbols of procnto (procnto.sym). 
 ; In QNX 6.1/6.2, you have to add "[+keeplinked]" to your
 ; image build file. 
 ; In QNX 6.3, set the project.bld property 
 ; "Procnto/Startup Symbol Files?" to "Yes".
 ; The symbol files are stored in your "Images" directory.
 
; if you want to debug the startup
 ; Data.LOAD.Elf startup-beagle.sym /nocode
 
; Load the symbols of procnto
 PRINT "loading procnto symbols..."
 Data.LOAD.Elf procnto-v6-instr.sym /NoCODE 
 
 
; Run over MMU initialization

 Break.Set _main /Program /Onchip   ; use onchip because of virtual address
 Go
 PRINT "initilizing QNX..."
 WAIT !run()
 Break.Delete _main
 

; Switch on debugger address translation
 PRINT "scanning system MMU..."
 ;MMU.FORMAT QNX
 MMU.SCAN                                   ; scan initial kernel tables
 TRANSlation.COMMON 0xe0000000--0xffffffff  ; kernel area is common for all MMU space ids
 TRANSlation.TableWalk ON   ; debugger uses a table walk to decode virtual addresses
 TRANSlation.ON             ; switch on debugger(!) address translation 

 
; We'd like to see something, open a code window.
 WinPOS 0. 0. 77. 22.
 List.auto
 

; Initialize QNX Support

 PRINT "initializing QNX support..."
 TASK.CONFIG ~~/demo/arm/kernel/qnx/qnx.t32     ; loads QNX awareness
 MENU.ReProgram ~~/demo/arm/kernel/qnx/qnx.men  ; loads QNX menu
 HELP.FILTER.Add rtosqnx    ; add QNX awareness manual to help system
 
 TASK.sYmbol.Option MMUSCAN OFF  ; not necessary with tablewalk

 ; switch on autoloader
 sYmbol.AutoLOAD.CHECKLINUX "do ~~/demo/arm/kernel/qnx/autoload "

 ; Group kernel area to be displayed with red bar
 GROUP.Create "kernel" 0xfc000000--0xffffffff /RED

 ; activate autoloader for processes:
 TASK.sYmbol.Option AutoLoad Process
 

; Set search path for symbol files and sources
 
 sYmbol.SourcePATH .    ; current directory

; Now let's boot and start QNX!
 
 wintop TERM.view        ; set terminal window to front
 Go
 PRINT "starting QNX... (please wait)"
 WAIT 2.s       ; let it run for 3 seconds
 Break
 
 PRINT "done."
 

; --------------------------------------------------------------------------------
; Application Debugging
; e.g. "sieve"
; --------------------------------------------------------------------------------

 PRINT "please start 'sieve'"

 ; script based
   ; using the script based application debugging
   ; gives more control over the single commands
   ; see file "app_debug.cmm"
   
   ;do ~~/demo/arm/kernel/qnx/app_debug sieve
   
 ; process watch system
   ; the process watch system automates the actions
   ; for application debugging
   
   WinPOS 55. 24. 40. 4.
   TASK.Watch.View  "sieve"
   Go

ENDDO

 
